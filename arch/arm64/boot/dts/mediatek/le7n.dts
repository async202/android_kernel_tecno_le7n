/*
 * Mediatek's MT6768 SoC device tree source
 *
 * Copyright (C) 2018 MediaTek Inc.
 * Copyright (C) 2021 XiaoMi, Inc.
 *
 * This program is free software; you can redistribute it and/or modify
 * it under the terms of the GNU General Public License version 2 as
 * published by the Free Software Foundation.
 *
 * This program is distributed in the hope that it will be useful,
 * but WITHOUT ANY WARRANTY; without even the implied warranty of
 * MERCHANTABILITY or FITNESS FOR A PARTICULAR PURPOSE.
 * See http://www.gnu.org/licenses/gpl-2.0.html for more details.
 */

/dts-v1/;
#include <dt-bindings/interrupt-controller/arm-gic.h>
#include <dt-bindings/interrupt-controller/irq.h>
#include <dt-bindings/mmc/mt6768-msdc.h>
#include <dt-bindings/memory/mt6768-larb-port.h>
#include <dt-bindings/pinctrl/mt6768-pinfunc.h>
#include <dt-bindings/gce/mt6768-gce.h>
#include <dt-bindings/clock/mt6768-clk.h>
#include <dt-bindings/iio/mt635x-auxadc.h>
#include <dt-bindings/mfd/mt6358-irq.h>
#include <dt-bindings/gce/mt6768-gce.h>
#include <generated/autoconf.h>

/ {
	model = "MT6768";
	compatible = "mediatek,MT6768";
	interrupt-parent = <&sysirq>;
	#address-cells = <0x02>;
	#size-cells = <0x02>;

	chosen: chosen {
		bootargs = "console=tty0 console=ttyS0,921600n1 root=/dev/ram vmalloc=400M slub_debug=OFZPU swiotlb=noforce cgroup.memory=nosocket,nokmem firmware_class.path=/vendor/firmware page_owner=on loop.max_part=7 androidboot.selinux=permissive";
		kaslr-seed = <0x00 0x00>;
		phandle = <0x68>;
	};

	cpus {
		#address-cells = <0x01>;
		#size-cells = <0x00>;

		cpu0: cpu@000 {
			device_type = "cpu";
			compatible = "arm,cortex-a55";
			reg = <0x00>;
			enable-method = "psci";
			clock-frequency = <0x65633340>;
			cpu-idle-states = <0x02 0x03 0x04 0x05 0x06 0x07 0x08>;
			phandle = <0x09>;
		};

		cpu1: cpu@001 {
			device_type = "cpu";
			compatible = "arm,cortex-a55";
			reg = <0x100>;
			enable-method = "psci";
			clock-frequency = <0x65633340>;
			cpu-idle-states = <0x02 0x03 0x04 0x05 0x06 0x07 0x08>;
			phandle = <0x0a>;
		};

		cpu2: cpu@002 {
			device_type = "cpu";
			compatible = "arm,cortex-a55";
			reg = <0x200>;
			enable-method = "psci";
			clock-frequency = <0x65633340>;
			cpu-idle-states = <0x02 0x03 0x04 0x05 0x06 0x07 0x08>;
			phandle = <0x0b>;
		};

		cpu3: cpu@003 {
			device_type = "cpu";
			compatible = "arm,cortex-a55";
			reg = <0x300>;
			enable-method = "psci";
			clock-frequency = <0x65633340>;
			cpu-idle-states = <0x02 0x03 0x04 0x05 0x06 0x07 0x08>;
			phandle = <0x0c>;
		};

		cpu4: cpu@100 {
			device_type = "cpu";
			compatible = "arm,cortex-a55";
			reg = <0x400>;
			enable-method = "psci";
			clock-frequency = <0x65633340>;
			cpu-idle-states = <0x02 0x03 0x04 0x05 0x06 0x07 0x08>;
			phandle = <0x0d>;
		};

		cpu5: cpu@101 {
			device_type = "cpu";
			compatible = "arm,cortex-a55";
			reg = <0x500>;
			enable-method = "psci";
			clock-frequency = <0x65633340>;
			cpu-idle-states = <0x02 0x03 0x04 0x05 0x06 0x07 0x08>;
			phandle = <0x0e>;
		};

		cpu6: cpu@102 {
			device_type = "cpu";
			compatible = "arm,cortex-a75";
			reg = <0x600>;
			enable-method = "psci";
			clock-frequency = <0x8166d4c0>;
			cpu-idle-states = <0x02 0x03 0x04 0x05 0x06 0x07 0x08>;
			phandle = <0x0f>;
		};

		cpu7: cpu@103 {
			device_type = "cpu";
			compatible = "arm,cortex-a75";
			reg = <0x700>;
			enable-method = "psci";
			clock-frequency = <0x8166d4c0>;
			cpu-idle-states = <0x02 0x03 0x04 0x05 0x06 0x07 0x08>;
			phandle = <0x10>;
		};

		cpu-map {

			cluster0 {

				core0 {
					cpu = <0x09>;
				};

				core1 {
					cpu = <0x0a>;
				};

				core2 {
					cpu = <0x0b>;
				};

				core3 {
					cpu = <0x0c>;
				};

				core4 {
					cpu = <0x0d>;
				};

				core5 {
					cpu = <0x0e>;
				};

				doe_dvfs_cl0: doe {
					phandle = <0x69>;
				};
			};

			cluster1 {

				core0 {
					cpu = <0x0f>;
				};

				core1 {
					cpu = <0x10>;
				};

				doe_dvfs_cl1: doe {
					phandle = <0x6a>;
				};
			};
		};

		idle-states {
			entry-method = "arm,psci";

			STANDBY: standby {
				compatible = "arm,idle-state";
				arm,psci-suspend-param = <0x01>;
				entry-latency-us = <0x258>;
				exit-latency-us = <0x258>;
				min-residency-us = <0x4b0>;
				phandle = <0x02>;
			};

			MCDI_CPU: mcdi-cpu {
				compatible = "arm,idle-state";
				arm,psci-suspend-param = <0x10001>;
				entry-latency-us = <0x258>;
				exit-latency-us = <0x258>;
				min-residency-us = <0x4b0>;
				phandle = <0x03>;
			};

			MCDI_CLUSTER: mcdi-cluster {
				compatible = "arm,idle-state";
				arm,psci-suspend-param = <0x1010001>;
				entry-latency-us = <0x258>;
				exit-latency-us = <0x258>;
				min-residency-us = <0x4b0>;
				phandle = <0x04>;
			};

			idledram: idledram {
				compatible = "arm,idle-state";
				arm,psci-suspend-param = <0x1010002>;
				entry-latency-us = <0x320>;
				exit-latency-us = <0x3e8>;
				min-residency-us = <0x7d0>;
				status = "okay";
				phandle = <0x05>;
			};

			idlesyspll: idlesyspll {
				compatible = "arm,idle-state";
				arm,psci-suspend-param = <0x1010003>;
				entry-latency-us = <0x320>;
				exit-latency-us = <0x3e8>;
				min-residency-us = <0x7d0>;
				status = "okay";
				phandle = <0x06>;
			};

			idlebus26m: idlebus26m {
				compatible = "arm,idle-state";
				arm,psci-suspend-param = <0x1010004>;
				entry-latency-us = <0x320>;
				exit-latency-us = <0x3e8>;
				min-residency-us = <0x7d0>;
				status = "okay";
				phandle = <0x07>;
			};

			SUSPEND: suspend {
				compatible = "arm,idle-state";
				arm,psci-suspend-param = <0x1010005>;
				entry-latency-us = <0x320>;
				exit-latency-us = <0x3e8>;
				min-residency-us = <0x7d0>;
				phandle = <0x08>;
			};
		};
	};

	cache_parity {
		compatible = "mediatek,cache_parity";
		version = <0x01>;
		reg = <0x00 0xc530000 0x00 0x10000>;
		err_level = <0x01>;
		irq_config = <0x00 0x8090 0xff00 0x8090 0x44 0x8090 0xff 0x01 0x8090 0xff00 0x8090 0x44 0x8090 0xff 0x02 0x8090 0xff00 0x8090 0x44 0x8090 0xff 0x03 0x8090 0xff00 0x8090 0x44 0x8090 0xff 0x04 0x8090 0xff00 0x8090 0x44 0x8090 0xff 0x05 0x8090 0xff00 0x8090 0x44 0x8090 0xff 0x06 0x8090 0xff00 0x8090 0x44 0x8090 0xff 0x07 0x8090 0xff00 0x8090 0x44 0x8090 0xff 0x400 0xc8c0 0x1000000 0xc8c0 0x0c 0xc8c8 0x01>;
		interrupts = <GIC_SPI 22 IRQ_TYPE_LEVEL_HIGH GIC_SPI 23 IRQ_TYPE_LEVEL_HIGH GIC_SPI 24 IRQ_TYPE_LEVEL_HIGH GIC_SPI 25 IRQ_TYPE_LEVEL_HIGH GIC_SPI 26 IRQ_TYPE_LEVEL_HIGH GIC_SPI 27 IRQ_TYPE_LEVEL_HIGH GIC_SPI 28 IRQ_TYPE_LEVEL_HIGH GIC_SPI 29 IRQ_TYPE_LEVEL_HIGH GIC_SPI 19 IRQ_TYPE_LEVEL_HIGH>;
	};

	memory {
		device_type = "memory";
		reg = <0x00 0x40000000 0x00 0x3e605000>;
	};

	psci {
		compatible = "arm,psci-1.0";
		method = "smc";
	};

	mobicore {
		compatible = "trustonic,mobicore";
		interrupts = <GIC_SPI 297 IRQ_TYPE_EDGE_RISING>;
	};

	tee_sanity {
		compatible = "mediatek,tee_sanity";
		interrupts = <GIC_SPI 298 IRQ_TYPE_EDGE_RISING>;
	};

	utos {
		compatible = "microtrust,utos";
		interrupts = <GIC_SPI 299 IRQ_TYPE_EDGE_RISING GIC_SPI 300 IRQ_TYPE_EDGE_RISING>;
	};

	utos_tester {
		compatible = "microtrust,tester-v1";
	};

	pmu {
		compatible = "arm,armv8-pmuv3";
		interrupt-parent = <&gic>;
		interrupts = <GIC_PPI 7 IRQ_TYPE_LEVEL_LOW>;
	};

	dsu-pmu-0 {
		compatible = "arm,dsu-pmu";
		interrupts = <GIC_SPI 18 IRQ_TYPE_LEVEL_HIGH>;
		cpus = <0x09 0x0a 0x0b 0x0c 0x0d 0x0e 0x0f 0x10>;
	};

	reserved_memory: reserved-memory {
		#address-cells = <0x02>;
		#size-cells = <0x02>;
		ranges;
		phandle = <0x6b>;

		zmc-default {
			compatible = "mediatek,zone_movable_cma";
			size = <0x00 0x2d000000>;
			alignment = <0x00 0x1000000>;
			alloc-ranges = <0x00 0xc0000000 0x04 0x00>;
		};

		reserve-memory-sspm_share {
			compatible = "mediatek,reserve-memory-sspm_share";
			no-map;
			status = "okay";
			size = <0x00 0x510000>;
			alignment = <0x00 0x10000>;
			alloc-ranges = <0x00 0x40000000 0x00 0x60000000>;
		};

		reserve-memory-scp_share {
			compatible = "mediatek,reserve-memory-scp_share";
			no-map;
			size = <0x00 0x300000>;
			alignment = <0x00 0x1000000>;
			alloc-ranges = <0x00 0x40000000 0x00 0x50000000>;
		};

		ion-carveout-heap {
			compatible = "mediatek,ion-carveout-heap";
			no-map;
			size = <0x00 0x9000>;
			alignment = <0x00 0x1000>;
			alloc-ranges = <0x00 0xc0000000 0x04 0x00>;
		};

		consys-reserve-memory {
			compatible = "mediatek,consys-reserve-memory";
			no-map;
			size = <0x00 0x400000>;
			alignment = <0x00 0x1000000>;
			alloc-ranges = <0x00 0x40000000 0x00 0x80000000>;
		};

		wifi_mem: wifi-reserve-memory {
			compatible = "shared-dma-pool";
			no-map;
			size = <0x00 0x300000>;
			alignment = <0x00 0x1000000>;
			alloc-ranges = <0x00 0x40000000 0x00 0x80000000>;
			phandle = <0x5f>;
		};

		soter-shared-mem {
			compatible = "microtrust,shared_mem";
			no-map;
			size = <0x00 0x800000>;
			alignment = <0x00 0x1000000>;
			alloc-ranges = <0x00 0x40000000 0x00 0x50000000>;
		};
	};

	cpu_dbgapb: cpu_dbgapb@0e010000 {
		compatible = "mediatek,hw_dbg";
		num = <0x08>;
		reg = <0x00 0xe010000 0x00 0x1000 0x00 0xe110000 0x00 0x1000 0x00 0xe210000 0x00 0x1000 0x00 0xe310000 0x00 0x1000 0x00 0xe410000 0x00 0x1000 0x00 0xe510000 0x00 0x1000 0x00 0xe610000 0x00 0x1000 0x00 0xe710000 0x00 0x1000>;
		phandle = <0x6c>;
	};

	gic: interrupt-controller {
		compatible = "arm,gic-v3";
		#interrupt-cells = <0x03>;
		#address-cells = <0x02>;
		#size-cells = <0x02>;
		#redistributor-regions = <0x01>;
		interrupt-parent = <&gic>;
		interrupt-controller;
		reg = <0x00 0xc000000 0x00 0x40000 0x00 0xc040000 0x00 0x200000 0x00 0xc53a650 0x00 0x50>;
		interrupts = <GIC_PPI 9 IRQ_TYPE_LEVEL_HIGH>;
		phandle = <0x11>;
	};

	sysirq: intpol-controller@0 {
		compatible = "mediatek,mt6577-sysirq";
		interrupt-controller;
		#interrupt-cells = <0x03>;
		interrupt-parent = <&gic>;
		reg = <0x00 0xc53a650 0x00 0x50>;
		phandle = <0x01>;
	};

	chipid@08000000 {
		compatible = "mediatek,chipid";
		reg = <0x00 0x8000000 0x00 0x04 0x00 0x8000004 0x00 0x04 0x00 0x8000008 0x00 0x04 0x00 0x800000c 0x00 0x04>;
	};

	timer: timer {
		compatible = "arm,armv8-timer";
		interrupt-parent = <&gic>;
		interrupts = <GIC_PPI 13 IRQ_TYPE_LEVEL_LOW GIC_PPI 14 IRQ_TYPE_LEVEL_LOW GIC_PPI 11 IRQ_TYPE_LEVEL_LOW GIC_PPI 10 IRQ_TYPE_LEVEL_LOW>;
		clock-frequency = <0xc65d40>;
		phandle = <0x6d>;
	};

	infracfg_ao: infracfg_ao@10001000 {
		compatible = "mediatek,infracfg_ao\0syscon";
		reg = <0x00 0x10001000 0x00 0x1000>;
		interrupts = <GIC_SPI 71 IRQ_TYPE_EDGE_RISING>;
		#clock-cells = <0x01>;
		phandle = <0x21>;
	};

	scpsys: scpsys@10001000 {
		compatible = "mediatek,scpsys\0syscon";
		reg = <0x00 0x10001000 0x00 0x1000 0x00 0x10006000 0x00 0x1000 0x00 0x14002000 0x00 0x1000 0x00 0x1020e000 0x00 0x1000 0x00 0x18004000 0x00 0x1000 0x00 0x18002000 0x00 0x1000 0x00 0x10000000 0x00 0x1000 0x00 0x16000000 0x00 0x1000 0x00 0x16025000 0x00 0x1000>;
		#clock-cells = <0x01>;
		phandle = <0x22>;
	};

	mcdi: mcdi@0010fc00 {
		compatible = "mediatek,mt6768-mcdi";
		mediatek,enabled = <0x01>;
		reg = <0x00 0x10fc00 0x00 0x800 0x00 0xc53a000 0x00 0x1000>;
		phandle = <0x6e>;
	};

	scp@10500000 {
		compatible = "mediatek,scp";
		status = "okay";
		reg = <0x00 0x10500000 0x00 0x80000 0x00 0x105c0000 0x00 0x3000 0x00 0x105c4000 0x00 0x1000 0x00 0x105d4000 0x00 0x6000>;
		interrupts = <GIC_SPI 205 IRQ_TYPE_LEVEL_HIGH>;
		core_1 = "enable";
		scp_sramSize = <0x80000>;
	};

	scp_dvfs {
		compatible = "mediatek,scp_dvfs";
		clocks = <&topckgen &mt6358_snd &clk26m &topckgen &cpu5 &topckgen &io_cfg_rb &topckgen &STANDBY &topckgen &io_cfg_lb &topckgen &idlesyspll &topckgen &io_cfg_rm>;
		clock-names = "clk_mux\0clk_pll_0\0clk_pll_1\0clk_pll_2\0clk_pll_3\0clk_pll_4\0clk_pll_5\0clk_pll_6";
	};

	topckgen: topckgen@10000000 {
		compatible = "mediatek,topckgen\0syscon";
		reg = <0x00 0x10000000 0x00 0x1000>;
		#clock-cells = <0x01>;
		phandle = <0x12>;
	};

	io_cfg_lt: io_cfg_lt@10002000 {
		compatible = "mediatek,io_cfg_lt";
		reg = <0x00 0x10002000 0x00 0x200>;
		phandle = <0x15>;
	};

	io_cfg_lm: io_cfg_lm@10002200 {
		compatible = "mediatek,io_cfg_lm";
		reg = <0x00 0x10002200 0x00 0x200>;
		phandle = <0x16>;
	};

	io_cfg_lb: io_cfg_lb@10002400 {
		compatible = "mediatek,io_cfg_lb";
		reg = <0x00 0x10002400 0x00 0x200>;
		phandle = <0x17>;
	};

	io_cfg_bl: io_cfg_bl@10002600 {
		compatible = "mediatek,io_cfg_bl";
		reg = <0x00 0x10002600 0x00 0x200>;
		phandle = <0x18>;
	};

	io_cfg_rm: io_cfg_rm@10002800 {
		compatible = "mediatek,io_cfg_rm";
		reg = <0x00 0x10002800 0x00 0x200>;
		phandle = <0x19>;
	};

	io_cfg_rb: io_cfg_rb@10002a00 {
		compatible = "mediatek,io_cfg_rb";
		reg = <0x00 0x10002a00 0x00 0x200>;
		phandle = <0x1a>;
	};

	io_cfg_rt: io_cfg_rt@10002c00 {
		compatible = "mediatek,io_cfg_rt";
		reg = <0x00 0x10002c00 0x00 0x200>;
		phandle = <0x1b>;
	};

	io_cfg_tl: io_cfg_tl@10002e00 {
		compatible = "mediatek,io_cfg_tl";
		reg = <0x00 0x10002e00 0x00 0x200>;
		phandle = <0x1c>;
	};

	pericfg: pericfg@10003000 {
		compatible = "mediatek,pericfg\0syscon";
		reg = <0x00 0x10003000 0x00 0x1000>;
		#clock-cells = <0x01>;
		phandle = <0x6f>;
	};

	efuse_dbg@10004000 {
		compatible = "mediatek,efuse_dbg";
		reg = <0x00 0x10004000 0x00 0x1000>;
	};

	gpio: gpio@10005000 {
		compatible = "mediatek,gpio";
		reg = <0x00 0x10005000 0x00 0x1000>;
		phandle = <0x14>;
	};

	pio: pinctrl {
		compatible = "mediatek,mt6768-pinctrl";
		reg_bases = <0x14 0x15 0x16 0x17 0x18 0x19 0x1a 0x1b 0x1c>;
		reg_base_eint = <0x1d>;
		pins-are-numbered;
		gpio-controller;
		gpio-ranges = <0x1e 0x00 0x00 0xba>;
		#gpio-cells = <0x02>;
		interrupt-controller;
		interrupts = <GIC_SPI 186 IRQ_TYPE_LEVEL_HIGH>;
		#interrupt-cells = <0x04>;
		phandle = <0x1e>;

		aud_clk_mosi_off: aud_clk_mosi_off {
			phandle = <0x3f>;

			pins_cmd0_dat {
				pinmux = <0x8800 /* GPIO136_F0 */ 0x8900 /* GPIO137_F0 */>;
			};
		};

		aud_clk_mosi_on: aud_clk_mosi_on {
			phandle = <0x40>;

			pins_cmd0_dat {
				pinmux = <0x8801 /* GPIO136_F1 */>;
				input-schmitt-enable;
			};

			pins_cmd1_dat {
				pinmux = <0x8901 /* GPIO137_F1 */>;
				input-schmitt-enable;
			};
		};

		aud_clk_miso_off: aud_clk_miso_off {
			phandle = <0x41>;

			pins_cmd0_dat {
				pinmux = <0x8c00 /* GPIO140_F0 */ 0x8d00 /* GPIO141_F0 */>;
			};
		};

		aud_clk_miso_on: aud_clk_miso_on {
			phandle = <0x42>;

			pins_cmd0_dat {
				pinmux = <0x8c01 /* GPIO140_F1 */>;
				input-schmitt-enable;
			};

			pins_cmd1_dat {
				pinmux = <0x8d01 /* GPIO141_F1 */>;
				input-schmitt-enable;
			};
		};

		aud_dat_mosi_off: aud_dat_mosi_off {
			phandle = <0x43>;

			pins_cmd0_dat {
				pinmux = <0x8800 /* GPIO136_F0 */>;
				input-enable;
				slew-rate = <0x00>;
				bias-disable;
			};

			pins_cmd1_dat {
				pinmux = <0x8900 /* GPIO137_F0 */>;
				input-enable;
				slew-rate = <0x00>;
				bias-disable;
			};

			pins_cmd2_dat {
				pinmux = <0x8a00 /* GPIO138_F0 */>;
				input-enable;
				slew-rate = <0x00>;
				bias-disable;
			};

			pins_cmd3_dat {
				pinmux = <0x8b00 /* GPIO139_F0 */>;
				input-enable;
				slew-rate = <0x00>;
				bias-pull-down;
			};
		};

		aud_dat_mosi_on: aud_dat_mosi_on {
			phandle = <0x44>;

			pins_cmd0_dat {
				pinmux = <0x8801 /* GPIO136_F1 */>;
				input-schmitt-enable;
			};

			pins_cmd1_dat {
				pinmux = <0x8901 /* GPIO137_F1 */>;
				input-schmitt-enable;
			};

			pins_cmd2_dat {
				pinmux = <0x8a01 /* GPIO138_F1 */>;
				input-schmitt-enable;
			};

			pins_cmd3_dat {
				pinmux = <0x8b01 /* GPIO139_F1 */>;
				input-schmitt-enable;
			};
		};

		aud_dat_miso_off: aud_dat_miso_off {
			phandle = <0x45>;

			pins_cmd0_dat {
				pinmux = <0x8c00 /* GPIO140_F0 */>;
				input-enable;
				slew-rate = <0x00>;
				bias-disable;
			};

			pins_cmd1_dat {
				pinmux = <0x8d00 /* GPIO141_F0 */>;
				input-enable;
				slew-rate = <0x00>;
				bias-disable;
			};

			pins_cmd2_dat {
				pinmux = <0x8e00 /* GPIO142_F0 */>;
				input-enable;
				slew-rate = <0x00>;
				bias-disable;
			};

			pins_cmd3_dat {
				pinmux = <0x8f00 /* GPIO143_F0 */>;
				input-enable;
				slew-rate = <0x00>;
				bias-disable;
			};
		};

		aud_dat_miso_on: aud_dat_miso_on {
			phandle = <0x46>;

			pins_cmd0_dat {
				pinmux = <0x8c01 /* GPIO140_F1 */>;
				input-schmitt-enable;
			};

			pins_cmd1_dat {
				pinmux = <0x8d01 /* GPIO141_F1 */>;
				input-schmitt-enable;
			};

			pins_cmd2_dat {
				pinmux = <0x8e01 /* GPIO142_F1 */>;
				input-schmitt-enable;
			};

			pins_cmd3_dat {
				pinmux = <0x8f01 /* GPIO143_F1 */>;
				input-schmitt-enable;
			};
		};

		aud_gpio_i2s0_off: aud_gpio_i2s0_off {
			phandle = <0x47>;

			pins_cmd_dat {
				pinmux = <0x2800 /* GPIO40_F0 */>;
			};
		};

		aud_gpio_i2s0_on: aud_gpio_i2s0_on {
			phandle = <0x48>;

			pins_cmd_dat {
				pinmux = <0x2802 /* GPIO40_F2 */>;
			};
		};

		aud_gpio_i2s1_off: aud_gpio_i2s1_off {
			phandle = <0x49>;
		};

		aud_gpio_i2s1_on: aud_gpio_i2s1_on {
			phandle = <0x4a>;
		};

		aud_gpio_i2s2_off: aud_gpio_i2s2_off {
			phandle = <0x4b>;
		};

		aud_gpio_i2s2_on: aud_gpio_i2s2_on {
			phandle = <0x4c>;
		};

		aud_gpio_i2s3_off: aud_gpio_i2s3_off {
			phandle = <0x4d>;

			pins_cmd_dat {
				pinmux = <0x2500 /* GPIO37_F0 */ 0x2600 /* GPIO38_F0 */ 0x2400 /* GPIO36_F0 */>;
			};
		};

		aud_gpio_i2s3_on: aud_gpio_i2s3_on {
			phandle = <0x4e>;

			pins_cmd_dat {
				pinmux = <0x2502 /* GPIO37_F2 */ 0x2602 /* GPIO38_F2 */ 0x2402 /* GPIO36_F2 */>;
			};
		};

		vow_dat_miso_off: vow_dat_miso_off {
			phandle = <0x4f>;

			pins_cmd1_dat {
				pinmux = <0x8e00 /* GPIO142_F0 */>;
			};
		};

		vow_dat_miso_on: vow_dat_miso_on {
			phandle = <0x50>;

			pins_cmd1_dat {
				pinmux = <0x8e04 /* GPIO142_F4 */>;
			};
		};

		vow_clk_miso_off: vow_clk_miso_off {
			phandle = <0x51>;

			pins_cmd3_dat {
				pinmux = <0x8f00 /* GPIO143_F0 */>;
			};
		};

		vow_clk_miso_on: vow_clk_miso_on {
			phandle = <0x52>;

			pins_cmd3_dat {
				pinmux = <0x8f04 /* GPIO143_F4 */>;
			};
		};

		msdc0_pins_default: msdc0@default {
			phandle = <0x31>;

			pins_cmd {
				drive-strength = [03];
			};

			pins_dat {
				drive-strength = [03];
			};

			pins_clk {
				drive-strength = [03];
			};

			pins_rst {
				drive-strength = [03];
			};

			pins_ds {
				drive-strength = [03];
			};
		};

		msdc0_pins_hs400: msdc0@hs400 {
			phandle = <0x32>;

			pins_cmd {
				drive-strength = [03];
			};

			pins_dat {
				drive-strength = [04];
			};

			pins_clk {
				drive-strength = [04];
			};

			pins_rst {
				drive-strength = [03];
			};

			pins_ds {
				drive-strength = [04];
			};
		};

		msdc0_pins_hs200: msdc0@hs200 {
			phandle = <0x33>;

			pins_cmd {
				drive-strength = [03];
			};

			pins_dat {
				drive-strength = [04];
			};

			pins_clk {
				drive-strength = [04];
			};

			pins_rst {
				drive-strength = [03];
			};

			pins_ds {
				drive-strength = [04];
			};
		};

		msdc0_register_setting_default: msdc0@register_default {
			cmd_edge = [00];
			rdata_edge = [00];
			wdata_edge = [00];
			phandle = <0x34>;
		};

		msdc1_pins_default: msdc1@default {
			phandle = <0x36>;

			pins_cmd {
				drive-strength = [03];
			};

			pins_dat {
				drive-strength = [03];
			};

			pins_clk {
				drive-strength = [03];
			};
		};

		msdc1_pins_sdr104: msdc1@sdr104 {
			phandle = <0x37>;

			pins_cmd {
				drive-strength = [03];
			};

			pins_dat {
				drive-strength = [03];
			};

			pins_clk {
				drive-strength = [03];
			};
		};

		msdc1_pins_sdr50: msdc1@sdr50 {
			phandle = <0x38>;

			pins_cmd {
				drive-strength = [03];
			};

			pins_dat {
				drive-strength = [03];
			};

			pins_clk {
				drive-strength = [03];
			};
		};

		msdc1_pins_ddr50: msdc1@ddr50 {
			phandle = <0x39>;

			pins_cmd {
				drive-strength = [03];
			};

			pins_dat {
				drive-strength = [03];
			};

			pins_clk {
				drive-strength = [03];
			};
		};

		msdc1_register_setting_default: msdc1@register_default {
			cmd_edge = [00];
			rdata_edge = [00];
			wdata_edge = [00];
			phandle = <0x3a>;
		};

                camdefault: camdefault {
                };

                camera0_rst_output_low: camera0_rst_output_low {
                    pins_cmd_dat {
                        pinmux = <PINMUX_GPIO102__FUNC_GPIO102>;
                        output-low;
                    };
                };

                camera0_rst_output_high: camera0_rst_output_high {
                    pins_cmd_dat {
                        pinmux = <PINMUX_GPIO102__FUNC_GPIO102>;
                        output-high;
                    };
                };

                camera1_rst_output_low: camera1_rst_output_low {
                    pins_cmd_dat {
                        pinmux = <PINMUX_GPIO101__FUNC_GPIO101>;
                        output-low;
                    };
                };

                camera1_rst_output_high: camera1_rst_output_high {
                    pins_cmd_dat {
                        pinmux = <PINMUX_GPIO101__FUNC_GPIO101>;
                        output-high;
                    };
                };

                camera1_pdn_output_low: camera1_pdn_output_low {
                    pins_cmd_dat {
                        pinmux = <PINMUX_GPIO97__FUNC_GPIO97>;
                        slew-rate = <1>;
                        output-low;
                    };
                };

                camera1_pdn_output_high: camera1_pdn_output_high {
                    pins_cmd_dat {
                        pinmux = <PINMUX_GPIO97__FUNC_GPIO97>;
                        output-high;
                    };
                };

                camera2_rst_output_low: camera2_rst_output_low {
                    pins_cmd_dat {
                        pinmux = <PINMUX_GPIO37__FUNC_GPIO37>;
                        output-low;
                    };
                };

                camera2_rst_output_high: camera2_rst_output_high {
                    pins_cmd_dat {
                        pinmux = <PINMUX_GPIO37__FUNC_GPIO37>;
                        output-high;
                    };
                };

                camera2_pdn_output_low: camera2_pdn_output_low {
                    pins_cmd_dat {
                        pinmux = <PINMUX_GPIO36__FUNC_GPIO36>;
                        output-low;
                    };
                };

                camera2_pdn_output_high: camera2_pdn_output_high {
                    pins_cmd_dat {
                        pinmux = <PINMUX_GPIO36__FUNC_GPIO36>;
                        output-high;
                    };
                };

                camera3_rst_output_low: camera3_rst_output_low {
                    pins_cmd_dat {
                        pinmux = <PINMUX_GPIO109__FUNC_GPIO109>;
                        output-low;
                    };
                };

                camera3_rst_output_high: camera3_rst_output_high {
                    pins_cmd_dat {
                        pinmux = <PINMUX_GPIO109__FUNC_GPIO109>;
                        output-high;
                    };
                };

                camera3_pdn_output_low: camera3_pdn_output_low {
                    pins_cmd_dat {
                        pinmux = <PINMUX_GPIO107__FUNC_GPIO107>;
                        output-low;
                    };
                };

                camera3_pdn_output_high: camera3_pdn_output_high {
                    pins_cmd_dat {
                        pinmux = <PINMUX_GPIO107__FUNC_GPIO107>;
                        output-high;
                    };
                };

                camera4_pdn_output_low: camera4_pdn_output_low {
                    pins_cmd_dat {
                        pinmux = <PINMUX_GPIO110__FUNC_GPIO110>;
                        output-low;
                    };
                };

                camera4_pdn_output_high: camera4_pdn_output_high {
                    pins_cmd_dat {
                        pinmux = <PINMUX_GPIO110__FUNC_GPIO110>;
                        output-high;
                    };
                };

                camera0_vcama_output_low: camera0_vcama_output_low {
                    pins_cmd_dat {
                        pinmux = <PINMUX_GPIO23__FUNC_GPIO23>;
                        output-low;
                    };
                };

                camera0_vcama_output_high: camera0_vcama_output_high {
                    pins_cmd_dat {
                        pinmux = <PINMUX_GPIO23__FUNC_GPIO23>;
                        output-high;
                    };
                };

                camera1_vcama_output_low: camera1_vcama_output_low {
                    pins_cmd_dat {
                        pinmux = <PINMUX_GPIO23__FUNC_GPIO23>;
                        output-low;
                    };
                };

                camera1_vcama_output_high: camera1_vcama_output_high {
                    pins_cmd_dat {
                        pinmux = <PINMUX_GPIO23__FUNC_GPIO23>;
                        output-high;
                    };
                };

                camera0_vcamd_output_low: camera0_vcamd_output_low {
                    pins_cmd_dat {
                        pinmux = <PINMUX_GPIO40__FUNC_GPIO40>;
                        output-low;
                    };
                };

                camera0_vcamd_output_high: camera0_vcamd_output_high {
                    pins_cmd_dat {
                        pinmux = <PINMUX_GPIO40__FUNC_GPIO40>;
                        output-high;
                    };
                };

		camera0_mclk_2mA: camera0_mclk_2mA { pins_cmd_dat { pinmux = <0x6401>; drive-strength = <2>; }; };
		camera0_mclk_4mA: camera0_mclk_4mA { pins_cmd_dat { pinmux = <0x6401>; drive-strength = <4>; }; };
		camera0_mclk_6mA: camera0_mclk_6mA { pins_cmd_dat { pinmux = <0x6401>; drive-strength = <6>; }; };
		camera0_mclk_8mA: camera0_mclk_8mA { pins_cmd_dat { pinmux = <0x6401>; drive-strength = <7>; }; };
		camera0_mclk_gpio_mode: camera0_mclk_gpio_mode { pins_cmd_dat { pinmux = <0x6400>; drive-strength = <4>; }; };

		camera1_mclk_2mA: camera1_mclk_2mA { pins_cmd_dat { pinmux = <0x6301>; drive-strength = <2>; }; };
		camera1_mclk_4mA: camera1_mclk_4mA { pins_cmd_dat { pinmux = <0x6301>; drive-strength = <4>; }; };
		camera1_mclk_6mA: camera1_mclk_6mA { pins_cmd_dat { pinmux = <0x6301>; drive-strength = <6>; }; };
		camera1_mclk_8mA: camera1_mclk_8mA { pins_cmd_dat { pinmux = <0x6301>; drive-strength = <7>; }; };
		camera1_mclk_gpio_mode: camera1_mclk_gpio_mode { pins_cmd_dat { pinmux = <0x6300>; drive-strength = <4>; }; };

		camera2_mclk_2mA: camera2_mclk_2mA { pins_cmd_dat { pinmux = <0x6f01>; drive-strength = <2>; }; };
		camera2_mclk_4mA: camera2_mclk_4mA { pins_cmd_dat { pinmux = <0x6f01>; drive-strength = <4>; }; };
		camera2_mclk_6mA: camera2_mclk_6mA { pins_cmd_dat { pinmux = <0x6f01>; drive-strength = <6>; }; };
		camera2_mclk_8mA: camera2_mclk_8mA { pins_cmd_dat { pinmux = <0x6f01>; drive-strength = <7>; }; };
		camera2_mclk_gpio_mode: camera2_mclk_gpio_mode { pins_cmd_dat { pinmux = <0x6f00>; drive-strength = <4>; }; };

		camera3_mclk_2mA: camera3_mclk_2mA { pins_cmd_dat { pinmux = <0x6c01>; drive-strength = <2>; }; };
		camera3_mclk_4mA: camera3_mclk_4mA { pins_cmd_dat { pinmux = <0x6c01>; drive-strength = <4>; }; };
		camera3_mclk_6mA: camera3_mclk_6mA { pins_cmd_dat { pinmux = <0x6c01>; drive-strength = <6>; }; };
		camera3_mclk_8mA: camera3_mclk_8mA { pins_cmd_dat { pinmux = <0x6c01>; drive-strength = <7>; }; };
		camera3_mclk_gpio_mode: camera3_mclk_gpio_mode { pins_cmd_dat { pinmux = <0x6c00>; drive-strength = <4>; }; };

		camera4_mclk_2mA: camera4_mclk_2mA { pins_cmd_dat { pinmux = <0x6f01>; drive-strength = <2>; }; };
		camera4_mclk_4mA: camera4_mclk_4mA { pins_cmd_dat { pinmux = <0x6f01>; drive-strength = <4>; }; };
		camera4_mclk_6mA: camera4_mclk_6mA { pins_cmd_dat { pinmux = <0x6f01>; drive-strength = <6>; }; };
		camera4_mclk_8mA: camera4_mclk_8mA { pins_cmd_dat { pinmux = <0x6f01>; drive-strength = <7>; }; };
		camera4_mclk_gpio_mode: camera4_mclk_gpio_mode { pins_cmd_dat { pinmux = <0x6f00>; drive-strength = <4>; }; };
	};

	sleep: sleep@10006000 {
		compatible = "mediatek,sleep";
		reg = <0x00 0x10006000 0x00 0x1000>;
		interrupts = <GIC_SPI 195 IRQ_TYPE_LEVEL_LOW>;
		phandle = <0x70>;
	};

	toprgu: toprgu@10007000 {
		compatible = "mediatek,toprgu";
		reg = <0x00 0x10007000 0x00 0x1000>;
		interrupts = <GIC_SPI 156 IRQ_TYPE_LEVEL_LOW>;
		phandle = <0x71>;
	};

	clocks {

		clk26m: clk26m {
			compatible = "fixed-clock";
			#clock-cells = <0x00>;
			clock-frequency = <0x18cba80>;
			phandle = <0x13>;
		};

		clk32k: clk32k {
			compatible = "fixed-clock";
			#clock-cells = <0x00>;
			clock-frequency = <0x7d00>;
			phandle = <0x1f>;
		};
	};

	dcm: dcm {
		compatible = "mediatek,dcm";
		phandle = <0x72>;
	};

	apxgpt@10008000 {
		compatible = "mediatek,apxgpt";
		reg = <0x00 0x10008000 0x00 0x1000>;
		interrupts = <GIC_SPI 185 IRQ_TYPE_LEVEL_LOW>;
		clocks = <&clk32k>;
	};

	hacc@1000a000 {
		compatible = "mediatek,hacc";
		reg = <0x00 0x1000a000 0x00 0x1000>;
		interrupts = <GIC_SPI 203 IRQ_TYPE_LEVEL_LOW>;
	};

	eint: apirq@1000b000 {
		compatible = "mediatek,apirq";
		reg = <0x00 0x1000b000 0x00 0x1000>;
		interrupts = <GIC_SPI 186 IRQ_TYPE_LEVEL_HIGH>;
		phandle = <0x1d>;
	};

	apmixed: apmixed@1000c000 {
		compatible = "mediatek,apmixed\0syscon";
		reg = <0x00 0x1000c000 0x00 0x1000>;
		#clock-cells = <0x01>;
		phandle = <0x3d>;
	};

	fhctl@1000ce00 {
		compatible = "mediatek,fhctl";
		reg = <0x00 0x1000ce00 0x00 0x200>;
	};

	pwrap: pwrap@1000d000 {
		compatible = "mediatek,mt6768-pwrap";
		reg = <0x00 0x1000d000 0x00 0x1000>;
		reg-names = "pwrap";
		interrupts = <GIC_SPI 194 IRQ_TYPE_LEVEL_HIGH>;
		clocks = <&clk26m &clk26m>;
		clock-names = "spi\0wrap";
		phandle = <0x20>;

		main_pmic: mt6358-pmic {
			compatible = "mediatek,mt6358-pmic";
			interrupt-parent = <&pio>;
			interrupts = <0x90 0x04 0x90 0x00>;
			status = "okay";
			interrupt-controller;
			#interrupt-cells = <0x02>;
			mediatek,num-pmic-irqs = <0x91>;
			mediatek,pmic-irqs = <0x00 0x00 0x01 0x00 0x02 0x00 0x03 0x00 0x04 0x00 0x05 0x00 0x06 0x00 0x07 0x00 0x08 0x00 0x09 0x00 0x10 0x01 0x11 0x01 0x12 0x01 0x13 0x01 0x14 0x01 0x15 0x01 0x16 0x01 0x17 0x01 0x18 0x01 0x19 0x01 0x1a 0x01 0x1b 0x01 0x1c 0x01 0x1d 0x01 0x1e 0x01 0x1f 0x01 0x20 0x01 0x21 0x01 0x22 0x01 0x23 0x01 0x24 0x01 0x25 0x01 0x26 0x01 0x27 0x01 0x28 0x01 0x29 0x01 0x2a 0x01 0x2b 0x01 0x2c 0x01 0x2d 0x01 0x2e 0x01 0x30 0x02 0x31 0x02 0x32 0x02 0x33 0x02 0x34 0x02 0x35 0x02 0x36 0x02 0x37 0x02 0x40 0x03 0x50 0x04 0x51 0x04 0x52 0x04 0x53 0x04 0x54 0x04 0x55 0x04 0x56 0x04 0x57 0x04 0x58 0x04 0x59 0x04 0x5a 0x04 0x5b 0x04 0x5c 0x04 0x60 0x04 0x61 0x04 0x62 0x04 0x63 0x04 0x64 0x04 0x70 0x05 0x71 0x05 0x72 0x05 0x73 0x05 0x74 0x05 0x75 0x05 0x76 0x05 0x77 0x05 0x80 0x06 0x85 0x06 0x86 0x06 0x87 0x06 0x90 0x07>;
			interrupt-names = "vproc11_oc\0vproc12_oc\0vcore_oc\0vgpu_oc\0vmodem_oc\0vdram1_oc\0vs1_oc\0vs2_oc\0vpa_oc\0vcore_preoc\0vfe28_oc\0vxo22_oc\0vrf18_oc\0vrf12_oc\0vefuse_oc\0vcn33_oc\0vcn28_oc\0vcn18_oc\0vcama1_oc\0vcama2_oc\0vcamd_oc\0vcamio_oc\0vldo28_oc\0va12_oc\0vaux18_oc\0vaud28_oc\0vio28_oc\0vio18_oc\0vsram_proc11_oc\0vsram_proc12_oc\0vsram_others_oc\0vsram_gpu_oc\0vdram2_oc\0vmc_oc\0vmch_oc\0vemc_oc\0vsim1_oc\0vsim2_oc\0vibr_oc\0vusb_oc\0vbif28_oc\0pwrkey\0homekey\0pwrkey_r\0homekey_r\0ni_lbat_int\0chrdet\0chrdet_edge\0vcdt_hv_det\0rtc\0fg_bat0_h\0fg_bat0_l\0fg_cur_h\0fg_cur_l\0fg_zcv\0fg_bat1_h\0fg_bat1_l\0fg_n_charge_l\0fg_iavg_h\0fg_iavg_l\0fg_time_h\0fg_discharge\0fg_charge\0baton_lv\0baton_ht\0baton_bat_in\0baton_bat_out\0bif\0bat_h\0bat_l\0bat2_h\0bat2_l\0bat_temp_h\0bat_temp_l\0auxadc_imp\0nag_c_dltv\0audio\0accdet\0accdet_eint0\0accdet_eint1\0spi_cmd_alert";
			phandle = <0x60>;

			pmic: mt-pmic {
				compatible = "mediatek,mt-pmic";
				interrupts = <0x30 0x04 0x32 0x04 0x31 0x04 0x33 0x04 0x70 0x04 0x71 0x04 0x52 0x04 0x53 0x04>;
				interrupt-names = "pwrkey\0pwrkey_r\0homekey\0homekey_r\0bat_h\0bat_l\0fg_cur_h\0fg_cur_l";
				phandle = <0x73>;
			};

			pmic_auxadc: mt635x-auxadc {
				compatible = "mediatek,mt6358-auxadc";
				#io-channel-cells = <0x01>;
				phandle = <0x74>;

				batadc {
					channel = <0x00>;
					resistance-ratio = <0x03 0x01>;
					avg-num = <0x80>;
				};

				vcdt {
					channel = <0x02>;
				};

				bat_temp {
					channel = <0x03>;
					resistance-ratio = <0x02 0x01>;
				};

				chip_temp {
					channel = <0x05>;
				};

				vcore_temp {
					channel = <0x06>;
				};

				vproc_temp {
					channel = <0x07>;
				};

				vgpu_temp {
					channel = <0x08>;
				};

				accdet {
					channel = <0x09>;
				};

				dcxo_volt {
					channel = <0x0a>;
					resistance-ratio = <0x03 0x02>;
				};

				tsx_temp {
					channel = <0x0b>;
					avg-num = <0x80>;
				};

				hpofs_cal {
					channel = <0x0c>;
					avg-num = <0x100>;
				};

				dcxo_temp {
					channel = <0x0d>;
					avg-num = <0x10>;
				};

				vbif {
					channel = <0x0e>;
					resistance-ratio = <0x02 0x01>;
				};
			};

			mt6358regulator: mt6358regulator {
				compatible = "mediatek,mt6358-regulator";
				phandle = <0x75>;

				mt_pmic_vdram1_buck_reg: buck_vdram1 {
					regulator-name = "vdram1";
					regulator-min-microvolt = <0x7a120>;
					regulator-max-microvolt = <0x1fda4c>;
					regulator-enable-ramp-delay = <0x00>;
					phandle = <0x76>;
				};

				mt_pmic_vcore_buck_reg: buck_vcore {
					regulator-name = "vcore";
					regulator-min-microvolt = <0x7a120>;
					regulator-max-microvolt = <0x13bdb6>;
					regulator-enable-ramp-delay = <0xc8>;
					phandle = <0x77>;
				};

				mt_pmic_vpa_buck_reg: buck_vpa {
					regulator-name = "vpa";
					regulator-min-microvolt = <0x7a120>;
					regulator-max-microvolt = <0x37b1d0>;
					regulator-enable-ramp-delay = <0xfa>;
					phandle = <0x78>;
				};

				mt_pmic_vproc11_buck_reg: buck_vproc11 {
					regulator-name = "vproc11";
					regulator-min-microvolt = <0x7a120>;
					regulator-max-microvolt = <0x13bdb6>;
					regulator-enable-ramp-delay = <0xc8>;
					phandle = <0x79>;
				};

				mt_pmic_vproc12_buck_reg: buck_vproc12 {
					regulator-name = "vproc12";
					regulator-min-microvolt = <0x7a120>;
					regulator-max-microvolt = <0x13bdb6>;
					regulator-enable-ramp-delay = <0xc8>;
					phandle = <0x7a>;
				};

				mt_pmic_vgpu_buck_reg: buck_vgpu {
					regulator-name = "vgpu";
					regulator-min-microvolt = <0x7a120>;
					regulator-max-microvolt = <0x13bdb6>;
					regulator-enable-ramp-delay = <0xc8>;
					phandle = <0x7b>;
				};

				mt_pmic_vs2_buck_reg: buck_vs2 {
					regulator-name = "vs2";
					regulator-min-microvolt = <0x7a120>;
					regulator-max-microvolt = <0x1fda4c>;
					regulator-enable-ramp-delay = <0x00>;
					phandle = <0x7c>;
				};

				mt_pmic_vmodem_buck_reg: buck_vmodem {
					regulator-name = "vmodem";
					regulator-min-microvolt = <0x7a120>;
					regulator-max-microvolt = <0x13bdb6>;
					regulator-enable-ramp-delay = <0x384>;
					phandle = <0x7d>;
				};

				mt_pmic_vs1_buck_reg: buck_vs1 {
					regulator-name = "vs1";
					regulator-min-microvolt = <0xf4240>;
					regulator-max-microvolt = <0x277b6c>;
					regulator-enable-ramp-delay = <0x00>;
					phandle = <0x7e>;
				};

				mt_pmic_vdram2_ldo_reg: ldo_vdram2 {
					regulator-name = "vdram2";
					regulator-min-microvolt = <0x927c0>;
					regulator-max-microvolt = <0x1b7740>;
					regulator-enable-ramp-delay = <0xce4>;
					phandle = <0x7f>;
				};

				mt_pmic_vsim1_ldo_reg: ldo_vsim1 {
					regulator-name = "vsim1";
					regulator-min-microvolt = <0x19f0a0>;
					regulator-max-microvolt = <0x2f4d60>;
					regulator-enable-ramp-delay = <0x21c>;
					phandle = <0x80>;
				};

				mt_pmic_vibr_ldo_reg: ldo_vibr {
					regulator-name = "vibr";
					regulator-min-microvolt = <0x124f80>;
					regulator-max-microvolt = <0x325aa0>;
					regulator-enable-ramp-delay = <0x3c>;
					phandle = <0x81>;
				};

				mt_pmic_vrf12_ldo_reg: ldo_vrf12 {
					compatible = "regulator-fixed";
					regulator-name = "vrf12";
					regulator-min-microvolt = <0x124f80>;
					regulator-max-microvolt = <0x124f80>;
					regulator-enable-ramp-delay = <0x78>;
					phandle = <0x82>;
				};

				mt_pmic_vio18_ldo_reg: ldo_vio18 {
					compatible = "regulator-fixed";
					regulator-name = "vio18";
					regulator-min-microvolt = <0x1b7740>;
					regulator-max-microvolt = <0x1b7740>;
					regulator-enable-ramp-delay = <0xa8c>;
					phandle = <0x83>;
				};

				mt_pmic_vusb_ldo_reg: ldo_vusb {
					regulator-name = "vusb";
					regulator-min-microvolt = <0x2dc6c0>;
					regulator-max-microvolt = <0x2f4d60>;
					regulator-enable-ramp-delay = <0x10e>;
					phandle = <0x84>;
				};

				mt_pmic_vcamio_ldo_reg: ldo_vcamio {
					compatible = "regulator-fixed";
					regulator-name = "vcamio";
					regulator-min-microvolt = <0x1b7740>;
					regulator-max-microvolt = <0x1b7740>;
					regulator-enable-ramp-delay = <0x10e>;
					phandle = <0x85>;
				};

				mt_pmic_vcamd_ldo_reg: ldo_vcamd {
					regulator-name = "vcamd";
					regulator-min-microvolt = <0xdbba0>;
					regulator-max-microvolt = <0x1b7740>;
					regulator-enable-ramp-delay = <0x10e>;
					phandle = <0x86>;
				};

				mt_pmic_vcn18_ldo_reg: ldo_vcn18 {
					compatible = "regulator-fixed";
					regulator-name = "vcn18";
					regulator-min-microvolt = <0x1b7740>;
					regulator-max-microvolt = <0x1b7740>;
					regulator-enable-ramp-delay = <0x10e>;
					phandle = <0x87>;
				};

				mt_pmic_vfe28_ldo_reg: ldo_vfe28 {
					compatible = "regulator-fixed";
					regulator-name = "vfe28";
					regulator-min-microvolt = <0x2ab980>;
					regulator-max-microvolt = <0x2ab980>;
					regulator-enable-ramp-delay = <0x10e>;
					phandle = <0x88>;
				};

				mt_pmic_vsram_proc11_ldo_reg: ldo_vsram_proc11 {
					regulator-name = "vsram_proc11";
					regulator-min-microvolt = <0x7a120>;
					regulator-max-microvolt = <0x13bdb6>;
					regulator-enable-ramp-delay = <0xf0>;
					phandle = <0x89>;
				};

				mt_pmic_vcn28_ldo_reg: ldo_vcn28 {
					compatible = "regulator-fixed";
					regulator-name = "vcn28";
					regulator-min-microvolt = <0x2ab980>;
					regulator-max-microvolt = <0x2ab980>;
					regulator-enable-ramp-delay = <0x10e>;
					phandle = <0x8a>;
				};

				mt_pmic_vsram_others_ldo_reg: ldo_vsram_others {
					regulator-name = "vsram_others";
					regulator-min-microvolt = <0x7a120>;
					regulator-max-microvolt = <0x13bdb6>;
					regulator-enable-ramp-delay = <0xf0>;
					phandle = <0x8b>;
				};

				mt_pmic_vsram_gpu_ldo_reg: ldo_vsram_gpu {
					regulator-name = "vsram_gpu";
					regulator-min-microvolt = <0x7a120>;
					regulator-max-microvolt = <0x13bdb6>;
					regulator-enable-ramp-delay = <0xf0>;
					phandle = <0x8c>;
				};

				mt_pmic_vxo22_ldo_reg: ldo_vxo22 {
					compatible = "regulator-fixed";
					regulator-name = "vxo22";
					regulator-min-microvolt = <0x2191c0>;
					regulator-max-microvolt = <0x2191c0>;
					regulator-enable-ramp-delay = <0x78>;
					phandle = <0x8d>;
				};

				mt_pmic_vefuse_ldo_reg: ldo_vefuse {
					regulator-name = "vefuse";
					regulator-min-microvolt = <0x19f0a0>;
					regulator-max-microvolt = <0x1cfde0>;
					regulator-enable-ramp-delay = <0x10e>;
					phandle = <0x8e>;
				};

				mt_pmic_vaux18_ldo_reg: ldo_vaux18 {
					compatible = "regulator-fixed";
					regulator-name = "vaux18";
					regulator-min-microvolt = <0x1b7740>;
					regulator-max-microvolt = <0x1b7740>;
					regulator-enable-ramp-delay = <0x10e>;
					phandle = <0x8f>;
				};

				mt_pmic_vmch_ldo_reg: ldo_vmch {
					regulator-name = "vmch";
					regulator-min-microvolt = <0x2c4020>;
					regulator-max-microvolt = <0x325aa0>;
					regulator-enable-ramp-delay = <0x3c>;
					phandle = <0x3b>;
				};

				mt_pmic_vbif28_ldo_reg: ldo_vbif28 {
					compatible = "regulator-fixed";
					regulator-name = "vbif28";
					regulator-min-microvolt = <0x2ab980>;
					regulator-max-microvolt = <0x2ab980>;
					regulator-enable-ramp-delay = <0x10e>;
					phandle = <0x90>;
				};

				mt_pmic_vsram_proc12_ldo_reg: ldo_vsram_proc12 {
					regulator-name = "vsram_proc12";
					regulator-min-microvolt = <0x7a120>;
					regulator-max-microvolt = <0x13bdb6>;
					regulator-enable-ramp-delay = <0xf0>;
					phandle = <0x91>;
				};

				mt_pmic_vcama1_ldo_reg: ldo_vcama1 {
					regulator-name = "vcama1";
					regulator-min-microvolt = <0x1b7740>;
					regulator-max-microvolt = <0x2dc6c0>;
					regulator-enable-ramp-delay = <0x10e>;
					phandle = <0x92>;
				};

				mt_pmic_vemc_ldo_reg: ldo_vemc {
					regulator-name = "vemc";
					regulator-min-microvolt = <0x2c4020>;
					regulator-max-microvolt = <0x325aa0>;
					regulator-enable-ramp-delay = <0x3c>;
					phandle = <0x35>;
				};

				mt_pmic_vio28_ldo_reg: ldo_vio28 {
					compatible = "regulator-fixed";
					regulator-name = "vio28";
					regulator-min-microvolt = <0x2ab980>;
					regulator-max-microvolt = <0x2ab980>;
					regulator-enable-ramp-delay = <0x10e>;
					phandle = <0x93>;
				};

				mt_pmic_va12_ldo_reg: ldo_va12 {
					compatible = "regulator-fixed";
					regulator-name = "va12";
					regulator-min-microvolt = <0x124f80>;
					regulator-max-microvolt = <0x124f80>;
					regulator-enable-ramp-delay = <0x10e>;
					phandle = <0x94>;
				};

				mt_pmic_vrf18_ldo_reg: ldo_vrf18 {
					compatible = "regulator-fixed";
					regulator-name = "vrf18";
					regulator-min-microvolt = <0x1b7740>;
					regulator-max-microvolt = <0x1b7740>;
					regulator-enable-ramp-delay = <0x78>;
					phandle = <0x95>;
				};

				mt_pmic_vcn33_bt_ldo_reg: ldo_vcn33_bt {
					regulator-name = "vcn33_bt";
					regulator-min-microvolt = <0x325aa0>;
					regulator-max-microvolt = <0x3567e0>;
					regulator-enable-ramp-delay = <0x10e>;
					phandle = <0x96>;
				};

				mt_pmic_vcn33_wifi_ldo_reg: ldo_vcn33_wifi {
					regulator-name = "vcn33_wifi";
					regulator-min-microvolt = <0x325aa0>;
					regulator-max-microvolt = <0x3567e0>;
					regulator-enable-ramp-delay = <0x10e>;
					phandle = <0x97>;
				};

				mt_pmic_vcama2_ldo_reg: ldo_vcama2 {
					regulator-name = "vcama2";
					regulator-min-microvolt = <0x1b7740>;
					regulator-max-microvolt = <0x2dc6c0>;
					regulator-enable-ramp-delay = <0x10e>;
					phandle = <0x98>;
				};

				mt_pmic_vmc_ldo_reg: ldo_vmc {
					regulator-name = "vmc";
					regulator-min-microvolt = <0x1b7740>;
					regulator-max-microvolt = <0x325aa0>;
					regulator-enable-ramp-delay = <0x3c>;
					phandle = <0x3c>;
				};

				mt_pmic_vldo28_ldo_reg: ldo_vldo28 {
					regulator-name = "vldo28";
					regulator-min-microvolt = <0x2ab980>;
					regulator-max-microvolt = <0x2dc6c0>;
					regulator-enable-ramp-delay = <0x10e>;
					phandle = <0x67>;
				};

				mt_pmic_vaud28_ldo_reg: ldo_vaud28 {
					compatible = "regulator-fixed";
					regulator-name = "vaud28";
					regulator-min-microvolt = <0x2ab980>;
					regulator-max-microvolt = <0x2ab980>;
					regulator-enable-ramp-delay = <0x10e>;
					phandle = <0x99>;
				};

				mt_pmic_vsim2_ldo_reg: ldo_vsim2 {
					regulator-name = "vsim2";
					regulator-min-microvolt = <0x19f0a0>;
					regulator-max-microvolt = <0x2f4d60>;
					regulator-enable-ramp-delay = <0x21c>;
					phandle = <0x9a>;
				};

				mt_pmic_va09_ldo_reg: ldo_va09 {
					compatible = "regulator-fixed";
					regulator-name = "va09";
					regulator-min-microvolt = <0xdbba0>;
					regulator-max-microvolt = <0xdbba0>;
					regulator-enable-ramp-delay = <0x108>;
					regulator-boot-on;
					phandle = <0x9b>;
				};
			};

			mt6358_rtc: mt6358_rtc {
				compatible = "mediatek,mt6358-rtc";
				interrupts = <0x40 0x00>;
				interrupt-names = "rtc";
				base = <0x580>;
				apply-lpsd-solution;
				phandle = <0x9c>;
			};

			mt6358_misc: mt6358_misc {
				compatible = "mediatek,mt6358-misc";
				base = <0x580>;
				apply-lpsd-solution;
				dcxo-switch;
				phandle = <0x9d>;
			};
		};
	};

	pwraph: pwraphal@ {
		compatible = "mediatek,pwraph";
		mediatek,pwrap-regmap = <0x20>;
		phandle = <0x9e>;
	};

	pwrap_mpu@1000d000 {
		compatible = "mediatek,pwrap_mpu";
		reg = <0x00 0x1000d000 0x00 0x1000>;
	};

	pwrap_p2p@1005cb000 {
		compatible = "mediatek,pwrap_p2p";
		reg = <0x00 0x105cb000 0x00 0x1000>;
	};

	pwrap_md32@10448000 {
		compatible = "mediatek,pwrap_md32";
		reg = <0x00 0x10448000 0x00 0x1000>;
	};

	sleep_reg_md@1000f000 {
		compatible = "mediatek,sleep_reg_md";
		reg = <0x00 0x1000f000 0x00 0x1000>;
	};

	keypad: kp@10010000 {
		compatible = "mediatek,kp";
		reg = <0x00 0x10010000 0x00 0x1000>;
		interrupts = <GIC_SPI 73 IRQ_TYPE_EDGE_FALLING>;
		phandle = <0x9f>;
	};

	mrdump_ext_rst: mrdump_ext_rst {
		compatible = "mediatek, mrdump_disable";
		mode = "IRQ";
		status = "okay";
		phandle = <0xa0>;
	};

	topmisc@10011000 {
		compatible = "mediatek,topmisc";
		reg = <0x00 0x10011000 0x00 0x1000>;
	};

	dvfsrc: dvfsrc@10012000 {
		compatible = "mediatek,dvfsrc";
		reg = <0x00 0x10012000 0x00 0x1000 0x00 0x110780 0x00 0x80>;
		phandle = <0xa1>;
	};

	mbist_ao@10013000 {
		compatible = "mediatek,mbist_ao";
		reg = <0x00 0x10013000 0x00 0x1000>;
	};

	apcldmain_ao@10014000 {
		compatible = "mediatek,apcldmain_ao";
		reg = <0x00 0x10014000 0x00 0x400>;
	};

	apcldmaout_ao@10014400 {
		compatible = "mediatek,apcldmaout_ao";
		reg = <0x00 0x10014400 0x00 0x400>;
	};

	apcldmamisc_ao@10014800 {
		compatible = "mediatek,apcldmamisc_ao";
		reg = <0x00 0x10014800 0x00 0x400>;
	};

	apcldmamisc_ao@10014c00 {
		compatible = "mediatek,apcldmamisc_ao";
		reg = <0x00 0x10014c00 0x00 0x400>;
	};

	ddrphy@10015000 {
		compatible = "mediatek,ddrphy";
		reg = <0x00 0x10015000 0x00 0x1000>;
	};

	aes_top0@10016000 {
		compatible = "mediatek,aes_top0";
		reg = <0x00 0x10016000 0x00 0x1000>;
	};

	sys_timer@10017000 {
		compatible = "mediatek,sys_timer";
		reg = <0x00 0x10017000 0x00 0x1000>;
		reg-names = "sys_timer_base";
		interrupts = <GIC_SPI 207 IRQ_TYPE_LEVEL_HIGH>;
		clocks = <&topckgen &mt_pmic_vcamd_ldo_reg>;
	};

	modem_temp_share@10018000 {
		compatible = "mediatek,modem_temp_share";
		reg = <0x00 0x10018000 0x00 0x1000>;
	};

	security_ao@1001a000 {
		compatible = "mediatek,security_ao";
		reg = <0x00 0x1001a000 0x00 0x1000>;
	};

	topckgen_ao@1001b000 {
		compatible = "mediatek,topckgen_ao";
		reg = <0x00 0x1001b000 0x00 0x1000>;
	};

	iocfg_0@10002000 {
		compatible = "mediatek,iocfg_0";
		reg = <0x00 0x10002000 0x00 0x200>;
	};

	iocfg_1@10002200 {
		compatible = "mediatek,iocfg_1";
		reg = <0x00 0x10002200 0x00 0x200>;
	};

	iocfg_2@10002400 {
		compatible = "mediatek,iocfg_2";
		reg = <0x00 0x10002400 0x00 0x200>;
	};

	iocfg_3@10002600 {
		compatible = "mediatek,iocfg_3";
		reg = <0x00 0x10002600 0x00 0x200>;
	};

	iocfg_4@10002800 {
		compatible = "mediatek,iocfg_4";
		reg = <0x00 0x10002800 0x00 0x200>;
	};

	iocfg_5@10002a00 {
		compatible = "mediatek,iocfg_5";
		reg = <0x00 0x10002a00 0x00 0x200>;
	};

	mdcldmain_ao@10015000 {
		compatible = "mediatek,mdcldmain_ao";
		reg = <0x00 0x10015000 0x00 0x400>;
	};

	mdcldmaout_ao@10015400 {
		compatible = "mediatek,mdcldmaout_ao";
		reg = <0x00 0x10015400 0x00 0x400>;
	};

	mdcldmamisc_ao@10015800 {
		compatible = "mediatek,mdcldmamisc_ao";
		reg = <0x00 0x10015800 0x00 0x400>;
	};

	sys_cirq@10204000 {
		compatible = "mediatek,sys_cirq";
		reg = <0x00 0x10204000 0x00 0x1000>;
		mediatek,cirq_num = <0xe8>;
		mediatek,spi_start_offset = <0x40>;
		interrupts = <GIC_SPI 295 IRQ_TYPE_LEVEL_LOW>;
	};

	mcucfg_mp0_counter@0c530000 {
		compatible = "mediatek,mcucfg_mp0_counter";
		reg = <0x00 0xc530000 0x00 0x10000>;
	};

	mcucfg: mcucfg@0c530000 {
		compatible = "mediatek,mcucfg";
		reg = <0x00 0xc530000 0x00 0x10000>;
		phandle = <0xa2>;
	};

	m4u@10205000 {
		cell-index = <0x00>;
		compatible = "mediatek,m4u";
		reg = <0x00 0x10205000 0x00 0x1000>;
		interrupts = <GIC_SPI 174 IRQ_TYPE_LEVEL_LOW>;
	};

	devapc@10207000 {
		compatible = "mediatek,mt6768-devapc";
		reg = <0x00 0x10207000 0x00 0x1000 0x00 0x1000e000 0x00 0x1000 0x00 0x10033000 0x00 0x1000>;
		interrupts = <GIC_SPI 159 IRQ_TYPE_LEVEL_LOW>;
		clocks = <&infracfg_ao &mdp_wdma0>;
		clock-names = "devapc-infra-clock";
	};

	hwrng: hwrng {
		compatible = "mediatek,mt67xx-rng";
		phandle = <0xa3>;
	};

	bus_dbg@10208000 {
		compatible = "mediatek,bus_dbg-v2";
		reg = <0x00 0x10208000 0x00 0x1000 0x00 0x10001000 0x00 0x1000>;
		mediatek,bus_dbg_con_offset = <0x2fc>;
		interrupts = <GIC_SPI 158 IRQ_TYPE_LEVEL_LOW>;
	};

	ap_ccif0@10209000 {
		compatible = "mediatek,ap_ccif0";
		reg = <0x00 0x10209000 0x00 0x1000>;
		interrupts = <GIC_SPI 164 IRQ_TYPE_LEVEL_LOW>;
	};

	md_ccif0@1020a000 {
		compatible = "mediatek,md_ccif0";
		reg = <0x00 0x1020a000 0x00 0x1000>;
	};

	ap_ccif1@1020b000 {
		compatible = "mediatek,ap_ccif1";
		reg = <0x00 0x1020b000 0x00 0x1000>;
		interrupts = <GIC_SPI 166 IRQ_TYPE_LEVEL_LOW>;
	};

	md_ccif1@1020c000 {
		compatible = "mediatek,md_ccif1";
		reg = <0x00 0x1020c000 0x00 0x1000>;
	};

	infra_mbist@1020d000 {
		compatible = "mediatek,infra_mbist";
		reg = <0x00 0x1020d000 0x00 0x1000>;
	};

	infracfg@1020e000 {
		compatible = "mediatek,infracfg";
		reg = <0x00 0x1020e000 0x00 0x1000>;
	};

	trng@1020f000 {
		compatible = "mediatek,trng";
		reg = <0x00 0x1020f000 0x00 0x1000>;
		interrupts = <GIC_SPI 176 IRQ_TYPE_LEVEL_LOW>;
	};

	dxcc_sec@10210000 {
		compatible = "mediatek,dxcc_sec";
		reg = <0x00 0x10210000 0x00 0x1000>;
		interrupts = <GIC_SPI 177 IRQ_TYPE_LEVEL_HIGH>;
	};

	mcupm_sram2@10211000 {
		compatible = "mediatek,mcupm_sram2";
		reg = <0x00 0x10211000 0x00 0x1000>;
	};

	cq_dma@10212000 {
		compatible = "mediatek,mt-cqdma-v1";
		reg = <0x00 0x10212000 0x00 0x80 0x00 0x10212080 0x00 0x80 0x00 0x10212100 0x00 0x80>;
		interrupts = <GIC_SPI 134 IRQ_TYPE_LEVEL_LOW GIC_SPI 135 IRQ_TYPE_LEVEL_LOW GIC_SPI 136 IRQ_TYPE_LEVEL_LOW>;
		nr_channel = <0x03>;
		clocks = <&infracfg_ao &aud_dat_mosi_off>;
		clock-names = "cqdma";
	};

	mcupm_sram3@10213000 {
		compatible = "mediatek,mcupm_sram3";
		reg = <0x00 0x10213000 0x00 0x1000>;
	};

	sramrom@10214000 {
		compatible = "mediatek,sramrom";
		reg = <0x00 0x10214000 0x00 0x1000>;
	};

	mcupm_reg@10216000 {
		compatible = "mediatek,mcupm_reg";
		reg = <0x00 0x10216000 0x00 0x1000>;
	};

	mcupm_sram0@10217000 {
		compatible = "mediatek,mcupm_sram0";
		reg = <0x00 0x10217000 0x00 0x1000>;
	};

	mcupm_sram1@10218000 {
		compatible = "mediatek,mcupm_sram1";
		reg = <0x00 0x10218000 0x00 0x1000>;
	};

	emi@10219000 {
		compatible = "mediatek,emi";
		reg = <0x00 0x10219000 0x00 0x1000 0x00 0x10226000 0x00 0x1000 0x00 0x1022d000 0x00 0x1000 0x00 0x10235000 0x00 0x1000 0x00 0x1020e000 0x00 0x1000>;
		interrupts = <GIC_SPI 161 IRQ_TYPE_LEVEL_LOW>;
	};

	chn_emi@1021a000 {
		compatible = "mediatek,chn_emi";
		reg = <0x00 0x1021a000 0x00 0x1000>;
	};

	apcldmain@1021b000 {
		compatible = "mediatek,apcldmain";
		reg = <0x00 0x1021b000 0x00 0x100>;
	};

	apcldmain@1021b100 {
		compatible = "mediatek,apcldmain";
		reg = <0x00 0x1021b100 0x00 0x100>;
	};

	apcldmaout@1021b400 {
		compatible = "mediatek,apcldmaout";
		reg = <0x00 0x1021b400 0x00 0x100>;
	};

	apcldmaout@1021b500 {
		compatible = "mediatek,apcldmaout";
		reg = <0x00 0x1021b500 0x00 0x100>;
	};

	apcldmamisc@1021b800 {
		compatible = "mediatek,apcldmamisc";
		reg = <0x00 0x1021b800 0x00 0x100>;
		interrupts = <GIC_SPI 180 IRQ_TYPE_LEVEL_HIGH>;
	};

	apcldmamisc@1021b900 {
		compatible = "mediatek,apcldmamisc";
		reg = <0x00 0x1021b900 0x00 0x400>;
	};

	mdcldmain@1021c000 {
		compatible = "mediatek,mdcldmain";
		reg = <0x00 0x1021c000 0x00 0x400>;
	};

	mdcldmaout@1021c400 {
		compatible = "mediatek,mdcldmaout";
		reg = <0x00 0x1021c400 0x00 0x400>;
	};

	mdcldmamisc@1021c000 {
		compatible = "mediatek,mdcldmamisc";
		reg = <0x00 0x1021c000 0x00 0x1000>;
	};

	mdcldmamisc@1021c900 {
		compatible = "mediatek,mdcldmamisc";
		reg = <0x00 0x1021c900 0x00 0x400>;
	};

	mdcldma: mdcldma@10014000 {
		compatible = "mediatek,mdcldma";
		reg = <0x00 0x10014000 0x00 0x1000 0x00 0x1021b000 0x00 0x1000 0x00 0x10209000 0x00 0x1000 0x00 0x1020a000 0x00 0x1000>;
		interrupts = <GIC_SPI 180 IRQ_TYPE_LEVEL_HIGH GIC_SPI 164 IRQ_TYPE_LEVEL_LOW GIC_SPI 165 IRQ_TYPE_LEVEL_LOW GIC_SPI 75 IRQ_TYPE_EDGE_FALLING>;
		mediatek,md_id = <0x00>;
		mediatek,cldma_capability = <0x06>;
		clocks = <&scpsys 0x00 &infracfg_ao &msdc0_pins_hs400 &infracfg_ao &mdp_wrot0 &infracfg_ao &mdp_ccorr &infracfg_ao &auxadc &infracfg_ao &mmsys_config &infracfg_ao &vow_clk_miso_off &infracfg_ao &vow_clk_miso_on>;
		clock-names = "scp-sys-md1-main\0infra-cldma-bclk\0infra-ccif-ap\0infra-ccif-md\0infra-ccif1-ap\0infra-ccif1-md\0infra-ccif2-ap\0infra-ccif2-md";
		phandle = <0xa4>;
	};

	md_auxadc: md_auxadc {
		compatible = "mediatek,md_auxadc";
		io-channels = <&auxadc &STANDBY>;
		io-channel-names = "md-channel";
		phandle = <0xa5>;
	};

	bpi_bsi_slv0@1021e000 {
		compatible = "mediatek,bpi_bsi_slv0";
		reg = <0x00 0x1021e000 0x00 0x1000>;
	};

	bpi_bsi_slv1@1021f000 {
		compatible = "mediatek,bpi_bsi_slv1";
		reg = <0x00 0x1021f000 0x00 0x6000>;
	};

	bpi_bsi_slv2@10225000 {
		compatible = "mediatek,bpi_bsi_slv2";
		reg = <0x00 0x10225000 0x00 0x1000>;
	};

	emi_mpu@10226000 {
		compatible = "mediatek,emi_mpu";
		reg = <0x00 0x10226000 0x00 0x1000>;
	};

	dvfsp@10227000 {
		compatible = "mediatek,dvfsp";
		reg = <0x00 0x10227000 0x00 0x1000>;
	};

	dvfsp: dvfsp@00110800 {
		compatible = "mediatek,mt6768-dvfsp";
		reg = <0x00 0x110800 0x00 0x1400 0x00 0x110800 0x00 0x1400>;
		state = <0x01>;
		change_flag = <0x00>;
		little-rise-time = <0x3e8>;
		little-down-time = <0x2ee>;
		big-rise-time = <0x3e8>;
		big-down-time = <0x2ee>;
		L-table = <0x6a4 0x38 0x02 0x01 0x659 0x35 0x02 0x01 0x5dc 0x30 0x02 0x01 0x5aa 0x2e 0x02 0x01 0x55f 0x2b 0x02 0x01 0x52d 0x29 0x02 0x01 0x4fb 0x27 0x02 0x01 0x497 0x22 0x02 0x01 0x44c 0x29 0x02 0x01 0x41a 0x1d 0x02 0x01 0x3e7 0x1b 0x02 0x01 0x3b6 0x19 0x02 0x01 0x384 0x17 0x02 0x01 0x352 0x15 0x04 0x01 0x306 0x13 0x04 0x01 0x1f4 0x10 0x04 0x01>;
		B-table = <0x7d0 0x48 0x01 0x01 0x79e 0x45 0x01 0x01 0x76c 0x41 0x01 0x01 0x73a 0x3d 0x01 0x01 0x708 0x3a 0x01 0x01 0x6ae 0x36 0x01 0x01 0x655 0x32 0x01 0x01 0x60c 0x30 0x02 0x01 0x5a3 0x2b 0x02 0x01 0x54a 0x27 0x02 0x01 0x4f1 0x24 0x02 0x01 0x498 0x20 0x02 0x01 0x43f 0x1d 0x02 0x01 0x3e6 0x19 0x02 0x01 0x38d 0x16 0x02 0x01 0x352 0x13 0x02 0x01>;
		CCI-table = <0x4a3 0x38 0x02 0x01 0x460 0x34 0x02 0x01 0x419 0x30 0x02 0x01 0x3f6 0x2e 0x02 0x01 0x3c1 0x2b 0x02 0x01 0x38d 0x28 0x02 0x01 0x358 0x24 0x02 0x01 0x335 0x22 0x02 0x01 0x300 0x1f 0x02 0x01 0x2dd 0x1d 0x04 0x01 0x2ba 0x1b 0x04 0x01 0x297 0x19 0x04 0x01 0x274 0x17 0x04 0x01 0x251 0x15 0x04 0x01 0x3a 0x13 0x04 0x01 0x1f4 0x10 0x04 0x01>;
		phandle = <0xa6>;
	};

	mt_cpufreq: mt_cpufreq {
		compatible = "mediatek,mt-cpufreq";
		phandle = <0xa7>;
	};

	dramc@1022a000 {
		compatible = "mediatek,dramc";
		reg = <0x00 0x1022a000 0x00 0x2000 0x00 0x10232000 0x00 0x2000 0x00 0x1022c000 0x00 0x1000 0x00 0x10234000 0x00 0x1000 0x00 0x10228000 0x00 0x2000 0x00 0x10230000 0x00 0x2000 0x00 0x1022e000 0x00 0x1000 0x00 0x10236000 0x00 0x1000>;
	};

	gce: gce@10238000 {
		compatible = "mediatek,gce\0syscon";
		reg = <0x00 0x10238000 0x00 0x4000>;
		#clock-cells = <0x01>;
		interrupts = <GIC_SPI 170 IRQ_TYPE_LEVEL_LOW>;
		disp_mutex_reg = <0x14016000 0x1000>;
		g3d_config_base = <0x13000000 0x00 0xffff0000>;
		mmsys_config_base = <0x14000000 0x01 0xffff0000>;
		disp_dither_base = <0x14010000 0x02 0xffff0000>;
		mm_na_base = <0x14020000 0x03 0xffff0000>;
		imgsys_base = <0x15020000 0x04 0xffff0000>;
		vdec_gcon_base = <0x18800000 0x05 0xffff0000>;
		venc_gcon_base = <0x18810000 0x06 0xffff0000>;
		conn_peri_base = <0x18820000 0x07 0xffff0000>;
		topckgen_base = <0x18830000 0x08 0xffff0000>;
		kp_base = <0x18840000 0x09 0xffff0000>;
		scp_sram_base = <0x10000000 0x0a 0xffff0000>;
		infra_na3_base = <0x10010000 0x0b 0xffff0000>;
		infra_na4_base = <0x10020000 0x0c 0xffff0000>;
		scp_base = <0x10030000 0x0d 0xffff0000>;
		mcucfg_base = <0x10040000 0x0e 0xffff0000>;
		gcpu_base = <0x10050000 0x0f 0xffff0000>;
		usb0_base = <0x10200000 0x10 0xffff0000>;
		usb_sif_base = <0x10280000 0x11 0xffff0000>;
		audio_base = <0x17000000 0x12 0xffff0000>;
		vdec_base = <0x17010000 0x13 0xffff0000>;
		msdc2_base = <0x17020000 0x14 0xffff0000>;
		vdec1_base = <0x17030000 0x15 0xffff0000>;
		msdc3_base = <0x18000000 0x16 0xffff0000>;
		ap_dma_base = <0x18010000 0x17 0xffff0000>;
		gce_base = <0x18020000 0x18 0xffff0000>;
		vdec2_base = <0x18040000 0x19 0xffff0000>;
		vdec3_base = <0x18050000 0x1a 0xffff0000>;
		camsys_base = <0x18080000 0x1b 0xffff0000>;
		camsys1_base = <0x180a0000 0x1c 0xffff0000>;
		camsys2_base = <0x180b0000 0x1d 0xffff0000>;
		pwm_sw_base = <0x1100e000 0x63 0xffff0000>;
		mdp_rdma0_sof = <0x00>;
		mdp_ccorr0_sof = <0x01>;
		mdp_rsz0_sof = <0x02>;
		mdp_rsz1_sof = <0x03>;
		mdp_wdma_sof = <0x04>;
		mdp_wrot0_sof = <0x05>;
		mdp_tdshp0_sof = <0x06>;
		disp_ovl0_sof = <0x07>;
		disp_2l_ovl0_sof = <0x08>;
		disp_rdma0_sof = <0x09>;
		disp_wdma0_sof = <0x0a>;
		disp_color0_sof = <0x0b>;
		disp_ccorr0_sof = <0x0c>;
		disp_aal0_sof = <0x0d>;
		disp_gamma0_sof = <0x0e>;
		disp_dither0_sof = <0x0f>;
		disp_dsi0_sof = <0x10>;
		disp_rsz0_sof = <0x11>;
		img_dl_relay_sof = <0x12>;
		disp_pwm0_sof = <0x13>;
		mdp_rdma0_frame_done = <0x14>;
		mdp_ccorr0_frame_done = <0x15>;
		mdp_rsz0_frame_done = <0x16>;
		mdp_rsz1_frame_done = <0x17>;
		mdp_wrot0_write_frame_done = <0x18>;
		mdp_wdma_frame_done = <0x19>;
		mdp_tdshp0_frame_done = <0x1a>;
		disp_ovl0_frame_done = <0x1b>;
		disp_2l_ovl0_frame_done = <0x1c>;
		disp_rsz0_frame_done = <0x1d>;
		disp_rdma0_frame_done = <0x1e>;
		disp_wdma0_frame_done = <0x1f>;
		disp_color0_frame_done = <0x20>;
		disp_ccorr0_frame_done = <0x21>;
		disp_aal0_frame_done = <0x22>;
		disp_gamma0_frame_done = <0x23>;
		disp_dither0_frame_done = <0x24>;
		disp_dsi0_frame_done = <0x25>;
		stream_done_0 = <0x82>;
		stream_done_1 = <0x83>;
		stream_done_2 = <0x84>;
		stream_done_3 = <0x85>;
		stream_done_4 = <0x86>;
		stream_done_5 = <0x87>;
		stream_done_6 = <0x88>;
		stream_done_7 = <0x89>;
		stream_done_8 = <0x8a>;
		stream_done_9 = <0x8b>;
		buf_underrun_event_0 = <0x8c>;
		dsi0_te_event = <0x8d>;
		dsi0_irq_event = <0x8e>;
		dsi0_done_event = <0x8f>;
		disp_wdma0_rst_done = <0x93>;
		mdp_wdma_rst_done = <0x94>;
		mdp_wrot0_rst_done = <0x95>;
		mdp_rdma0_rst_done = <0x97>;
		disp_ovl0_frame_rst_done_pusle = <0x98>;
		dip_cq_thread0_frame_done = <0x101>;
		dip_cq_thread1_frame_done = <0x102>;
		dip_cq_thread2_frame_done = <0x103>;
		dip_cq_thread3_frame_done = <0x104>;
		dip_cq_thread4_frame_done = <0x105>;
		dip_cq_thread5_frame_done = <0x106>;
		dip_cq_thread6_frame_done = <0x107>;
		dip_cq_thread7_frame_done = <0x108>;
		dip_cq_thread8_frame_done = <0x109>;
		dip_cq_thread9_frame_done = <0x10a>;
		dip_cq_thread10_frame_done = <0x10b>;
		dip_cq_thread11_frame_done = <0x10c>;
		dip_cq_thread12_frame_done = <0x10d>;
		dip_cq_thread13_frame_done = <0x10e>;
		dip_cq_thread14_frame_done = <0x10f>;
		dip_cq_thread15_frame_done = <0x110>;
		dip_cq_thread16_frame_done = <0x111>;
		dip_cq_thread17_frame_done = <0x112>;
		dip_cq_thread18_frame_done = <0x113>;
		dve_frame_done = <0x114>;
		wmf_frame_done = <0x115>;
		rsc_frame_done = <0x116>;
		venc_frame_done = <0x121>;
		venc_pause_done = <0x122>;
		jpgenc_done = <0x123>;
		venc_mb_done = <0x124>;
		venc_128byte_cnt_done = <0x125>;
		isp_frame_done_b = <0x142>;
		camsv_0_pass1_done = <0x143>;
		camsv_1_pass1_done = <0x144>;
		camsv_2_pass1_done = <0x145>;
		tsf_done = <0x146>;
		seninf_0_fifo_full = <0x147>;
		seninf_1_fifo_full = <0x148>;
		seninf_2_fifo_full = <0x149>;
		seninf_3_fifo_full = <0x14a>;
		seninf_4_fifo_full = <0x14b>;
		seninf_5_fifo_full = <0x14c>;
		seninf_6_fifo_full = <0x14d>;
		seninf_7_fifo_full = <0x14e>;
		dsi0_te_from_infra = <0x382>;
		mmsys_config = <&mmsys_config>;
		mdp_rdma0 = <0x25>;
		mdp_rsz0 = <0x26>;
		mdp_rsz1 = <0x27>;
		mdp_wdma0 = <0x28>;
		mdp_wrot0 = <0x29>;
		mdp_tdshp0 = <0x2a>;
		mdp_color0 = <0x2b>;
		mdp_ccorr0 = <0x2c>;
		mm_mutex = <0x2d>;
		sram_share_cnt = <0x01>;
		sram_share_engine = <0x0d>;
		sram_share_event = <0x2c6>;
		mediatek,mailbox-gce = <0x2e>;
		secure_thread = <0x06 0x08>;
		mboxes = <&gce_mbox 0x00 0x00 &MCDI_CLUSTER &gce_mbox &STANDBY 0x00 &idledram &gce_mbox &MCDI_CPU 0x00 &MCDI_CLUSTER &gce_mbox &MCDI_CLUSTER 0x00 &MCDI_CLUSTER &gce_mbox &idlesyspll 0x00 &MCDI_CPU &gce_mbox &idlebus26m 0xffffffff &STANDBY &gce_mbox_svp &SUSPEND 0x00 &MCDI_CLUSTER &gce_mbox_svp &cpu0 0x00 &MCDI_CLUSTER &gce_mbox_svp &cpu1 0x00 &sysirq &gce_mbox &cpu2 0x00 &sysirq &gce_mbox &cpu3 0x00 &sysirq &gce_mbox &cpu4 0x00 &sysirq &gce_mbox &cpu5 0x00 &sysirq &gce_mbox &cpu6 0xffffffff &sysirq>;
		clocks = <&infracfg_ao &cpu0 &infracfg_ao &io_cfg_bl &scpsys &MCDI_CPU>;
		clock-names = "GCE\0GCE_TIMER\0MMSYS_MTCMOS";
		phandle = <0xa8>;
	};

	gce_mbox: gce_mbox@10238000 {
		compatible = "mediatek,mt6768-gce";
		reg = <0x00 0x10238000 0x00 0x4000>;
		interrupts = <GIC_SPI 170 IRQ_TYPE_LEVEL_LOW>;
		default_tokens = [02 bc 02 bd 02 be 02 bf 02 c0 02 c6 02 c7];
		clocks = <&infracfg_ao &cpu0 &infracfg_ao &io_cfg_bl>;
		clock-names = "gce\0gce-timer";
		#mbox-cells = <0x03>;
		#gce-event-cells = <0x01>;
		#gce-subsys-cells = <0x02>;
		phandle = <0x2e>;
	};

	gce_mbox_svp: gce_mbox_svp@10238000 {
		compatible = "mediatek,mailbox-gce-svp";
		reg = <0x00 0x10238000 0x00 0x4000>;
		interrupts = <GIC_SPI 170 IRQ_TYPE_LEVEL_LOW GIC_SPI 171 IRQ_TYPE_LEVEL_LOW>;
		#mbox-cells = <0x03>;
		clocks = <&infracfg_ao &cpu0 &infracfg_ao &io_cfg_bl>;
		clock-names = "gce\0gce-timer";
		phandle = <0x2f>;
	};

	ap_ccif2@1023c000 {
		compatible = "mediatek,ap_ccif2";
		reg = <0x00 0x1023c000 0x00 0x1000>;
		interrupts = <GIC_SPI 160 IRQ_TYPE_LEVEL_LOW>;
	};

	md_ccif2@1023d000 {
		compatible = "mediatek,md_ccif2";
		reg = <0x00 0x1023d000 0x00 0x1000>;
	};

	ap_ccif3@1023e000 {
		compatible = "mediatek,ap_ccif3";
		reg = <0x00 0x1023e000 0x00 0x1000>;
		interrupts = <GIC_SPI 163 IRQ_TYPE_LEVEL_LOW>;
	};

	goodix_fp: fingerprint {
		compatible = "mediatek,goodix-fp";
		phandle = <0xa9>;
	};

	accdet: accdet {
		compatible = "mediatek,pmic-accdet";
		phandle = <0xaa>;
	};

	mt6358_gauge {
		compatible = "mediatek,mt6358_gauge";
		gauge_name = "gauge";
		alias_name = "MT6358";
	};

	gauge_timer {
		compatible = "mediatek,gauge_timer_service";
	};

	bat_gm30: battery {
		compatible = "mediatek,bat_gm30";
		DIFFERENCE_FULLOCV_ITH = <0xc8>;
		SHUTDOWN_1_TIME = <0x1e>;
		KEEP_100_PERCENT = <0x01>;
		R_FG_VALUE = <0x0a>;
		EMBEDDED_SEL = <0x01>;
		PMIC_SHUTDOWN_CURRENT = <0x14>;
		FG_METER_RESISTANCE = <0x64>;
		CAR_TUNE_VALUE = <0x64>;
		PMIC_MIN_VOL = <0x82dc>;
		POWERON_SYSTEM_IBOOT = <0x1f4>;
		SHUTDOWN_GAUGE0_VOLTAGE = <0x84d0>;
		TEMPERATURE_T0 = <0x32>;
		TEMPERATURE_T1 = <0x19>;
		TEMPERATURE_T2 = <0x0a>;
		TEMPERATURE_T3 = <0x00>;
		TEMPERATURE_T4 = <0xfffffffa>;
		TEMPERATURE_T5 = <0xfffffff6>;
		g_FG_PSEUDO100_T0 = <0x64>;
		g_FG_PSEUDO100_T1 = <0x64>;
		g_FG_PSEUDO100_T2 = <0x64>;
		g_FG_PSEUDO100_T3 = <0x64>;
		g_FG_PSEUDO100_T4 = <0x64>;
		Q_MAX_SYS_VOLTAGE_BAT0 = <0xd16>;
		Q_MAX_SYS_VOLTAGE_BAT1 = <0xd16>;
		Q_MAX_SYS_VOLTAGE_BAT2 = <0xd16>;
		Q_MAX_SYS_VOLTAGE_BAT3 = <0xd16>;
		COM_FG_METER_RESISTANCE = <0x64>;
		COM_R_FG_VALUE = <0x00>;
		enable_tmp_intr_suspend = <0x00>;
		ACTIVE_TABLE = <0x06>;
		MULTI_TEMP_GAUGE0 = <0x01>;
		g_PMIC_MIN_VOL = <0x8660 0x82dc 0x88b8 0x82dc 0x8660 0x80e8 0x88b8 0x80e8 0x8598 0x82dc 0x86c4 0x82dc 0x7ef4 0x7dc8 0x7ef4 0x7dc8 0x7c9c 0x7c9c 0x7c9c 0x7c9c 0x7b0c 0x7b0c 0x7b0c 0x7b0c 0x7918 0x7918 0x7918 0x7918 0x7918 0x7918 0x7918 0x7918 0x7918 0x7918 0x7918 0x7918 0x7918 0x7918 0x7918 0x79e0>;
		SHUTDOWN_GAUGE1_VBAT_EN = <0x01>;
		UI_LOW_LIMIT_SOC0 = <0xc8>;
		UI_LOW_LIMIT_VTH0 = <0x87f0>;
		UI_LOW_LIMIT_SOC1 = <0xc8>;
		UI_LOW_LIMIT_VTH1 = <0x87f0>;
		UI_LOW_LIMIT_SOC2 = <0xc8>;
		UI_LOW_LIMIT_VTH2 = <0x87f0>;
		UI_LOW_LIMIT_SOC3 = <0xc8>;
		UI_LOW_LIMIT_VTH3 = <0x87f0>;
		UI_LOW_LIMIT_SOC4 = <0xc8>;
		UI_LOW_LIMIT_VTH4 = <0x87f0>;
		io-channels = <&auxadc &MCDI_CPU>;
		io-channel-names = "batteryID-channel";
		tran_Q_diff = <0x1b58 0x1b58 0x1b58 0x1b58>;
		battery3_profile_t0_num = <0x64>;
		battery3_profile_t0 = <0x00 0xac69 0x38e 0x2cf 0xaba0 0x390 0x59d 0xaaf6 0x397 0x86c 0xaa5f 0x38e 0xb3a 0xa9d8 0x38e 0xe09 0xa957 0x38e 0x10d8 0xa8dc 0x38e 0x13a6 0xa85d 0x38e 0x1675 0xa7df 0x393 0x1943 0xa761 0x393 0x1c12 0xa6e2 0x391 0x1ee1 0xa662 0x38c 0x21af 0xa5e2 0x394 0x247e 0xa563 0x398 0x274c 0xa4e3 0x39d 0x2a1b 0xa465 0x39d 0x2cea 0xa3e8 0x39d 0x2fb8 0xa36b 0x3a2 0x3287 0xa2ef 0x3a6 0x3556 0xa274 0x3a9 0x3824 0xa1fa 0x3a2 0x3af3 0xa182 0x3a2 0x3dc1 0xa10c 0x3a8 0x4090 0xa095 0x3a7 0x435f 0xa022 0x3a2 0x462d 0x9fb7 0x3b3 0x48fc 0x9f48 0x3b0 0x4bca 0x9eda 0x3b3 0x4e99 0x9e6f 0x3b6 0x5168 0x9e07 0x3bc 0x5436 0x9da1 0x3c0 0x5705 0x9d3c 0x3c7 0x59d3 0x9cdd 0x3ca 0x5ca2 0x9c7f 0x3d6 0x5f71 0x9c1f 0x3dd 0x623f 0x9bc5 0x3d5 0x650e 0x9b6d 0x3dc 0x67dc 0x9b17 0x3e9 0x6aab 0x9ac5 0x3fc 0x6d7a 0x9a71 0x3fc 0x7048 0x9a24 0x414 0x7317 0x99d4 0x422 0x75e5 0x997a 0x42c 0x78b4 0x9907 0x416 0x7b83 0x9870 0x3de 0x7e51 0x97e8 0x3ae 0x8120 0x9783 0x398 0x83ee 0x973a 0x3a2 0x86bd 0x96f8 0x39a 0x898c 0x96b7 0x38e 0x8c5a 0x967e 0x392 0x8f29 0x9646 0x398 0x91f8 0x9613 0x39e 0x94c6 0x95e0 0x39d 0x9795 0x95af 0x398 0x9a63 0x9580 0x38f 0x9d32 0x9555 0x39b 0xa001 0x952d 0x3aa 0xa2cf 0x9503 0x3a6 0xa59e 0x94db 0x3a2 0xa86c 0x94b8 0x3ac 0xab3b 0x9497 0x3ac 0xae0a 0x9477 0x3b5 0xb0d8 0x9458 0x3c2 0xb3a7 0x943b 0x3c9 0xb675 0x9420 0x3ca 0xb944 0x9405 0x3cd 0xbc13 0x93ea 0x3d5 0xbee1 0x93d2 0x3dc 0xc1b0 0x93b6 0x3de 0xc47e 0x937d 0x3ca 0xc74d 0x932f 0x3a6 0xca1c 0x92e5 0x392 0xccea 0x92b7 0x3a8 0xcfb9 0x928d 0x3ad 0xd287 0x9260 0x3b3 0xd556 0x9234 0x3ac 0xd825 0x920a 0x3a6 0xdaf3 0x91e8 0x3b0 0xddc2 0x91c6 0x3b6 0xe090 0x919f 0x3ba 0xe35f 0x9174 0x3c0 0xe62e 0x9139 0x3ba 0xe8fc 0x90f9 0x3b6 0xebcb 0x90bb 0x3c0 0xee9a 0x9074 0x3c5 0xf168 0x9024 0x3ae 0xf437 0x8fe9 0x396 0xf705 0x8fd8 0x3a4 0xf9d4 0x8fcb 0x3b9 0xfca3 0x8fba 0x3db 0xff71 0x8fa6 0x402 0x10240 0x8f7f 0x42d 0x1050e 0x8ed4 0x422 0x107dd 0x8d79 0x3f7 0x10aac 0x8b65 0x418 0x10d7a 0x889c 0x443 0x1123d 0x8526 0x49c 0x1137b 0x8526 0x49c 0x11443 0x8526 0x49c>;
		battery3_profile_t1_num = <0x64>;
		battery3_profile_t1 = <0x00 0xad3c 0x406 0x2cf 0xac53 0x402 0x59d 0xab98 0x3f3 0x86c 0xaaff 0x3e2 0xb3a 0xaa7a 0x3d8 0xe09 0xa9fd 0x3dd 0x10d8 0xa983 0x3d6 0x13a6 0xa908 0x3d4 0x1675 0xa88e 0x3db 0x1943 0xa80f 0x3d5 0x1c12 0xa792 0x3d4 0x1ee1 0xa713 0x3d4 0x21af 0xa692 0x3ca 0x247e 0xa612 0x3ca 0x274c 0xa591 0x3d4 0x2a1b 0xa512 0x3d4 0x2cea 0xa492 0x3cb 0x2fb8 0xa415 0x3d6 0x3287 0xa39b 0x3dd 0x3556 0xa31d 0x3d7 0x3824 0xa2a4 0x3de 0x3af3 0xa229 0x3dd 0x3dc1 0xa1af 0x3d7 0x4090 0xa139 0x3de 0x435f 0xa0c6 0x3ea 0x462d 0xa052 0x3f1 0x48fc 0x9fdf 0x3f2 0x4bca 0x9f6e 0x3f2 0x4e99 0x9f02 0x3fc 0x5168 0x9e97 0x402 0x5436 0x9e2f 0x410 0x5705 0x9dc5 0x408 0x59d3 0x9d5c 0x40f 0x5ca2 0x9cfc 0x41d 0x5f71 0x9c9c 0x42c 0x623f 0x9c41 0x438 0x650e 0x9be6 0x43e 0x67dc 0x9b90 0x44c 0x6aab 0x9b3a 0x456 0x6d7a 0x9ae9 0x473 0x7048 0x9a93 0x475 0x7317 0x9a41 0x48c 0x75e5 0x99ed 0x497 0x78b4 0x9990 0x49f 0x7b83 0x9927 0x490 0x7e51 0x98a5 0x460 0x8120 0x9819 0x411 0x83ee 0x97a2 0x3d6 0x86bd 0x974e 0x3c2 0x898c 0x9702 0x3b6 0x8c5a 0x96c2 0x3b6 0x8f29 0x9684 0x3b6 0x91f8 0x964f 0x3b6 0x94c6 0x961b 0x3b6 0x9795 0x95e7 0x3b6 0x9a63 0x95b7 0x3b2 0x9d32 0x958c 0x3af 0xa001 0x9562 0x3b6 0xa2cf 0x9536 0x3b6 0xa59e 0x9513 0x3bc 0xa86c 0x94f1 0x3cb 0xab3b 0x94cf 0x3d9 0xae0a 0x94ae 0x3de 0xb0d8 0x948e 0x3de 0xb3a7 0x9470 0x3de 0xb675 0x9455 0x3ea 0xb944 0x943c 0x3f9 0xbc13 0x9426 0x3fc 0xbee1 0x940f 0x401 0xc1b0 0x93f9 0x406 0xc47e 0x93e2 0x406 0xc74d 0x93ca 0x3fe 0xca1c 0x93ae 0x3f7 0xccea 0x9388 0x3da 0xcfb9 0x9362 0x3d4 0xd287 0x933b 0x3ce 0xd556 0x9315 0x3c5 0xd825 0x92f0 0x3c4 0xdaf3 0x92c9 0x3ca 0xddc2 0x92a5 0x3d1 0xe090 0x9282 0x3d4 0xe35f 0x9261 0x3d5 0xe62e 0x923b 0x3dc 0xe8fc 0x920a 0x3df 0xebcb 0x91c9 0x3e3 0xee9a 0x9184 0x3d5 0xf168 0x9148 0x3db 0xf437 0x9106 0x3de 0xf705 0x90b1 0x3dc 0xf9d4 0x9077 0x3cd 0xfca3 0x905f 0x3df 0xff71 0x9050 0x3ed 0x10240 0x903f 0x3fc 0x1050e 0x9025 0x414 0x107dd 0x9004 0x446 0x10aac 0x8f78 0x453 0x10d7a 0x8e14 0x445 0x1123d 0x8c09 0x473 0x1137b 0x88c7 0x538 0x11443 0x849e 0x690>;
		battery3_profile_t2_num = <0x64>;
		battery3_profile_t2 = <0x00 0xace8 0x668 0x2cf 0xac03 0x661 0x59d 0xab45 0x655 0x86c 0xaab7 0x647 0xb3a 0xaa36 0x639 0xe09 0xa9bf 0x634 0x10d8 0xa945 0x626 0x13a6 0xa8cc 0x618 0x1675 0xa850 0x604 0x1943 0xa7d3 0x5ff 0x1c12 0xa756 0x600 0x1ee1 0xa6d7 0x5f2 0x21af 0xa655 0x5e4 0x247e 0xa5d3 0x5dc 0x274c 0xa554 0x5dc 0x2a1b 0xa4d5 0x5dc 0x2cea 0xa455 0x5d7 0x2fb8 0xa3d5 0x5d2 0x3287 0xa359 0x5d2 0x3556 0xa2db 0x5cf 0x3824 0xa25f 0x5cf 0x3af3 0xa1e5 0x5d2 0x3dc1 0xa16d 0x5d8 0x4090 0xa0f3 0x5c8 0x435f 0xa080 0x5da 0x462d 0xa00c 0x5d3 0x48fc 0x9fa0 0x5ee 0x4bca 0x9f31 0x5e7 0x4e99 0x9ec5 0x5e9 0x5168 0x9e5b 0x5fe 0x5436 0x9def 0x622 0x5705 0x9d84 0x622 0x59d3 0x9d17 0x622 0x5ca2 0x9cb9 0x634 0x5f71 0x9c59 0x62d 0x623f 0x9c00 0x62e 0x650e 0x9ba9 0x63d 0x67dc 0x9b53 0x64b 0x6aab 0x9afe 0x659 0x6d7a 0x9aa7 0x668 0x7048 0x9a4d 0x66c 0x7317 0x99f1 0x676 0x75e5 0x9992 0x674 0x78b4 0x9920 0x649 0x7b83 0x98ac 0x61a 0x7e51 0x982f 0x5c9 0x8120 0x97c0 0x59b 0x83ee 0x975b 0x579 0x86bd 0x9707 0x56e 0x898c 0x96bb 0x55a 0x8c5a 0x9676 0x557 0x8f29 0x9639 0x559 0x91f8 0x9601 0x552 0x94c6 0x95cb 0x550 0x9795 0x95a3 0x557 0x9a63 0x9575 0x55a 0x9d32 0x954b 0x561 0xa001 0x951f 0x564 0xa2cf 0x94f7 0x565 0xa59e 0x94d2 0x56c 0xa86c 0x94ae 0x579 0xab3b 0x948c 0x580 0xae0a 0x946d 0x58c 0xb0d8 0x944e 0x598 0xb3a7 0x9431 0x59f 0xb675 0x9413 0x596 0xb944 0x93f8 0x596 0xbc13 0x93de 0x5a1 0xbee1 0x93c9 0x5ad 0xc1b0 0x93b5 0x5b4 0xc47e 0x93a6 0x5be 0xc74d 0x9397 0x5c2 0xca1c 0x9389 0x5c8 0xccea 0x937e 0x5d7 0xcfb9 0x936c 0x5d0 0xd287 0x9355 0x5c8 0xd556 0x9337 0x5be 0xd825 0x930f 0x5be 0xdaf3 0x92e4 0x5be 0xddc2 0x92ba 0x5c5 0xe090 0x9298 0x5da 0xe35f 0x926b 0x5e1 0xe62e 0x923e 0x5fe 0xe8fc 0x9204 0x60f 0xebcb 0x91bd 0x616 0xee9a 0x917b 0x63f 0xf168 0x913c 0x65c 0xf437 0x90f0 0x679 0xf705 0x9095 0x699 0xf9d4 0x905c 0x6ce 0xfca3 0x9035 0x713 0xff71 0x9012 0x78c 0x10240 0x8fe9 0x825 0x1050e 0x8fad 0x984 0x107dd 0x8f2e 0xd4f 0x10aac 0x8e59 0x14b0 0x10d7a 0x8951 0x1dda 0x1123d 0x824b 0x20ee 0x1137b 0x824b 0x20ee 0x11443 0x824b 0x20ee>;
		battery3_profile_t3_num = <0x64>;
		battery3_profile_t3 = <0x00 0xad0a 0xbae 0x2cf 0xac0c 0xbb5 0x59d 0xab42 0xba7 0x86c 0xaab0 0xb8a 0xb3a 0xaa2d 0xb6d 0xe09 0xa9ac 0xb3a 0x10d8 0xa930 0xb16 0x13a6 0xa8b6 0xaf8 0x1675 0xa83d 0xad2 0x1943 0xa7c2 0xab5 0x1c12 0xa743 0xa92 0x1ee1 0xa6c6 0xa72 0x21af 0xa647 0xa5b 0x247e 0xa5c7 0xa42 0x274c 0xa549 0xa26 0x2a1b 0xa4ca 0xa11 0x2cea 0xa450 0x9f6 0x2fb8 0xa3d0 0x9de 0x3287 0xa354 0x9d4 0x3556 0xa2da 0x9cb 0x3824 0xa260 0x9bd 0x3af3 0xa1e9 0x9c0 0x3dc1 0xa173 0x9c7 0x4090 0xa0fd 0x9cd 0x435f 0xa086 0x9bf 0x462d 0xa013 0x9b2 0x48fc 0x9fa4 0x9bd 0x4bca 0x9f39 0x9cc 0x4e99 0x9ece 0x9ed 0x5168 0x9e5d 0x9f4 0x5436 0x9de9 0x9f6 0x5705 0x9d78 0x9f6 0x59d3 0x9d09 0x9f6 0x5ca2 0x9c9b 0x9de 0x5f71 0x9c35 0x9d0 0x623f 0x9bd4 0x9c4 0x650e 0x9b7c 0x9c4 0x67dc 0x9b25 0x9c5 0x6aab 0x9ac8 0x9ce 0x6d7a 0x9a65 0x9c9 0x7048 0x9a00 0x9b7 0x7317 0x9996 0x994 0x75e5 0x9927 0x96a 0x78b4 0x98b8 0x947 0x7b83 0x984a 0x914 0x7e51 0x97e3 0x8e9 0x8120 0x978a 0x8d4 0x83ee 0x9735 0x8d1 0x86bd 0x96ea 0x8ca 0x898c 0x96a4 0x8d4 0x8c5a 0x9664 0x8d4 0x8f29 0x9627 0x8d9 0x91f8 0x95f2 0x8ef 0x94c6 0x95bb 0x8f2 0x9795 0x9585 0x8f2 0x9a63 0x9558 0x906 0x9d32 0x952a 0x91a 0xa001 0x94fe 0x91a 0xa2cf 0x94d8 0x92d 0xa59e 0x94b4 0x94e 0xa86c 0x9490 0x956 0xab3b 0x946b 0x95c 0xae0a 0x944d 0x96a 0xb0d8 0x9430 0x987 0xb3a7 0x9418 0x996 0xb675 0x9401 0x9a2 0xb944 0x93e8 0x9a8 0xbc13 0x93df 0x9dc 0xbee1 0x93d7 0xa0d 0xc1b0 0x93ca 0xa38 0xc47e 0x93bd 0xa67 0xc74d 0x93af 0xa94 0xca1c 0x939d 0xacd 0xccea 0x9389 0xafe 0xcfb9 0x936e 0xb36 0xd287 0x9351 0xb70 0xd556 0x932f 0xba9 0xd825 0x930a 0xbed 0xdaf3 0x92e2 0xc43 0xddc2 0x92b3 0xca6 0xe090 0x9283 0xd30 0xe35f 0x924f 0xdbf 0xe62e 0x9212 0xe65 0xe8fc 0x91ca 0xf1f 0xebcb 0x9182 0xfeb 0xee9a 0x9137 0x10f1 0xf168 0x90e3 0x122c 0xf437 0x9089 0x1395 0xf705 0x9031 0x15ab 0xf9d4 0x8fe3 0x1856 0xfca3 0x8fa0 0x1c93 0xff71 0x8f53 0x2533 0x10240 0x8ef5 0x3114 0x1050e 0x8b2e 0x3136 0x107dd 0x8188 0x1faf 0x10aac 0x8124 0x1efa 0x10d7a 0x8124 0x1efa 0x1123d 0x8124 0x1efa 0x1137b 0x8124 0x1efa 0x11443 0x8124 0x1efa>;
		battery3_profile_t4_num = <0x64>;
		battery3_profile_t4 = <0x00 0xad01 0x18f6 0x2cf 0xabda 0x18f2 0x59d 0xaaff 0x18e3 0x86c 0xaa50 0x18be 0xb3a 0xa9b7 0x1882 0xe09 0xa925 0x184d 0x10d8 0xa89c 0x180b 0x13a6 0xa816 0x17b7 0x1675 0xa791 0x175c 0x1943 0xa70f 0x170f 0x1c12 0xa690 0x16ce 0x1ee1 0xa60f 0x1692 0x21af 0xa58e 0x164c 0x247e 0xa50c 0x160b 0x274c 0xa48f 0x15d2 0x2a1b 0xa415 0x15a2 0x2cea 0xa398 0x1568 0x2fb8 0xa320 0x1547 0x3287 0xa2a8 0x1525 0x3556 0xa230 0x1508 0x3824 0xa1b8 0x14e4 0x3af3 0xa13f 0x14b9 0x3dc1 0xa0c9 0x1494 0x4090 0xa055 0x146d 0x435f 0x9fea 0x1458 0x462d 0x9f7f 0x1447 0x48fc 0x9f0e 0x1438 0x4bca 0x9e98 0x142a 0x4e99 0x9e1c 0x140d 0x5168 0x9da2 0x13e5 0x5436 0x9d29 0x13c1 0x5705 0x9cb3 0x13a0 0x59d3 0x9c44 0x137e 0x5ca2 0x9bd9 0x1357 0x5f71 0x9b76 0x1343 0x623f 0x9b17 0x133b 0x650e 0x9abc 0x133b 0x67dc 0x9a57 0x132a 0x6aab 0x99ec 0x130e 0x6d7a 0x9981 0x12e7 0x7048 0x9918 0x12ca 0x7317 0x98b4 0x12b7 0x75e5 0x9853 0x12a5 0x78b4 0x97f5 0x1288 0x7b83 0x979b 0x127f 0x7e51 0x9747 0x126d 0x8120 0x96f7 0x1266 0x83ee 0x96ad 0x1266 0x86bd 0x9668 0x1270 0x898c 0x9627 0x128b 0x8c5a 0x95ec 0x12bc 0x8f29 0x95b1 0x12da 0x91f8 0x957c 0x12f7 0x94c6 0x9548 0x130c 0x9795 0x9517 0x133e 0x9a63 0x94ed 0x136c 0x9d32 0x94c4 0x13ab 0xa001 0x949c 0x13d6 0xa2cf 0x9479 0x1404 0xa59e 0x945e 0x1442 0xa86c 0x9446 0x1481 0xab3b 0x9432 0x14c1 0xae0a 0x941e 0x150f 0xb0d8 0x940b 0x155b 0xb3a7 0x93f9 0x15b7 0xb675 0x93e9 0x162a 0xb944 0x93d6 0x169c 0xbc13 0x93c3 0x1736 0xbee1 0x93ae 0x17d1 0xc1b0 0x9399 0x186a 0xc47e 0x9380 0x192f 0xc74d 0x9369 0x1a15 0xca1c 0x9350 0x1b09 0xccea 0x9334 0x1bff 0xcfb9 0x9315 0x1d22 0xd287 0x92f1 0x1e3c 0xd556 0x92cf 0x1f7e 0xd825 0x92a7 0x2088 0xdaf3 0x927f 0x21e9 0xddc2 0x924f 0x23a0 0xe090 0x9219 0x2565 0xe35f 0x91e1 0x27a6 0xe62e 0x91a2 0x2a17 0xe8fc 0x9163 0x2cf5 0xebcb 0x911b 0x3037 0xee9a 0x90d3 0x33a2 0xf168 0x9085 0x36e2 0xf437 0x9039 0x3972 0xf705 0x8fed 0x3b81 0xf9d4 0x8fa2 0x3cee 0xfca3 0x8f4d 0x3f13 0xff71 0x8eec 0x4214 0x10240 0x8dfb 0x46d3 0x1050e 0x8c6d 0x4902 0x107dd 0x8c6d 0x4902 0x10aac 0x8c6d 0x4902 0x10d7a 0x8c6d 0x4902 0x1123d 0x8c6d 0x4902 0x1137b 0x8c6d 0x4902 0x11443 0x8c6d 0x4902>;
		battery3_profile_t5_num = <0x64>;
		battery3_profile_t5 = <0x00 0xad01 0x18f6 0x2cf 0xabda 0x18f2 0x59d 0xaaff 0x18e3 0x86c 0xaa50 0x18be 0xb3a 0xa9b7 0x1882 0xe09 0xa925 0x184d 0x10d8 0xa89c 0x180b 0x13a6 0xa816 0x17b7 0x1675 0xa791 0x175c 0x1943 0xa70f 0x170f 0x1c12 0xa690 0x16ce 0x1ee1 0xa60f 0x1692 0x21af 0xa58e 0x164c 0x247e 0xa50c 0x160b 0x274c 0xa48f 0x15d2 0x2a1b 0xa415 0x15a2 0x2cea 0xa398 0x1568 0x2fb8 0xa320 0x1547 0x3287 0xa2a8 0x1525 0x3556 0xa230 0x1508 0x3824 0xa1b8 0x14e4 0x3af3 0xa13f 0x14b9 0x3dc1 0xa0c9 0x1494 0x4090 0xa055 0x146d 0x435f 0x9fea 0x1458 0x462d 0x9f7f 0x1447 0x48fc 0x9f0e 0x1438 0x4bca 0x9e98 0x142a 0x4e99 0x9e1c 0x140d 0x5168 0x9da2 0x13e5 0x5436 0x9d29 0x13c1 0x5705 0x9cb3 0x13a0 0x59d3 0x9c44 0x137e 0x5ca2 0x9bd9 0x1357 0x5f71 0x9b76 0x1343 0x623f 0x9b17 0x133b 0x650e 0x9abc 0x133b 0x67dc 0x9a57 0x132a 0x6aab 0x99ec 0x130e 0x6d7a 0x9981 0x12e7 0x7048 0x9918 0x12ca 0x7317 0x98b4 0x12b7 0x75e5 0x9853 0x12a5 0x78b4 0x97f5 0x1288 0x7b83 0x979b 0x127f 0x7e51 0x9747 0x126d 0x8120 0x96f7 0x1266 0x83ee 0x96ad 0x1266 0x86bd 0x9668 0x1270 0x898c 0x9627 0x128b 0x8c5a 0x95ec 0x12bc 0x8f29 0x95b1 0x12da 0x91f8 0x957c 0x12f7 0x94c6 0x9548 0x130c 0x9795 0x9517 0x133e 0x9a63 0x94ed 0x136c 0x9d32 0x94c4 0x13ab 0xa001 0x949c 0x13d6 0xa2cf 0x9479 0x1404 0xa59e 0x945e 0x1442 0xa86c 0x9446 0x1481 0xab3b 0x9432 0x14c1 0xae0a 0x941e 0x150f 0xb0d8 0x940b 0x155b 0xb3a7 0x93f9 0x15b7 0xb675 0x93e9 0x162a 0xb944 0x93d6 0x169c 0xbc13 0x93c3 0x1736 0xbee1 0x93ae 0x17d1 0xc1b0 0x9399 0x186a 0xc47e 0x9380 0x192f 0xc74d 0x9369 0x1a15 0xca1c 0x9350 0x1b09 0xccea 0x9334 0x1bff 0xcfb9 0x9315 0x1d22 0xd287 0x92f1 0x1e3c 0xd556 0x92cf 0x1f7e 0xd825 0x92a7 0x2088 0xdaf3 0x927f 0x21e9 0xddc2 0x924f 0x23a0 0xe090 0x9219 0x2565 0xe35f 0x91e1 0x27a6 0xe62e 0x91a2 0x2a17 0xe8fc 0x9163 0x2cf5 0xebcb 0x911b 0x3037 0xee9a 0x90d3 0x33a2 0xf168 0x9085 0x36e2 0xf437 0x9039 0x3972 0xf705 0x8fed 0x3b81 0xf9d4 0x8fa2 0x3cee 0xfca3 0x8f4d 0x3f13 0xff71 0x8eec 0x4214 0x10240 0x8dfb 0x46d3 0x1050e 0x8c6d 0x4902 0x107dd 0x8c6d 0x4902 0x10aac 0x8c6d 0x4902 0x10d7a 0x8c6d 0x4902 0x1123d 0x8c6d 0x4902 0x1137b 0x8c6d 0x4902 0x11443 0x8c6d 0x4902>;
		phandle = <0xab>;
	};

	md_ccif3@1023f000 {
		compatible = "mediatek,md_ccif3";
		reg = <0x00 0x1023f000 0x00 0x1000>;
	};

	sspm@10440000 {
		compatible = "mediatek,sspm";
		reg = <0x00 0x10440000 0x00 0x10000 0x00 0x10450000 0x00 0x100 0x00 0x10451000 0x00 0x08 0x00 0x10460000 0x00 0x100 0x00 0x10461000 0x00 0x08 0x00 0x10470000 0x00 0x100 0x00 0x10471000 0x00 0x08 0x00 0x10480000 0x00 0x100 0x00 0x10481000 0x00 0x08 0x00 0x10490000 0x00 0x100 0x00 0x10491000 0x00 0x08>;
		reg-names = "cfgreg\0mbox0_base\0mbox0_ctrl\0mbox1_base\0mbox1_ctrl\0mbox2_base\0mbox2_ctrl\0mbox3_base\0mbox3_ctrl\0mbox4_base\0mbox4_ctrl";
		interrupts = <GIC_SPI 215 IRQ_TYPE_LEVEL_HIGH GIC_SPI 218 IRQ_TYPE_LEVEL_HIGH GIC_SPI 219 IRQ_TYPE_LEVEL_HIGH GIC_SPI 220 IRQ_TYPE_LEVEL_HIGH GIC_SPI 221 IRQ_TYPE_LEVEL_HIGH GIC_SPI 222 IRQ_TYPE_LEVEL_HIGH>;
		interrupt-names = "ipc\0mbox0\0mbox1\0mbox2\0mbox3\0mbox4";
	};

	gic500@0c000000 {
		compatible = "mediatek,gic500";
		reg = <0x00 0xc000000 0x00 0x400000>;
	};

	gic_cpu@0c400000 {
		compatible = "mediatek,gic_cpu";
		reg = <0x00 0xc400000 0x00 0x40000>;
	};

	lastbus@10001000 {
		compatible = "mediatek,lastbus-v1";
		reg = <0x00 0x10001000 0x00 0x1000 0x00 0x10003000 0x00 0x1000>;
	};

	dfd@10200b00 {
		compatible = "mediatek,dfd";
		reg = <0x00 0x10200b00 0x00 0x10000>;
		mediatek,enabled = <0x01>;
		mediatek,chain_length = <0xa7f8>;
		mediatek,rg_dfd_timeout = <0xa0>;
	};

	dfd_cache: dfd_cache {
		compatible = "mediatek,dfd_cache";
		mediatek,enabled = <0x00>;
		mediatek,rg_dfd_timeout = <0x3e80>;
		phandle = <0xac>;
	};

	dbg_cti@0d020000 {
		compatible = "mediatek,dbg_cti";
		reg = <0x00 0xd020000 0x00 0x10000>;
	};

	dbg_etr@0d030000 {
		compatible = "mediatek,dbg_etr";
		reg = <0x00 0xd030000 0x00 0x10000>;
	};

	dbg_funnel@0d040000 {
		compatible = "mediatek,dbg_funnel";
		reg = <0x00 0xd040000 0x00 0x10000>;
	};

	dbg_dem@0d0a0000 {
		compatible = "mediatek,dbg_dem";
		reg = <0x00 0xd0a0000 0x00 0x10000>;
		interrupts = <GIC_SPI 157 IRQ_TYPE_LEVEL_LOW>;
	};

	dbg_mdsys1@0d0c0000 {
		compatible = "mediatek,dbg_mdsys1";
		reg = <0x00 0xd0c0000 0x00 0x40000>;
	};

	dbg_apmcu_mp0@0d400000 {
		compatible = "mediatek,dbg_apmcu_mp0";
		reg = <0x00 0xd400000 0x00 0x1000>;
	};

	dbg_apmcu_mp0@0d410000 {
		compatible = "mediatek,dbg_apmcu_mp0";
		reg = <0x00 0xd410000 0x00 0x1000>;
	};

	dbg_apmcu_mp0@0d420000 {
		compatible = "mediatek,dbg_apmcu_mp0";
		reg = <0x00 0xd420000 0x00 0x1000>;
	};

	dbg_apmcu_mp0@0d430000 {
		compatible = "mediatek,dbg_apmcu_mp0";
		reg = <0x00 0xd430000 0x00 0x1000>;
	};

	dbg_apmcu_mp0@0d440000 {
		compatible = "mediatek,dbg_apmcu_mp0";
		reg = <0x00 0xd440000 0x00 0x1000>;
	};

	dbg_apmcu_mp0@0d510000 {
		compatible = "mediatek,dbg_apmcu_mp0";
		reg = <0x00 0xd510000 0x00 0x1000>;
	};

	dbg_apmcu_mp0@0d520000 {
		compatible = "mediatek,dbg_apmcu_mp0";
		reg = <0x00 0xd520000 0x00 0x1000>;
	};

	dbg_apmcu_mp0@0d530000 {
		compatible = "mediatek,dbg_apmcu_mp0";
		reg = <0x00 0xd530000 0x00 0x1000>;
	};

	dbg_apmcu_mp0@0d540000 {
		compatible = "mediatek,dbg_apmcu_mp0";
		reg = <0x00 0xd540000 0x00 0x1000>;
	};

	dbg_apmcu_mp0@0d610000 {
		compatible = "mediatek,dbg_apmcu_mp0";
		reg = <0x00 0xd610000 0x00 0x1000>;
	};

	dbg_apmcu_mp0@0d620000 {
		compatible = "mediatek,dbg_apmcu_mp0";
		reg = <0x00 0xd620000 0x00 0x1000>;
	};

	dbg_apmcu_mp0@0d630000 {
		compatible = "mediatek,dbg_apmcu_mp0";
		reg = <0x00 0xd630000 0x00 0x1000>;
	};

	dbg_apmcu_mp0@0d640000 {
		compatible = "mediatek,dbg_apmcu_mp0";
		reg = <0x00 0xd640000 0x00 0x1000>;
	};

	dbg_apmcu_mp0@0d710000 {
		compatible = "mediatek,dbg_apmcu_mp0";
		reg = <0x00 0xd710000 0x00 0x1000>;
	};

	dbg_apmcu_mp0@0d720000 {
		compatible = "mediatek,dbg_apmcu_mp0";
		reg = <0x00 0xd720000 0x00 0x1000>;
	};

	dbg_apmcu_mp0@0d730000 {
		compatible = "mediatek,dbg_apmcu_mp0";
		reg = <0x00 0xd730000 0x00 0x1000>;
	};

	dbg_apmcu_mp0@0d740000 {
		compatible = "mediatek,dbg_apmcu_mp0";
		reg = <0x00 0xd740000 0x00 0x1000>;
	};

	dbg_apmcu_mp1@0d800000 {
		compatible = "mediatek,dbg_apmcu_mp1";
		reg = <0x00 0xd800000 0x00 0x1000>;
	};

	dbg_apmcu_mp1@0d810000 {
		compatible = "mediatek,dbg_apmcu_mp1";
		reg = <0x00 0xd810000 0x00 0x1000>;
	};

	dbg_apmcu_mp1@0d820000 {
		compatible = "mediatek,dbg_apmcu_mp1";
		reg = <0x00 0xd820000 0x00 0x1000>;
	};

	dbg_apmcu_mp1@0d830000 {
		compatible = "mediatek,dbg_apmcu_mp1";
		reg = <0x00 0xd830000 0x00 0x1000>;
	};

	dbg_apmcu_mp1@0d840000 {
		compatible = "mediatek,dbg_apmcu_mp1";
		reg = <0x00 0xd840000 0x00 0x1000>;
	};

	dbg_apmcu_mp1@0d910000 {
		compatible = "mediatek,dbg_apmcu_mp1";
		reg = <0x00 0xd910000 0x00 0x1000>;
	};

	dbg_apmcu_mp1@0d920000 {
		compatible = "mediatek,dbg_apmcu_mp1";
		reg = <0x00 0xd920000 0x00 0x1000>;
	};

	dbg_apmcu_mp1@0d930000 {
		compatible = "mediatek,dbg_apmcu_mp1";
		reg = <0x00 0xd930000 0x00 0x1000>;
	};

	dbg_apmcu_mp1@0d940000 {
		compatible = "mediatek,dbg_apmcu_mp1";
		reg = <0x00 0xd940000 0x00 0x1000>;
	};

	dbg_apmcu_mp1@0da10000 {
		compatible = "mediatek,dbg_apmcu_mp1";
		reg = <0x00 0xda10000 0x00 0x1000>;
	};

	dbg_apmcu_mp1@0da20000 {
		compatible = "mediatek,dbg_apmcu_mp1";
		reg = <0x00 0xda20000 0x00 0x1000>;
	};

	dbg_apmcu_mp1@0da30000 {
		compatible = "mediatek,dbg_apmcu_mp1";
		reg = <0x00 0xda30000 0x00 0x1000>;
	};

	dbg_apmcu_mp1@0da40000 {
		compatible = "mediatek,dbg_apmcu_mp1";
		reg = <0x00 0xda40000 0x00 0x1000>;
	};

	dbg_apmcu_mp1@0db10000 {
		compatible = "mediatek,dbg_apmcu_mp1";
		reg = <0x00 0xdb10000 0x00 0x1000>;
	};

	dbg_apmcu_mp1@0db20000 {
		compatible = "mediatek,dbg_apmcu_mp1";
		reg = <0x00 0xdb20000 0x00 0x1000>;
	};

	dbg_apmcu_mp1@0db30000 {
		compatible = "mediatek,dbg_apmcu_mp1";
		reg = <0x00 0xdb30000 0x00 0x1000>;
	};

	dbg_apmcu_mp1@0db40000 {
		compatible = "mediatek,dbg_apmcu_mp1";
		reg = <0x00 0xdb40000 0x00 0x1000>;
	};

	infra_dbgsystop_cpu0@0e000000 {
		compatible = "mediatek,infra_dbgsystop_cpu0";
		reg = <0x00 0xe000000 0x00 0x100000>;
	};

	infra_dbgsystop_cpu1@0e100000 {
		compatible = "mediatek,infra_dbgsystop_cpu1";
		reg = <0x00 0xe100000 0x00 0x100000>;
	};

	infra_dbgsystop_cpu2@0e200000 {
		compatible = "mediatek,infra_dbgsystop_cpu2";
		reg = <0x00 0xe200000 0x00 0x100000>;
	};

	infra_dbgsystop_cpu3@0e300000 {
		compatible = "mediatek,infra_dbgsystop_cpu3";
		reg = <0x00 0xe300000 0x00 0x100000>;
	};

	infra_dbgsystop_cpu4@0e400000 {
		compatible = "mediatek,infra_dbgsystop_cpu4";
		reg = <0x00 0xe400000 0x00 0x100000>;
	};

	infra_dbgsystop_cpu5@0e500000 {
		compatible = "mediatek,infra_dbgsystop_cpu5";
		reg = <0x00 0xe500000 0x00 0x100000>;
	};

	infra_dbgsystop_cpu6@0e600000 {
		compatible = "mediatek,infra_dbgsystop_cpu6";
		reg = <0x00 0xe600000 0x00 0x100000>;
	};

	infra_dbgsystop_cpu7@0e700000 {
		compatible = "mediatek,infra_dbgsystop_cpu7";
		reg = <0x00 0xe700000 0x00 0x100000>;
	};

	ap_dma@11000000 {
		compatible = "mediatek,ap_dma";
		reg = <0x00 0x11000000 0x00 0x1000>;
		interrupts = <GIC_SPI 102 IRQ_TYPE_LEVEL_LOW>;
	};

	auxadc: auxadc@11001000 {
		compatible = "mediatek,mt6768-auxadc";
		reg = <0x00 0x11001000 0x00 0x1000>;
		interrupts = <GIC_SPI 66 IRQ_TYPE_EDGE_FALLING>;
		clocks = <&infracfg_ao &infracfg_ao>;
		clock-names = "main";
		#io-channel-cells = <0x01>;
		mediatek,cali-en-bit = <0x14>;
		mediatek,cali-ge-bit = <0x0a>;
		mediatek,cali-oe-bit = <0x00>;
		mediatek,cali-efuse-index = <0x6a>;
		phandle = <0x23>;
	};

	apdma: dma-controller@11000980 {
		compatible = "mediatek,mt6577-uart-dma";
		reg = <0x00 0x11000980 0x00 0x80 0x00 0x11000a00 0x00 0x80 0x00 0x11000a80 0x00 0x80 0x00 0x11000b00 0x00 0x80>;
		interrupts = <GIC_SPI 102 IRQ_TYPE_LEVEL_LOW GIC_SPI 103 IRQ_TYPE_LEVEL_LOW GIC_SPI 104 IRQ_TYPE_LEVEL_LOW GIC_SPI 114 IRQ_TYPE_LEVEL_LOW>;
		clocks = <&infracfg_ao &mdp_rsz0>;
		clock-names = "apdma";
		#dma-cells = <0x01>;
		dma-bits = <0x22>;
		phandle = <0x30>;
	};

	apuart0: serial@11002000 {
		compatible = "mediatek,mt6577-uart";
		reg = <0x00 0x11002000 0x00 0x1000>;
		interrupts = <GIC_SPI 112 IRQ_TYPE_LEVEL_LOW>;
		clocks = <&clk26m &infracfg_ao &io_cfg_lm>;
		clock-names = "baud\0bus";
		dmas = <&apdma 0x00 &apdma &sysirq>;
		dma-names = "tx\0rx";
		phandle = <0xad>;
	};

	apuart1: serial@11003000 {
		compatible = "mediatek,mt6577-uart";
		reg = <0x00 0x11003000 0x00 0x1000>;
		interrupts = <GIC_SPI 113 IRQ_TYPE_LEVEL_LOW>;
		clocks = <&clk26m &infracfg_ao &io_cfg_lb>;
		clock-names = "baud\0bus";
		dmas = <&apdma &STANDBY &apdma &MCDI_CPU>;
		dma-names = "tx\0rx";
		phandle = <0xae>;
	};

	i2c_common: i2c_common {
		compatible = "mediatek,i2c_common";
		dma_support = [03];
		idvfs = [01];
		set_dt_div = [01];
		check_max_freq = [01];
		ver = [02];
		set_ltiming = [01];
		ext_time_config = [18 01];
		cnt_constraint = [01];
		control_irq_sel = [01];
		phandle = <0xaf>;
	};

	pwm@11006000 {
		compatible = "mediatek,pwm";
		reg = <0x00 0x11006000 0x00 0x1000>;
		interrupts = <GIC_SPI 98 IRQ_TYPE_LEVEL_LOW>;
		clocks = <&infracfg_ao &cpu7 &infracfg_ao &gic &infracfg_ao &topckgen &infracfg_ao &clk26m &infracfg_ao &gpio &infracfg_ao &apdma &infracfg_ao &cpu6 &infracfg_ao &io_cfg_lt>;
		clock-names = "PWM1-main\0PWM2-main\0PWM3-main\0PWM4-main\0PWM5-main\0PWM6-main\0PWM-HCLK-main\0PWM-main";
	};

	i2c0: i2c0@11007000 {
		compatible = "mediatek,i2c";
		id = <0x00>;
		reg = <0x00 0x11007000 0x00 0x1000 0x00 0x11000080 0x00 0x80>;
		interrupts = <GIC_SPI 105 IRQ_TYPE_LEVEL_LOW>;
		clocks = <&infracfg_ao &cpu2 &infracfg_ao &mdp_rsz0>;
		clock-names = "main", "dma";
		clock-div = <0x05>;
		scl-gpio-id = <0x53>;
		sda-gpio-id = <0x52>;
		gpio_start = <0x10002a00>;
		mem_len = <0x200>;
		eh_cfg = <0x30>;
		pu_cfg = <0x70>;
		rsel_cfg = <0x90>;
		aed = <0x1a>;
		phandle = <0xb0>;
	};

	i2c1: i2c1@11008000 {
		compatible = "mediatek,i2c";
		id = <0x01>;
		reg = <0x00 0x11008000 0x00 0x1000 0x00 0x11000100 0x00 0x80>;
		interrupts = <GIC_SPI 106 IRQ_TYPE_LEVEL_LOW>;
		clocks = <&infracfg_ao &cpu2 &infracfg_ao &mdp_rsz0>;
		clock-names = "main", "dma";
		clock-div = <0x05>;
		scl-gpio-id = <0x54>;
		sda-gpio-id = <0x51>;
		gpio_start = <0x10002a00>;
		mem_len = <0x200>;
		eh_cfg = <0x30>;
		pu_cfg = <0x70>;
		rsel_cfg = <0x90>;
		aed = <0x1a>;
		phandle = <0xb1>;
	};

	i2c2: i2c2@11009000 {
		compatible = "mediatek,i2c";
		id = <0x02>;
		reg = <0x00 0x11009000 0x00 0x1000 0x00 0x11000180 0x00 0x180>;
		interrupts = <GIC_SPI 107 IRQ_TYPE_LEVEL_LOW>;
		clocks = <&infracfg_ao &cpu2 &infracfg_ao &mdp_rsz0>;
		clock-names = "main", "dma";
		clock-div = <0x05>;
		scl-gpio-id = <0x67>;
		sda-gpio-id = <0x68>;
		gpio_start = <0x10002800>;
		mem_len = <0x200>;
		eh_cfg = <0x40>;
		pu_cfg = <0xa0>;
		rsel_cfg = <0xf0>;
		aed = <0x1a>;
		ch_offset_default = <0x100>;
		ch_offset_ccu = <0x200>;
		phandle = <0xb2>;
	};

	i2c3: i2c3@1100f000 {
		compatible = "mediatek,i2c";
		id = <0x03>;
		reg = <0x00 0x1100f000 0x00 0x1000 0x00 0x11000300 0x00 0x100>;
		interrupts = <GIC_SPI 108 IRQ_TYPE_LEVEL_LOW>;
		clocks = <&infracfg_ao &cpu2 &infracfg_ao &mdp_rsz0>;
		clock-names = "main", "dma";
		clock-div = <0x05>;
		scl-gpio-id = <0x32>;
		sda-gpio-id = <0x33>;
		gpio_start = <0x10002600>;
		mem_len = <0x200>;
		eh_cfg = <0x30>;
		pu_cfg = <0x60>;
		rsel_cfg = <0x90>;
		aed = <0x1a>;
		ch_offset_default = <0x100>;
		ch_offset_ccu = <0x200>;
		phandle = <0xb3>;
	};

	i2c4: i2c4@11011000 {
		compatible = "mediatek,i2c";
		id = <0x04>;
		reg = <0x00 0x11011000 0x00 0x1000 0x00 0x11000400 0x00 0x180>;
		interrupts = <GIC_SPI 109 IRQ_TYPE_LEVEL_LOW>;
		clocks = <&infracfg_ao &cpu2 &infracfg_ao &mdp_rsz0>;
		clock-names = "main", "dma";
		clock-div = <0x05>;
		scl-gpio-id = <0x69>;
		sda-gpio-id = <0x6a>;
		gpio_start = <0x10002800>;
		mem_len = <0x200>;
		eh_cfg = <0x40>;
		pu_cfg = <0xa0>;
		rsel_cfg = <0xf0>;
		aed = <0x1a>;
		ch_offset_default = <0x100>;
		ch_offset_ccu = <0x200>;
		phandle = <0xb4>;
	};

	i2c5: i2c5@11016000 {
		compatible = "mediatek,i2c";
                #address-cells = <1>;
                #size-cells = <0>;
		id = <0x05>;
		reg = <0x00 0x11016000 0x00 0x1000 0x00 0x11000580 0x00 0x80>;
		interrupts = <GIC_SPI 147 IRQ_TYPE_LEVEL_LOW>;
		clocks = <&infracfg_ao &cpu2 &infracfg_ao &mdp_rsz0>;
		clock-names = "main", "dma";
		clock-div = <0x05>;
		scl-gpio-id = <0x30>;
		sda-gpio-id = <0x31>;
		gpio_start = <0x10002600>;
		mem_len = <0x200>;
		eh_cfg = <0x30>;
		pu_cfg = <0x60>;
		rsel_cfg = <0x90>;
		aed = <0x1a>;
		phandle = <0xb5>;

		rt-swchg@53 {
			compatible = "richtek,swchg";
			reg = <0x53>;
			status = "okay";
			rt,intr_gpio_num = <0x09>;
			rt,intr_gpio = <0x1e 0x09 0x00>;
			hvdcp20_dp_gpio = <0x1e 0x96 0x00>;
			tc30_dm_gpio = <0x1e 0xb3 0x00>;

			rt9471 {
				charger_name = "primary_chg";
				chg_alias_name = "rt9471_chg";
				rm-slave-addr = [53];
				rm-name = "rt9471";
				interrupt-names = "wdt\0chg_mivr\0vac_ov\0otg_fault\0chg_rdy\0chg_done\0aicc_done\0pe_done\0chg_tout\0ieoc\0rechg\0chg_batov";
				vac_ovp = <0xd59f80>;
				mivr = <0x432380>;
				aicr = <0x7a120>;
				cv = <0x43e6d0>;
				ichg = <0x16e360>;
				ieoc = <0x30d40>;
				safe_tmr = <0x14>;
				wdt = <0x28>;
				mivr_track = <0x00>;
				en_safe_tmr;
				en_te;
				en_qon_rst;
			};
		};
	};

	i2c6: i2c6@1100d000 {
		compatible = "mediatek,i2c";
		id = <0x06>;
		reg = <0x00 0x1100d000 0x00 0x1000 0x00 0x11000600 0x00 0x80>;
		interrupts = <GIC_SPI 148 IRQ_TYPE_LEVEL_LOW>;
		clocks = <&infracfg_ao &cpu2 &infracfg_ao &mdp_rsz0>;
		clock-names = "main", "dma";
		clock-div = <0x05>;
		scl-gpio-id = <0x59>;
		sda-gpio-id = <0x5a>;
		gpio_start = <0x10002000>;
		mem_len = <0x200>;
		eh_cfg = <0x30>;
		pu_cfg = <0x60>;
		rsel_cfg = <0x90>;
		aed = <0x1a>;
		phandle = <0xb6>;
	};

	i2c7: i2c7@11004000 {
		compatible = "mediatek,i2c";
                #address-cells = <1>;
                #size-cells = <0>;
		id = <0x07>;
		reg = <0x00 0x11004000 0x00 0x1000 0x00 0x11000680 0x00 0x180>;
		interrupts = <GIC_SPI 110 IRQ_TYPE_LEVEL_LOW>;
		clocks = <&infracfg_ao &cpu2 &infracfg_ao &mdp_rsz0>;
		clock-names = "main", "dma";
		clock-div = <0x05>;
		scl-gpio-id = <0xaf>;
		sda-gpio-id = <0xb0>;
		gpio_start = <0x10002600>;
		mem_len = <0x200>;
		eh_cfg = <0x30>;
		pu_cfg = <0x60>;
		rsel_cfg = <0x90>;
		aed = <0x1a>;
		phandle = <0xb7>;

		nfc@08 {
			compatible = "mediatek,nfc";
			reg = <0x08>;
			status = "okay";
		};

		rt-swchg@53 {
			compatible = "richtek,swchg";
			reg = <0x53>;
			status = "okay";
			rt,intr_gpio_num = <0x15>;
			rt,intr_gpio = <0x1e 0x15 0x00>;
			rt,ceb_gpio = <0x1e 0xa0 0x00>;
			rt,ceb_gpio_num = <0xa0>;

			rt9471 {
				chg_name = "secondary_chg";
				chg_alias_name = "rt9471_sec_chg";
				rm-slave-addr = [53];
				rm-name = "rt9471";
				interrupt-names = "wdt\0chg_mivr\0vac_ov\0otg_fault\0chg_rdy\0chg_done\0aicc_done\0chg_tout\0ieoc\0rechg\0chg_batov";
				vac_ovp = <0xd59f80>;
				mivr = <0x432380>;
				aicr = <0x7a120>;
				cv = <0x43e6d0>;
				ichg = <0x16e360>;
				ieoc = <0x6ddd0>;
				safe_tmr = <0x14>;
				wdt = <0x28>;
				mivr_track = <0x00>;
				en_safe_tmr;
				en_te;
				ceb_invert;
				en_qon_rst;
			};
		};
	};

	i2c8: i2c8@11005000 {
		compatible = "mediatek,i2c";
		id = <0x08>;
		reg = <0x00 0x11005000 0x00 0x1000 0x00 0x11000800 0x00 0x180>;
		interrupts = <GIC_SPI 111 IRQ_TYPE_LEVEL_LOW>;
		clocks = <&infracfg_ao &cpu2 &infracfg_ao &mdp_rsz0>;
		clock-names = "main", "dma";
		clock-div = <0x05>;
		aed = <0x1a>;
		phandle = <0xb8>;
	};

	spi0: spi0@1100a000 {
		compatible = "mediatek,mt6765-spi";
		mediatek,pad-select = <0x00>;
		reg = <0x00 0x1100a000 0x00 0x1000>;
		interrupts = <GIC_SPI 138 IRQ_TYPE_LEVEL_LOW>;
		clocks = <&topckgen &cpu2 &topckgen &vcu &infracfg_ao &io_cfg_rt>;
		clock-names = "parent-clk\0sel-clk\0spi-clk";
		phandle = <0xb9>;
	};

	eem_fsm: eem_fsm@1100b000 {
		compatible = "mediatek,eem_fsm";
		reg = <0x00 0x1100b000 0x00 0x1000>;
		interrupts = <GIC_SPI 142 IRQ_TYPE_LEVEL_LOW>;
		eem-status = <0x01>;
		eem-initmon-little = <0x0f>;
		eem-initmon-big = <0x0f>;
		eem-initmon-cci = <0x0f>;
		eem-initmon-gpu = <0x0f>;
		eem-clamp-little = <0x00>;
		eem-clamp-big = <0x00>;
		eem-clamp-cci = <0x00>;
		eem-clamp-gpu = <0x00>;
		eem-offset-little = <0xff>;
		eem-offset-big = <0xff>;
		eem-offset-cci = <0xff>;
		eem-offset-gpu = <0xff>;
		phandle = <0xba>;
	};

	therm_ctrl@1100b000 {
		compatible = "mediatek,therm_ctrl";
		reg = <0x00 0x1100b000 0x00 0x1000>;
		interrupts = <GIC_SPI 99 IRQ_TYPE_LEVEL_LOW>;
		clocks = <&infracfg_ao &cpu1>;
		clock-names = "therm-main";
	};

	tboard_thermistor1: thermal-sensor1 {
		compatible = "mediatek,mtboard-thermistor1";
		io-channels = <&auxadc 0x00>;
		io-channel-names = "thermistor-ch0";
		phandle = <0xbb>;
	};

	tboard_thermistor2: thermal-sensor2 {
		compatible = "mediatek,mtboard-thermistor2";
		io-channels = <&auxadc &sysirq>;
		io-channel-names = "thermistor-ch1";
		phandle = <0xbc>;
	};

	drcc: drcc {
		compatible = "mediatek,drcc";
		state = <0xff>;
		drcc0_Vref = <0xff>;
		drcc1_Vref = <0xff>;
		drcc2_Vref = <0xff>;
		drcc3_Vref = <0xff>;
		drcc4_Vref = <0xff>;
		drcc5_Vref = <0xff>;
		drcc6_Vref = <0xff>;
		drcc7_Vref = <0xff>;
		drcc0_Hwgatepct = <0xff>;
		drcc1_Hwgatepct = <0xff>;
		drcc2_Hwgatepct = <0xff>;
		drcc3_Hwgatepct = <0xff>;
		drcc4_Hwgatepct = <0xff>;
		drcc5_Hwgatepct = <0xff>;
		drcc6_Hwgatepct = <0xff>;
		drcc7_Hwgatepct = <0xff>;
		drcc0_Code = <0xff>;
		drcc1_Code = <0xff>;
		drcc2_Code = <0xff>;
		drcc3_Code = <0xff>;
		drcc4_Code = <0xff>;
		drcc5_Code = <0xff>;
		drcc6_Code = <0xff>;
		drcc7_Code = <0xff>;
		phandle = <0xbd>;
	};

	btif@1100c000 {
		compatible = "mediatek,btif";
		reg = <0x00 0x1100c000 0x00 0x1000 0x00 0x11000b80 0x00 0x80 0x00 0x11000c00 0x00 0x80>;
		interrupts = <GIC_SPI 133 IRQ_TYPE_LEVEL_LOW GIC_SPI 115 IRQ_TYPE_LEVEL_LOW GIC_SPI 141 IRQ_TYPE_LEVEL_LOW>;
		clocks = <&infracfg_ao &io_cfg_rb &infracfg_ao &mdp_rsz0>;
		clock-names = "btifc\0apdmac";
	};

	consys: consys@18002000 {
		compatible = "mediatek,mt6768-consys";
		#address-cells = <0x02>;
		#size-cells = <0x02>;
		reg = <0x00 0x18002000 0x00 0x1000 0x00 0x10007000 0x00 0x100 0x00 0x10001000 0x00 0x1000 0x00 0x10006000 0x00 0x1000 0x00 0x18007000 0x00 0x1000 0x00 0x180b1000 0x00 0x1000 0x00 0x180a3000 0x00 0x1000 0x00 0x180a5000 0x00 0x800 0x00 0x180c1000 0x00 0x1000 0x00 0x18004000 0x00 0x1000>;
		interrupts = <GIC_SPI 284 IRQ_TYPE_LEVEL_LOW GIC_SPI 78 IRQ_TYPE_LEVEL_LOW GIC_SPI 287 IRQ_TYPE_EDGE_RISING>;
		clocks = <&scpsys &sysirq>;
		clock-names = "conn";
		wifi_ant_swap_gpio = <0x1e 0x6c 0x00>;
		phandle = <0xbe>;
	};

	disp_pwm@1100e000 {
		compatible = "mediatek,disp_pwm";
		reg = <0x00 0x1100e000 0x00 0x1000>;
	};

	spi1: spi1@11010000 {
		compatible = "mediatek,mt6765-spi";
		mediatek,pad-select = <0x00>;
		reg = <0x00 0x11010000 0x00 0x1000>;
		interrupts = <GIC_SPI 139 IRQ_TYPE_LEVEL_LOW>;
		clocks = <&topckgen &cpu2 &topckgen &vcu &infracfg_ao &msdc0_register_setting_default>;
		clock-names = "parent-clk\0sel-clk\0spi-clk";
		phandle = <0xbf>;
	};

	spi2: spi2@11012000 {
		compatible = "mediatek,mt6765-spi";
		mediatek,pad-select = <0x00>;
		reg = <0x00 0x11012000 0x00 0x1000>;
		interrupts = <GIC_SPI 145 IRQ_TYPE_LEVEL_LOW>;
		clocks = <&topckgen &cpu2 &topckgen &vcu &infracfg_ao &msdc1_pins_sdr104>;
		clock-names = "parent-clk\0sel-clk\0spi-clk";
		phandle = <0xc0>;
	};

	spi3: spi3@11013000 {
		compatible = "mediatek,mt6765-spi";
		mediatek,pad-select = <0x00>;
		reg = <0x00 0x11013000 0x00 0x1000>;
		interrupts = <GIC_SPI 146 IRQ_TYPE_LEVEL_LOW>;
		clocks = <&topckgen &cpu2 &topckgen &vcu &infracfg_ao &msdc1_pins_sdr50>;
		clock-names = "parent-clk\0sel-clk\0spi-clk";
		phandle = <0xc1>;
	};

	spi4: spi4@11014000 {
		compatible = "mediatek,mt6765-spi";
		mediatek,pad-select = <0x00>;
		reg = <0x00 0x11014000 0x00 0x1000>;
		interrupts = <GIC_SPI 116 IRQ_TYPE_LEVEL_LOW>;
		clocks = <&topckgen &cpu2 &topckgen &vcu &infracfg_ao &aud_clk_miso_off>;
		clock-names = "parent-clk\0sel-clk\0spi-clk";
		phandle = <0xc2>;
	};

	spi5: spi5@11015000 {
		compatible = "mediatek,mt6765-spi";
		mediatek,pad-select = <0x00>;
		reg = <0x00 0x11015000 0x00 0x1000>;
		interrupts = <GIC_SPI 117 IRQ_TYPE_LEVEL_LOW>;
		clocks = <&topckgen &cpu2 &topckgen &vcu &infracfg_ao &aud_clk_miso_on>;
		clock-names = "parent-clk\0sel-clk\0spi-clk";
		phandle = <0xc3>;
	};

	imp_iic@11017000 {
		compatible = "mediatek,imp_iic";
		reg = <0x00 0x11017000 0x00 0x1000>;
	};

	nfi@11018000 {
		compatible = "mediatek,nfi";
		reg = <0x00 0x11018000 0x00 0x1000>;
	};

	nfiecc@11019000 {
		compatible = "mediatek,nfiecc";
		reg = <0x00 0x11019000 0x00 0x1000>;
	};

	usb0@11200000 {
		compatible = "mediatek,mt6768-usb20";
		reg = <0x00 0x11200000 0x00 0x10000 0x00 0x11cc0000 0x00 0x10000>;
		interrupts = <GIC_SPI 97 IRQ_TYPE_LEVEL_LOW>;
		mode = <0x02>;
		multipoint = <0x01>;
		num_eps = <0x10>;
		clocks = <&infracfg_ao &SUSPEND &topckgen &mipi_rx_ana_csi2b &topckgen &pwrap>;
		clock-names = "usb0\0usb0_clk_top_sel\0usb0_clk_univpll3_d4";
	};

	msdc0: msdc@11230000 {
		compatible = "mediatek,msdc";
		reg = <0x00 0x11230000 0x00 0x10000>;
		interrupts = <GIC_SPI 100 IRQ_TYPE_LEVEL_LOW>;
		index = [00];
		clk_src = [01];
		bus-width = <0x08>;
		max-frequency = <0xbebc200>;
		cap-mmc-highspeed;
		mmc-ddr-1_8v;
		mmc-hs200-1_8v;
		mmc-hs400-1_8v;
		no-sd;
		no-sdio;
		non-removable;
		pinctl = <0x31>;
		pinctl_hs400 = <0x32>;
		pinctl_hs200 = <0x33>;
		register_setting = <0x34>;
		host_function = [00];
		bootable;
		status = "okay";
		vmmc-supply = <&mt_pmic_vemc_ldo_reg>;
		clocks = <&infracfg_ao &aud_gpio_i2s2_on &infracfg_ao &io_cfg_tl &infracfg_ao &aud_dat_mosi_on>;
		clock-names = "msdc0-clock\0msdc0-hclock\0msdc0-aes-clock";
		phandle = <0xc4>;
	};

	msdc1: msdc@11240000 {
		compatible = "mediatek,msdc";
		reg = <0x00 0x11240000 0x00 0x10000>;
		interrupts = <GIC_SPI 101 IRQ_TYPE_LEVEL_LOW>;
		index = [01];
		clk_src = [02];
		bus-width = <0x04>;
		max-frequency = <0xbebc200>;
		cap-sd-highspeed;
		sd-uhs-sdr12;
		sd-uhs-sdr25;
		sd-uhs-sdr50;
		sd-uhs-sdr104;
		sd-uhs-ddr50;
		no-mmc;
		no-sdio;
		pinctl = <0x36>;
		pinctl_sdr104 = <0x37>;
		pinctl_sdr50 = <0x38>;
		pinctl_ddr50 = <0x39>;
		register_setting = <0x3a>;
		host_function = [01];
		cd_level = [01];
		cd-gpios = <0x1e 0x04 0x00>;
		status = "okay";
		vmmc-supply = <&mt_pmic_vmch_ldo_reg>;
		vqmmc-supply = <&mt_pmic_vmc_ldo_reg>;
		clocks = <&infracfg_ao &aud_gpio_i2s3_off &infracfg_ao &eint>;
		clock-names = "msdc1-clock\0msdc1-hclock";
		phandle = <0xc5>;
	};

	msdc0_top@11cd0000 {
		compatible = "mediatek,msdc0_top";
		reg = <0x00 0x11cd0000 0x00 0x1000>;
	};

	msdc1_top@11c90000 {
		compatible = "mediatek,msdc1_top";
		reg = <0x00 0x11c90000 0x00 0x1000>;
	};

	usb1p_sif@11210000 {
		compatible = "mediatek,usb1p_sif";
		reg = <0x00 0x11210000 0x00 0x10000>;
	};

	audio: audio@11220000 {
		compatible = "mediatek,audio\0syscon";
		reg = <0x00 0x11220000 0x00 0x1000>;
		#clock-cells = <0x01>;
		phandle = <0x3e>;
	};

	afe: mt6768-afe-pcm@11220000 {
		compatible = "mediatek,mt6768-sound";
		reg = <0x00 0x11220000 0x00 0x1000>;
		interrupts = <GIC_SPI 169 IRQ_TYPE_LEVEL_LOW>;
		topckgen = <0x12>;
		apmixed = <0x3d>;
		clocks = <&audio 0x00 &audio &idledram &audio &idlesyspll &audio &MCDI_CLUSTER &audio &sysirq &audio &STANDBY &audio &MCDI_CPU &audio &idlebus26m &infracfg_ao &disp_color0 &infracfg_ao &msdc0_pins_hs200 &topckgen &wifi_mem &topckgen &main_pmic &topckgen &MCDI_CPU &topckgen &mipi_rx_ana_csi0a &topckgen &mdp_wrot0 &topckgen &mipi_rx_ana_csi0b &topckgen &mdp_ccorr &topckgen &mt_pmic_vrf12_ldo_reg &topckgen &mt_pmic_vio18_ldo_reg &topckgen &mt_pmic_vusb_ldo_reg &topckgen &mt_pmic_vcamio_ldo_reg &topckgen &sleep &topckgen &toprgu &topckgen &dcm &topckgen &pmic &apmixed &SUSPEND &clk26m>;
		clock-names = "aud_afe_clk\0aud_dac_clk\0aud_dac_predis_clk\0aud_adc_clk\0aud_apll22m_clk\0aud_apll24m_clk\0aud_apll1_tuner_clk\0aud_tml_clk\0aud_infra_axi_clk\0aud_infra_26m_clk\0top_mux_audio\0top_mux_audio_int\0top_sys_pll1_d4\0top_mux_aud_1\0top_apll1_ck\0top_mux_aud_eng1\0top_apll1_d8\0top_i2s0_m_sel\0top_i2s1_m_sel\0top_i2s2_m_sel\0top_i2s3_m_sel\0top_apll12_div0\0top_apll12_div1\0top_apll12_div2\0top_apll12_div3\0apmixed_apll1\0top_clk26m_clk";
		pinctrl-names = "aud_clk_mosi_off\0aud_clk_mosi_on\0aud_clk_miso_off\0aud_clk_miso_on\0aud_dat_mosi_off\0aud_dat_mosi_on\0aud_dat_miso_off\0aud_dat_miso_on\0aud_gpio_i2s0_off\0aud_gpio_i2s0_on\0aud_gpio_i2s1_off\0aud_gpio_i2s1_on\0aud_gpio_i2s2_off\0aud_gpio_i2s2_on\0aud_gpio_i2s3_off\0aud_gpio_i2s3_on\0vow_dat_miso_off\0vow_dat_miso_on\0vow_clk_miso_off\0vow_clk_miso_on";
		pinctrl-0 = <&aud_clk_mosi_off>;
		pinctrl-1 = <&aud_clk_mosi_on>;
		pinctrl-2 = <&aud_clk_miso_off>;
		pinctrl-3 = <&aud_clk_miso_on>;
		pinctrl-4 = <&aud_dat_mosi_off>;
		pinctrl-5 = <&aud_dat_mosi_on>;
		pinctrl-6 = <&aud_dat_miso_off>;
		pinctrl-7 = <&aud_dat_miso_on>;
		pinctrl-8 = <&aud_gpio_i2s0_off>;
		pinctrl-9 = <&aud_gpio_i2s0_on>;
		pinctrl-10 = <&aud_gpio_i2s1_off>;
		pinctrl-11 = <&aud_gpio_i2s1_on>;
		pinctrl-12 = <&aud_gpio_i2s2_off>;
		pinctrl-13 = <&aud_gpio_i2s2_on>;
		pinctrl-14 = <&aud_gpio_i2s3_off>;
		pinctrl-15 = <&aud_gpio_i2s3_on>;
		pinctrl-16 = <&vow_dat_miso_off>;
		pinctrl-17 = <&vow_dat_miso_on>;
		pinctrl-18 = <&vow_clk_miso_off>;
		pinctrl-19 = <&vow_clk_miso_on>;
		phandle = <0x54>;
	};

	mt6358_snd: mt6358_snd {
		compatible = "mediatek,mt6358-sound";
		mediatek,pwrap-regmap = <0x20>;
		phandle = <0x53>;
	};

	sound: sound {
		compatible = "mediatek,mt6768-mt6358-sound";
		mediatek,audio-codec = <0x53>;
		mediatek,platform = <0x54>;
		phandle = <0xc6>;
	};

	snd_scp_spk: snd_scp_spk {
		compatible = "mediatek,snd_scp_spk";
		phandle = <0xc7>;
	};

	audio_sram@11221000 {
		compatible = "mediatek,audio_sram";
		reg = <0x00 0x11221000 0x00 0x9000>;
		prefer_mode = <0x01>;
		mode_size = <0x6c00 0x9000>;
		block_size = <0x1000>;
	};

	mtk-btcvsd-snd@18050000 {
		compatible = "mediatek,mtk-btcvsd-snd";
		reg = <0x00 0x18050000 0x00 0x1000 0x00 0x18080000 0x00 0x10000>;
		interrupts = <GIC_SPI 283 IRQ_TYPE_LEVEL_LOW>;
		mediatek,infracfg = <0x21>;
		mediatek,offset = <0xf00 0x800 0x140 0x144 0x148>;
		disable_write_silence = <0x00>;
	};

	mt_soc_playback_offload {
		compatible = "mediatek,mt_soc_offload_common";
	};

	mipi_rx_ana_csi0a: mipi_rx_ana_csi0a@11c10000 {
		compatible = "mediatek,mipi_rx_ana_csi0a\0syscon";
		reg = <0x00 0x11c10000 0x00 0x1000>;
		#clock-cells = <0x01>;
		phandle = <0x61>;
	};

	mipi_rx_ana_csi0b: mipi_rx_ana_csi0b@11c11000 {
		compatible = "mediatek,mipi_rx_ana_csi0b\0syscon";
		reg = <0x00 0x11c11000 0x00 0x1000>;
		#clock-cells = <0x01>;
		phandle = <0x62>;
	};

	mipi_rx_ana_csi1a: mipi_rx_ana_csi1a@11c12000 {
		compatible = "mediatek,mipi_rx_ana_csi1a\0syscon";
		reg = <0x00 0x11c12000 0x00 0x1000>;
		#clock-cells = <0x01>;
		phandle = <0x63>;
	};

	mipi_rx_ana_csi1b: mipi_rx_ana_csi1b@11c13000 {
		compatible = "mediatek,mipi_rx_ana_csi1b\0syscon";
		reg = <0x00 0x11c13000 0x00 0x1000>;
		#clock-cells = <0x01>;
		phandle = <0x64>;
	};

	mipi_rx_ana_csi2a: mipi_rx_ana_csi2a@11c14000 {
		compatible = "mediatek,mipi_rx_ana_csi2a\0syscon";
		reg = <0x00 0x11c14000 0x00 0x1000>;
		#clock-cells = <0x01>;
		phandle = <0x65>;
	};

	mipi_rx_ana_csi2b: mipi_rx_ana_csi2b@11c15000 {
		compatible = "mediatek,mipi_rx_ana_csi2b\0syscon";
		reg = <0x00 0x11c15000 0x00 0x1000>;
		#clock-cells = <0x01>;
		phandle = <0x66>;
	};

	mipi_tx0@11c80000 {
		compatible = "mediatek,mipi_tx0";
		reg = <0x00 0x11c80000 0x00 0x10000>;
	};

	efusec@11ce0000 {
		compatible = "mediatek,efusec";
		reg = <0x00 0x11ce0000 0x00 0x10000>;
	};

	mfg_cfg: mfg_cfg@13000000 {
		compatible = "mediatek,mfgcfg\0syscon";
		reg = <0x00 0x13000000 0x00 0x1000>;
		#clock-cells = <0x01>;
		phandle = <0x56>;
	};

	mali@13040000 {
		compatible = "mediatek,mali\0arm,mali-midgard\0arm,mali-bifrost";
		reg = <0x00 0x13040000 0x00 0x4000>;
		interrupts = <GIC_SPI 274 IRQ_TYPE_LEVEL_LOW GIC_SPI 275 IRQ_TYPE_LEVEL_LOW GIC_SPI 276 IRQ_TYPE_LEVEL_LOW GIC_SPI 277 IRQ_TYPE_LEVEL_LOW GIC_SPI 278 IRQ_TYPE_LEVEL_LOW>;
		interrupt-names = "GPU\0MMU\0JOB\0EVENT\0PWR";
	};

	gpufreq {
		compatible = "mediatek,mt6768-gpufreq";
		clocks = <&topckgen &afe &topckgen &mdp_rsz0 &topckgen &idlesyspll &mfg_cfg 0x00 &scpsys &cpu0 &scpsys &MCDI_CLUSTER &scpsys &idlebus26m &scpsys &SUSPEND>;
		clock-names = "clk_mux\0clk_main_parent\0clk_sub_parent\0subsys_mfg_cg\0mtcmos_mfg_async\0mtcmos_mfg\0mtcmos_mfg_core0\0mtcmos_mfg_core1";
	};

	mmsys_config: mmsys_config@14000000 {
		compatible = "mediatek,mmsys_config\0syscon";
		reg = <0x00 0x14000000 0x00 0x1000>;
		interrupts = <GIC_SPI 240 IRQ_TYPE_LEVEL_LOW>;
		#clock-cells = <0x01>;
		clocks = <&mmsys_config &io_cfg_lb &mmsys_config &io_cfg_tl &mmsys_config &eint>;
		clock-names = "CAM_MDP\0IMG_DL_RELAY\0IMG_DL_ASYNC_TOP";
		phandle = <0x24>;
	};

	disp_mutex0: disp_mutex0@14001000 {
		compatible = "mediatek,disp_mutex0";
		reg = <0x00 0x14001000 0x00 0x1000>;
		interrupts = <GIC_SPI 223 IRQ_TYPE_LEVEL_LOW>;
		phandle = <0x2d>;
	};

	smi_common@14002000 {
		compatible = "mediatek,smi_common";
		reg = <0x00 0x14002000 0x00 0x1000>;
		mediatek,smi-id = <0x05>;
		clocks = <&scpsys &MCDI_CPU &mmsys_config &io_cfg_lt &mmsys_config &io_cfg_lm &mmsys_config &clk26m>;
		clock-names = "scp-dis\0mm-comm0\0mm-comm1\0mm-common";
		mmsys_config = <&mmsys_config>;
	};

	mmdvfs_pmqos {
		compatible = "mediatek,mmdvfs_pmqos";
		mm_step0 = <0x1c9 0x01 0x00 0x03>;
		mm_step1 = <0x138 0x01 0x00 0x04>;
		mm_step2 = <0xe4 0x01 0x00 0x05>;
		venc_step0 = <0x1c9 0x01 0x01 0x03>;
		venc_step1 = <0x1a0 0x01 0x01 0x06>;
		venc_step2 = <0x138 0x01 0x01 0x04>;
		cam_step0 = <0x222 0x01 0x02 0x07>;
		cam_step1 = <0x138 0x01 0x02 0x04>;
		cam_step2 = <0xe4 0x01 0x02 0x05>;
		vopp_steps = <0x00 0x01 0x03>;
		disp_freq = "mm_step0\0mm_step1\0mm_step2";
		mdp_freq = "mm_step0\0mm_step1\0mm_step2";
		cam_freq = "cam_step0\0cam_step1\0cam_step2";
		img_freq = "mm_step0\0mm_step1\0mm_step2";
		vdec_freq = "mm_step0\0mm_step1\0mm_step2";
		venc_freq = "venc_step0\0venc_step1\0venc_step2";
		clocks = <&topckgen &vow_clk_miso_on &topckgen &mcdi &topckgen &pericfg &topckgen &infracfg_ao &topckgen &io_cfg_lb &topckgen &scpsys &topckgen &io_cfg_rm &topckgen &sysirq>;
		clock-names = "mmdvfs_clk_mm_sel_ck\0mmdvfs_clk_venc_sel_ck\0mmdvfs_clk_cam_sel_ck\0mmdvfs_clk_mmpll_ck\0mmdvfs_clk_univpll1_d2_ck\0mmdvfs_clk_mmpll_d2_ck\0mmdvfs_clk_univpll_d3_ck\0mmdvfs_clk_syspll_d2_ck";
	};

	smi_larb0: smi_larb0@14003000 {
		compatible = "mediatek,smi_larb0\0mediatek,smi_larb";
		reg = <0x00 0x14003000 0x00 0x1000>;
		mediatek,smi-id = <0x00>;
		clocks = <&scpsys &MCDI_CPU &mmsys_config &gpio>;
		clock-names = "scp-dis\0mm-larb0";
		phandle = <0x57>;
	};

	mdp_rdma0: mdp_rdma0@14004000 {
		compatible = "mediatek,mdp_rdma0";
		reg = <0x00 0x14004000 0x00 0x1000>;
		interrupts = <GIC_SPI 224 IRQ_TYPE_LEVEL_LOW>;
		clocks = <&mmsys_config 0x00>;
		clock-names = "MDP_RDMA0";
		phandle = <0x25>;
	};

	mdp_ccorr: mdp_ccorr0@14005000 {
		compatible = "mediatek,mdp_ccorr0";
		reg = <0x00 0x14005000 0x00 0x1000>;
		interrupts = <GIC_SPI 239 IRQ_TYPE_LEVEL_LOW>;
		clocks = <&mmsys_config &sysirq>;
		clock-names = "MDP_CCORR";
		phandle = <0x2c>;
	};

	mdp_rsz0: mdp_rsz0@14006000 {
		compatible = "mediatek,mdp_rsz0";
		reg = <0x00 0x14006000 0x00 0x1000>;
		interrupts = <GIC_SPI 225 IRQ_TYPE_LEVEL_LOW>;
		clocks = <&mmsys_config &STANDBY>;
		clock-names = "MDP_RSZ0";
		phandle = <0x26>;
	};

	mdp_rsz1: mdp_rsz1@14007000 {
		compatible = "mediatek,mdp_rsz1";
		reg = <0x00 0x14007000 0x00 0x1000>;
		interrupts = <GIC_SPI 226 IRQ_TYPE_LEVEL_LOW>;
		clocks = <&mmsys_config &MCDI_CPU>;
		clock-names = "MDP_RSZ1";
		phandle = <0x27>;
	};

	mdp_wdma0: mdp_wdma0@14008000 {
		compatible = "mediatek,mdp_wdma0";
		reg = <0x00 0x14008000 0x00 0x1000>;
		interrupts = <GIC_SPI 229 IRQ_TYPE_LEVEL_LOW>;
		clocks = <&mmsys_config &idlesyspll>;
		clock-names = "MDP_WDMA";
		phandle = <0x28>;
	};

	mdp_wrot0: mdp_wrot0@14009000 {
		compatible = "mediatek,mdp_wrot0";
		reg = <0x00 0x14009000 0x00 0x1000>;
		interrupts = <GIC_SPI 228 IRQ_TYPE_LEVEL_LOW>;
		clocks = <&mmsys_config &idledram>;
		clock-names = "MDP_WROT0";
		phandle = <0x29>;
	};

	mdp_tdshp0: mdp_tdshp0@1400a000 {
		compatible = "mediatek,mdp_tdshp0";
		reg = <0x00 0x1400a000 0x00 0x1000>;
		clocks = <&mmsys_config &MCDI_CLUSTER>;
		clock-names = "MDP_TDSHP";
		phandle = <0x2a>;
	};

	disp_ovl0@1400b000 {
		compatible = "mediatek,disp_ovl0";
		reg = <0x00 0x1400b000 0x00 0x1000>;
		interrupts = <GIC_SPI 230 IRQ_TYPE_LEVEL_LOW>;
	};

	disp_rdma0@1400d000 {
		compatible = "mediatek,disp_rdma0";
		reg = <0x00 0x1400d000 0x00 0x1000>;
		interrupts = <GIC_SPI 231 IRQ_TYPE_LEVEL_LOW>;
	};

	disp_wdma0@1400e000 {
		compatible = "mediatek,disp_wdma0";
		reg = <0x00 0x1400e000 0x00 0x1000>;
		interrupts = <GIC_SPI 232 IRQ_TYPE_LEVEL_LOW>;
	};

	disp_color0: disp_color0@1400f000 {
		compatible = "mediatek,disp_color0";
		reg = <0x00 0x1400f000 0x00 0x1000>;
		interrupts = <GIC_SPI 233 IRQ_TYPE_LEVEL_LOW>;
		clocks = <&mmsys_config &cpu3>;
		clock-names = "MDP_COLOR";
		phandle = <0x2b>;
	};

	disp_ccorr0@14010000 {
		compatible = "mediatek,disp_ccorr0";
		reg = <0x00 0x14010000 0x00 0x1000>;
		interrupts = <GIC_SPI 234 IRQ_TYPE_LEVEL_LOW>;
	};

	disp_aal0@14011000 {
		compatible = "mediatek,disp_aal0";
		reg = <0x00 0x14011000 0x00 0x1000>;
		interrupts = <GIC_SPI 235 IRQ_TYPE_LEVEL_LOW>;
	};

	disp_gamma0@14012000 {
		compatible = "mediatek,disp_gamma0";
		reg = <0x00 0x14012000 0x00 0x1000>;
		interrupts = <GIC_SPI 236 IRQ_TYPE_LEVEL_LOW>;
	};

	disp_dither0@14013000 {
		compatible = "mediatek,disp_dither0";
		reg = <0x00 0x14013000 0x00 0x1000>;
		interrupts = <GIC_SPI 237 IRQ_TYPE_LEVEL_LOW>;
	};

	dsi0@14014000 {
		compatible = "mediatek,dsi0";
		reg = <0x00 0x14014000 0x00 0x1000>;
		interrupts = <GIC_SPI 238 IRQ_TYPE_LEVEL_LOW>;
	};

	disp_ovl0_2l@1400c000 {
		compatible = "mediatek,disp_ovl0_2l";
		reg = <0x00 0x1400c000 0x00 0x1000>;
		interrupts = <GIC_SPI 242 IRQ_TYPE_LEVEL_LOW>;
	};

	disp_rsz0@14015000 {
		compatible = "mediatek,disp_rsz0";
		reg = <0x00 0x14015000 0x00 0x1000>;
		interrupts = <GIC_SPI 293 IRQ_TYPE_LEVEL_LOW>;
	};

	mtkfb: mtkfb@0 {
		compatible = "mediatek,mtkfb";
		phandle = <0xc8>;
	};

	dispsys {
		compatible = "mediatek,dispsys";
		mediatek,larb = <&smi_larb0>;
		clocks = <&scpsys &MCDI_CPU &mmsys_config &clk26m &mmsys_config &gpio &mmsys_config &io_cfg_lt &mmsys_config &io_cfg_lm &mmsys_config &idlebus26m &mmsys_config &SUSPEND &mmsys_config &cpu1 &mmsys_config &cpu2 &mmsys_config &cpu3 &mmsys_config &cpu4 &mmsys_config &cpu5 &mmsys_config &cpu6 &mmsys_config &cpu7 &mmsys_config &gic &mmsys_config &pio &mmsys_config &io_cfg_tl &mmsys_config &clk32k &mmsys_config &cpu0 &apmixed &io_cfg_lt &topckgen &mipi_rx_ana_csi1a &infracfg_ao &msdc0_pins_default &clk26m &topckgen &io_cfg_rt &topckgen &gce_mbox &topckgen &apdma>;
		clock-names = "MMSYS_MTCMOS\0MMSYS_SMI_COMMON\0MMSYS_SMI_LARB0\0MMSYS_GALS_COMM0\0MMSYS_GALS_COMM1\0MMSYS_DISP_OVL0\0MMSYS_DISP_OVL0_2L\0MMSYS_DISP_RDMA0\0MMSYS_DISP_WDMA0\0MMSYS_DISP_COLOR0\0MMSYS_DISP_CCORR0\0MMSYS_DISP_AAL0\0MMSYS_DISP_GAMMA0\0MMSYS_DISP_DITHER0\0MMSYS_DSI0_MM_CK\0MMSYS_DSI0_IF_CK\0MMSYS_IMG_DL_RELAY\0MMSYS_26M\0MMSYS_DISP_RSZ0\0APMIXED_MIPI_26M\0TOP_MUX_DISP_PWM\0DISP_PWM\0TOP_26M\0TOP_UNIVPLL2_D4\0TOP_ULPOSC1_D2\0TOP_ULPOSC1_D8";
	};

	dsi_te: dsi_te {
		compatible = "mediatek, dsi_te-eint";
		status = "disabled";
		phandle = <0xc9>;
	};

	mm_mutex@14016000 {
		compatible = "mediatek,mm_mutex";
		reg = <0x00 0x14016000 0x00 0x1000>;
	};

	imgsys: imgsys@15020000 {
		compatible = "mediatek,imgsys\0syscon";
		reg = <0x00 0x15020000 0x00 0x1000>;
		#clock-cells = <0x01>;
		clocks = <&scpsys &MCDI_CPU &scpsys &idledram &scpsys &cpu1 &imgsys &sysirq &camsys &STANDBY &camsys &MCDI_CPU &camsys &MCDI_CLUSTER &camsys &idledram &camsys &idlesyspll &camsys &idlebus26m>;
		clock-names = "ISP_SCP_SYS_DIS\0ISP_SCP_SYS_ISP\0ISP_SCP_SYS_CAM\0ISP_CLK_IMG_DIP\0ISP_CLK_CAM\0ISP_CLK_CAMTG\0ISP_CLK_CAM_SENINF\0ISP_CLK_CAMSV0\0ISP_CLK_CAMSV1\0ISP_CLK_CAMSV2";
		phandle = <0x58>;
	};

	dip1@15022000 {
		compatible = "mediatek,dip1";
		reg = <0x00 0x15022000 0x00 0x3000>;
		interrupts = <GIC_SPI 270 IRQ_TYPE_LEVEL_LOW>;
	};

	fdvt@1502b000 {
		compatible = "mediatek,fdvt";
		reg = <0x00 0x1502b000 0x00 0x1000>;
		interrupts = <GIC_SPI 273 IRQ_TYPE_LEVEL_LOW>;
		clocks = <&imgsys &STANDBY>;
		clock-names = "FD_CLK_IMG_FDVT";
	};

	dpe@15028000 {
		compatible = "mediatek,dpe";
		reg = <0x00 0x15028000 0x00 0x1000>;
		interrupts = <GIC_SPI 271 IRQ_TYPE_LEVEL_LOW>;
		clocks = <&imgsys &MCDI_CPU>;
		clock-names = "DPE_CG_IMG_DPE";
	};

	smi_larb2: smi_larb2@15021000 {
		compatible = "mediatek,smi_larb2\0mediatek,smi_larb";
		reg = <0x00 0x15021000 0x00 0x1000>;
		mediatek,smi-id = <0x02>;
		clocks = <&scpsys &idledram &mmsys_config &io_cfg_bl &imgsys 0x00>;
		clock-names = "scp-isp\0mm-img\0img-larb2";
		phandle = <0xca>;
	};

	vcu: vcu@16000000 {
		compatible = "mediatek-vcu";
		mediatek,vcuid = <0x00>;
		mediatek,vcuname = "vcu";
		reg = <0x00 0x16000000 0x00 0x40000 0x00 0x17020000 0x00 0x10000 0x00 0x19002000 0x00 0x1000>;
		mediatek,mailbox-gce = <0x2e>;
		mboxes = <&gce_mbox &sysirq 0x00 &sysirq &gce_mbox &idledram 0x00 &sysirq>;
		gce-event-names = "venc_eof\0venc_cmdq_pause_done\0venc_mb_done\0venc_128B_cnt_done";
		gce-events = <0x2e 0x121 0x2e 0x122 0x2e 0x124 0x2e 0x125>;
		phandle = <0x5b>;
	};

	vdec_gcon: vdec_gcon@16000000 {
		compatible = "mediatek,vdec_gcon\0syscon";
		reg = <0x00 0x16000000 0x00 0x1000 0x00 0x16020000 0x00 0x400 0x00 0x16025000 0x00 0x1000>;
		mediatek,larb = <&smi_larb1>;
		interrupts = <GIC_SPI 246 IRQ_TYPE_LEVEL_LOW>;
		mediatek,vcu = <&vcu>;
		clocks = <&scpsys &MCDI_CPU &scpsys &cpu3 &vdec_gcon 0x00>;
		clock-names = "MT_SCP_SYS_DIS\0MT_SCP_SYS_VDE\0MT_CG_VDEC";
		#clock-cells = <0x01>;
		phandle = <0x5c>;
	};

	smi_larb1: smi_larb1@16010000 {
		compatible = "mediatek,smi_larb1\0mediatek,smi_larb";
		reg = <0x00 0x16010000 0x00 0x1000>;
		interrupts = <GIC_SPI 247 IRQ_TYPE_LEVEL_LOW>;
		mediatek,smi-id = <0x01>;
		clocks = <&scpsys &cpu3 &mmsys_config &io_cfg_rt &vdec_gcon &MCDI_CPU>;
		clock-names = "scp-vdec\0mm-vdec\0vdec-larb1";
		phandle = <0x5a>;
	};

	vdec@16020000 {
		compatible = "mediatek,vdec";
		reg = <0x00 0x16020000 0x00 0x10000>;
		interrupts = <GIC_SPI 246 IRQ_TYPE_LEVEL_LOW>;
	};

	reserve@16030000 {
		compatible = "mediatek,reserve";
		reg = <0x00 0x16030000 0x00 0x10000>;
	};

	vdec_mbist_ctrl@16001000 {
		compatible = "mediatek,vdec_mbist_ctrl";
		reg = <0x00 0x16001000 0x00 0x1000>;
	};

	venc_gcon: venc_gcon@17000000 {
		compatible = "mediatek,venc_gcon\0syscon";
		reg = <0x00 0x17000000 0x00 0x1000 0x00 0x17020000 0x00 0x1000>;
		mediatek,larb = <&smi_larb4>;
		interrupts = <GIC_SPI 243 IRQ_TYPE_LEVEL_LOW>;
		mediatek,vcu = <&vcu>;
		clocks = <&scpsys &MCDI_CPU &scpsys &cpu2 &venc_gcon &sysirq>;
		clock-names = "MT_SCP_SYS_DIS\0MT_SCP_SYS_VEN\0MT_CG_VENC";
		#clock-cells = <0x01>;
		phandle = <0x5e>;
	};

	smi_larb4: smi_larb4@17010000 {
		compatible = "mediatek,smi_larb4\0mediatek,smi_larb";
		reg = <0x00 0x17010000 0x00 0x1000>;
		mediatek,smi-id = <0x04>;
		clocks = <&scpsys &cpu2 &mmsys_config &io_cfg_rb &venc_gcon &sysirq &venc_gcon &STANDBY>;
		clock-names = "scp-venc\0mm-venc\0venc-venc\0venc-jpgenc";
		phandle = <0x5d>;
	};

	venc@17020000 {
		compatible = "mediatek,venc";
		reg = <0x00 0x17020000 0x00 0x10000>;
		interrupts = <GIC_SPI 243 IRQ_TYPE_LEVEL_LOW>;
	};

	venc_jpg@17030000 {
		compatible = "mediatek,venc_jpg";
		reg = <0x00 0x17030000 0x00 0x10000>;
		interrupts = <GIC_SPI 245 IRQ_TYPE_LEVEL_LOW>;
		clocks = <&venc_gcon &STANDBY>;
		clock-names = "MT_CG_VENC_JPGENC";
	};

	mbist@17040000 {
		compatible = "mediatek,mbist";
		reg = <0x00 0x17040000 0x00 0x10000>;
	};

	mbist@17050000 {
		compatible = "mediatek,mbist";
		reg = <0x00 0x17050000 0x00 0x10000>;
	};

	mbist@17060000 {
		compatible = "mediatek,mbist";
		reg = <0x00 0x17060000 0x00 0x10000>;
	};

	mbist@17070000 {
		compatible = "mediatek,mbist";
		reg = <0x00 0x17070000 0x00 0x10000>;
	};

	wifi@18000000 {
		compatible = "mediatek,wifi";
		reg = <0x00 0x18000000 0x00 0x100000>;
		interrupts = <GIC_SPI 285 IRQ_TYPE_LEVEL_LOW>;
		memory-region = <&wifi_mem>;
	};

	camsys: camsys@1a000000 {
		compatible = "mediatek,camsys\0syscon";
		reg = <0x00 0x1a000000 0x00 0x1000>;
		#clock-cells = <0x01>;
		phandle = <0x59>;
	};

	smi_larb3: smi_larb3@1a002000 {
		compatible = "mediatek,smi_larb3\0mediatek,smi_larb";
		reg = <0x00 0x1a002000 0x00 0x1000>;
		mediatek,smi-id = <0x03>;
		clocks = <&scpsys &cpu1 &mmsys_config &io_cfg_rm &camsys 0x00>;
		clock-names = "scp-cam\0mm-cam\0cam-larb3";
		phandle = <0xcb>;
	};

	cam1@1a003000 {
		compatible = "mediatek,cam1";
		reg = <0x00 0x1a003000 0x00 0x1000>;
		interrupts = <GIC_SPI 250 IRQ_TYPE_LEVEL_LOW>;
	};

	cam2@1a004000 {
		compatible = "mediatek,cam2";
		reg = <0x00 0x1a004000 0x00 0x1000>;
		interrupts = <GIC_SPI 251 IRQ_TYPE_LEVEL_LOW>;
	};

	cam3@1a005000 {
		compatible = "mediatek,cam3";
		reg = <0x00 0x1a005000 0x00 0x1000>;
		interrupts = <GIC_SPI 252 IRQ_TYPE_LEVEL_LOW>;
	};

	cam_set@1a00b000 {
		compatible = "mediatek,cam_set";
		reg = <0x00 0x1a00b000 0x00 0x1000>;
	};

	cama_set@1a00c000 {
		compatible = "mediatek,cama_set";
		reg = <0x00 0x1a00c000 0x00 0x1000>;
	};

	camb_set@1a00d000 {
		compatible = "mediatek,camb_set";
		reg = <0x00 0x1a00d000 0x00 0x1000>;
	};

	cam_inner@1a013000 {
		compatible = "mediatek,cam_inner";
		reg = <0x00 0x1a013000 0x00 0x1000>;
	};

	cama_inner@1a014000 {
		compatible = "mediatek,cama_inner";
		reg = <0x00 0x1a014000 0x00 0x1000>;
	};

	camb_inner@1a015000 {
		compatible = "mediatek,camb_inner";
		reg = <0x00 0x1a015000 0x00 0x1000>;
	};

	cam_clear@1a01b000 {
		compatible = "mediatek,cam_clear";
		reg = <0x00 0x1a01b000 0x00 0x1000>;
	};

	cama_clear@1a01c000 {
		compatible = "mediatek,cama_clear";
		reg = <0x00 0x1a01c000 0x00 0x1000>;
	};

	camb_clear@1a01d000 {
		compatible = "mediatek,camb_clear";
		reg = <0x00 0x1a01d000 0x00 0x1000>;
	};

	cama_ext@1a024000 {
		compatible = "mediatek,cama_ext";
		reg = <0x00 0x1a024000 0x00 0x1000>;
	};

	camb_ext@1a025000 {
		compatible = "mediatek,camb_ext";
		reg = <0x00 0x1a025000 0x00 0x1000>;
	};

	seninf1@1a040000 {
		compatible = "mediatek,seninf1";
		reg = <0x00 0x1a040000 0x00 0x1000>;
	};

	seninf2@1a041000 {
		compatible = "mediatek,seninf2";
		reg = <0x00 0x1a041000 0x00 0x1000>;
	};

	seninf3@1a042000 {
		compatible = "mediatek,seninf3";
		reg = <0x00 0x1a042000 0x00 0x1000>;
	};

	seninf4@1a043000 {
		compatible = "mediatek,seninf4";
		reg = <0x00 0x1a043000 0x00 0x1000>;
	};

	kd_camera_hw1: kd_camera_hw1@1a040000 {
		compatible = "mediatek,camera_hw";
		reg = <0x00 0x1a040000 0x00 0x1000>;
		cam3_enable_sensor = "gc02m1_mipi_raw ov02b10_mipi_raw";
		pmic = <0x60>;
		clocks = <&topckgen &mfg_cfg &topckgen &smi_larb0 &topckgen &imgsys &topckgen &camsys &topckgen &gpio &topckgen &clk26m &topckgen &eint &topckgen &gic &topckgen &io_cfg_tl &topckgen &topckgen &clk26m &camsys &MCDI_CLUSTER &apmixed &cpu5 &apmixed &topckgen &mipi_rx_ana_csi0a 0x00 &mipi_rx_ana_csi0b 0x00 &mipi_rx_ana_csi1a 0x00 &mipi_rx_ana_csi1b 0x00 &mipi_rx_ana_csi2a 0x00 &mipi_rx_ana_csi2b 0x00 &topckgen &timer &topckgen &io_cfg_rb &scpsys &cpu1>;
		clock-names = "CLK_TOP_CAMTG_SEL\0CLK_TOP_CAMTG1_SEL\0CLK_TOP_CAMTG2_SEL\0CLK_TOP_CAMTG3_SEL\0CLK_MCLK_6M\0CLK_MCLK_12M\0CLK_MCLK_13M\0CLK_MCLK_48M\0CLK_MCLK_52M\0CLK_MCLK_24M\0CLK_MCLK_26M\0CLK_CAM_SENINF_CG\0CLK_MIPI_C0_26M_CG\0CLK_MIPI_C1_26M_CG\0CLK_MIPI_ANA_0A_CG\0CLK_MIPI_ANA_0B_CG\0CLK_MIPI_ANA_1A_CG\0CLK_MIPI_ANA_1B_CG\0CLK_MIPI_ANA_2A_CG\0CLK_MIPI_ANA_2B_CG\0CLK_TOP_CAMTM_SEL_CG\0CLK_TOP_CAMTM_208_CG\0CLK_SCP_SYS_CAM";
		phandle = <0xcc>;

		pinctrl-names = "default",
			"cam0_rst0", "cam0_rst1",
			"cam1_rst0", "cam1_rst1", "cam1_pnd0", "cam1_pnd1",
			"cam2_rst0", "cam2_rst1", "cam2_pnd0", "cam2_pnd1",
			"cam3_rst0", "cam3_rst1", "cam3_pnd0", "cam3_pnd1",
			"cam4_pnd0", "cam4_pnd1",
			"cam0_vcama_on", "cam0_vcama_off",
			"cam0_vcamd_on", "cam0_vcamd_off",
			"cam1_vcama_on", "cam1_vcama_off",
			"cam0_mclk_off", "cam0_mclk_2mA", "cam0_mclk_4mA", "cam0_mclk_6mA", "cam0_mclk_8mA",
			"cam1_mclk_off", "cam1_mclk_2mA", "cam1_mclk_4mA", "cam1_mclk_6mA", "cam1_mclk_8mA",
			"cam2_mclk_off", "cam2_mclk_2mA", "cam2_mclk_4mA", "cam2_mclk_6mA", "cam2_mclk_8mA",
			"cam3_mclk_off", "cam3_mclk_2mA", "cam3_mclk_4mA", "cam3_mclk_6mA", "cam3_mclk_8mA",
			"cam4_mclk_off", "cam4_mclk_2mA", "cam4_mclk_4mA", "cam4_mclk_6mA", "cam4_mclk_8mA";

		pinctrl-0  = <&camdefault>;
		pinctrl-1  = <&camera0_rst_output_low>;
		pinctrl-2  = <&camera0_rst_output_high>;
		pinctrl-3  = <&camera1_rst_output_low>;
		pinctrl-4  = <&camera1_rst_output_high>;
		pinctrl-5  = <&camera1_pdn_output_low>;
		pinctrl-6  = <&camera1_pdn_output_high>;
		pinctrl-7  = <&camera2_rst_output_low>;
		pinctrl-8  = <&camera2_rst_output_high>;
		pinctrl-9  = <&camera2_pdn_output_low>;
		pinctrl-10 = <&camera2_pdn_output_high>;
		pinctrl-11 = <&camera3_rst_output_low>;
		pinctrl-12 = <&camera3_rst_output_high>;
		pinctrl-13 = <&camera3_pdn_output_low>;
		pinctrl-14 = <&camera3_pdn_output_high>;
		pinctrl-15 = <&camera4_pdn_output_low>;
		pinctrl-16 = <&camera4_pdn_output_high>;
		pinctrl-17 = <&camera0_vcama_output_high>;
		pinctrl-18 = <&camera0_vcama_output_low>;
		pinctrl-19 = <&camera0_vcamd_output_high>;
		pinctrl-20 = <&camera0_vcamd_output_low>;
		pinctrl-21 = <&camera1_vcama_output_high>;
		pinctrl-22 = <&camera1_vcama_output_low>;
		pinctrl-23 = <&camera0_mclk_gpio_mode>;
		pinctrl-24 = <&camera0_mclk_2mA>;
		pinctrl-25 = <&camera0_mclk_4mA>;
		pinctrl-26 = <&camera0_mclk_6mA>;
		pinctrl-27 = <&camera0_mclk_8mA>;
		pinctrl-28 = <&camera1_mclk_gpio_mode>;
		pinctrl-29 = <&camera1_mclk_2mA>;
		pinctrl-30 = <&camera1_mclk_4mA>;
		pinctrl-31 = <&camera1_mclk_6mA>;
		pinctrl-32 = <&camera1_mclk_8mA>;
		pinctrl-33 = <&camera2_mclk_gpio_mode>;
		pinctrl-34 = <&camera2_mclk_2mA>;
		pinctrl-35 = <&camera2_mclk_4mA>;
		pinctrl-36 = <&camera2_mclk_6mA>;
		pinctrl-37 = <&camera2_mclk_8mA>;
		pinctrl-38 = <&camera3_mclk_gpio_mode>;
		pinctrl-39 = <&camera3_mclk_2mA>;
		pinctrl-40 = <&camera3_mclk_4mA>;
		pinctrl-41 = <&camera3_mclk_6mA>;
		pinctrl-42 = <&camera3_mclk_8mA>;
		pinctrl-43 = <&camera4_mclk_gpio_mode>;
		pinctrl-44 = <&camera4_mclk_2mA>;
		pinctrl-45 = <&camera4_mclk_4mA>;
		pinctrl-46 = <&camera4_mclk_6mA>;
		pinctrl-47 = <&camera4_mclk_8mA>;

		/* Camera power supplies requested by DTBO */
		cam0_vcama-supply = <&mt_pmic_vcama2_ldo_reg>;
		cam0_vcamd-supply = <&mt_pmic_vcamd_ldo_reg>;
		cam1_vcama-supply = <&mt_pmic_vcama1_ldo_reg>;

		cam2_vcama-supply = <&mt_pmic_vcama2_ldo_reg>;
		cam3_vcama-supply = <&mt_pmic_vcama1_ldo_reg>;
		cam4_vcama-supply = <&mt_pmic_vcama2_ldo_reg>;
		cam1_vcamd-supply = <&mt_pmic_vcamd_ldo_reg>;
		cam3_vcamd-supply = <&mt_pmic_vcamd_ldo_reg>;
		cam0_vcamio-supply = <&mt_pmic_vcamio_ldo_reg>;
		cam1_vcamio-supply = <&mt_pmic_vcamio_ldo_reg>;
		cam2_vcamio-supply = <&mt_pmic_vcamio_ldo_reg>;
		cam3_vcamio-supply = <&mt_pmic_vcamio_ldo_reg>;

		camera0 {
			compatible = "mediatek,camera0";
		};
		camera1 {
			compatible = "mediatek,camera1";
		};
		camera2 {
			compatible = "mediatek,camera2";
		};
		camera3 {
			compatible = "mediatek,camera3";
		};
	};

	flashlight_core: flashlight_core {
		compatible = "mediatek,flashlight_core";
		phandle = <0xcd>;
	};

	camera_af_hw_node: camera_af_hw_node {
		compatible = "mediatek,camera_af_lens";
		camaf_m1_pmic-supply = <&mt_pmic_vldo28_ldo_reg>;
		phandle = <0xce>;
	};

	flashlights_ocp81375: flashlights_ocp81375 {
		compatible = "mediatek,flashlights_ocp81375";
		phandle = <0xcf>;
	};

	flashlights_mt6370: flashlights_mt6370 {
		compatible = "mediatek,flashlights_mt6370";
		decouple = <0x00>;
		phandle = <0xd0>;

		channel@1 {
			type = <0x00>;
			ct = <0x00>;
			part = <0x00>;
		};

		channel@2 {
			type = <0x00>;
			ct = <0x01>;
			part = <0x00>;
		};
	};

	camsv1@1a050000 {
		compatible = "mediatek,camsv1";
		reg = <0x00 0x1a050000 0x00 0x1000>;
		interrupts = <GIC_SPI 258 IRQ_TYPE_LEVEL_LOW>;
	};

	camsv2@1a051000 {
		compatible = "mediatek,camsv2";
		reg = <0x00 0x1a051000 0x00 0x1000>;
		interrupts = <GIC_SPI 259 IRQ_TYPE_LEVEL_LOW>;
	};

	camsv3@1a052000 {
		compatible = "mediatek,camsv3";
		reg = <0x00 0x1a052000 0x00 0x1000>;
		interrupts = <GIC_SPI 256 IRQ_TYPE_LEVEL_LOW>;
	};

	camsv4@1a053000 {
		compatible = "mediatek,camsv4";
		reg = <0x00 0x1a053000 0x00 0x1000>;
		interrupts = <GIC_SPI 257 IRQ_TYPE_LEVEL_LOW>;
	};

	ccu@1a0b1000 {
		compatible = "mediatek,ccu";
		reg = <0x00 0x1a0b1000 0x00 0x10000>;
		interrupts = <GIC_SPI 261 IRQ_TYPE_LEVEL_LOW>;
		clocks = <&camsys &SUSPEND &scpsys &cpu1>;
		clock-names = "CCU_CLK_CAM_CCU\0CAM_PWR";
	};

	atf_logger {
		compatible = "mediatek,atf_logger";
		interrupts = <GIC_SPI 296 IRQ_TYPE_EDGE_RISING>;
	};

	amms_control {
		compatible = "mediatek,amms";
		interrupts = <GIC_SPI 305 IRQ_TYPE_EDGE_RISING>;
	};

	odm: odm {
		compatible = "simple-bus";
		phandle = <0xd1>;
	};

	memory_ssmr_features: memory-ssmr-features {
		compatible = "mediatek,memory-ssmr-features";
		svp-size = <0x00 0x10000000>;
		iris-recognition-size = <0x00 0x10000000>;
		2d_fr-size = <0x00 0x00>;
		tui-size = <0x00 0x4000000>;
		wfd-size = <0x00 0x4000000>;
		prot-sharedmem-size = <0x00 0x8000000>;
		ta-elf-size = <0x00 0x1000000>;
		ta-stack-heap-size = <0x00 0x6000000>;
		sdsp-tee-sharedmem-size = <0x00 0x1000000>;
		sdsp-firmware-size = <0x00 0x1000000>;
		phandle = <0xd2>;
	};

	radio_md_cfg: radio_md_cfg {
		compatible = "mediatek,radio_md_cfg";
		phandle = <0xd3>;
	};

	ts_btscharger: btscharger {
		compatible = "tran,ts_btscharger";
		io-channels = <&auxadc &MCDI_CLUSTER>;
		io-channel-names = "ts_btscharger";
		phandle = <0xd4>;
	};

	otg_iddig: otg_iddig {
		compatible = "mediatek,usb_iddig_bi_eint";
		phandle = <0xd5>;
	};

	tran_battery: tran_battery {
		compatible = "tran,chg_fun";
		enable_pcb_tml;
		pcb_temp_step_one = <0x9c40>;
		pcb_cur_step_one = <0x1f4>;
		pcb_temp_step_two = <0xabe0>;
		pcb_cur_step_two = <0x1f4>;
		pcb_min_chg_cur = <0xf4240>;
		enable_tchg_tml;
		tchg_temp_step_one = <0xa410>;
		tchg_cur_step_one = <0x1f4>;
		tchg_temp_step_two = <0xa7f8>;
		tchg_cur_step_two = <0x1f4>;
		tchg_min_chg_cur = <0xf4240>;
		jeita_below_t0_chg_cur = <0x00>;
		jeita_t0_to_t1_chg_cur = <0x155cc0>;
		jeita_t2_to_t3_chg_cur = <0x2191c0>;
		jeita_t3_to_t4_chg_cur = <0x1e8480>;
		jeita_above_t4_chg_cur = <0x00>;
		jeita_below_t0_input_cur = <0x16e360>;
		jeita_t0_to_t1_input_cur = <0x16e360>;
		jeita_t2_to_t3_input_cur = <0x2191c0>;
		jeita_t3_to_t4_input_cur = <0x1e8480>;
		jeita_above_t4_input_cur = <0xf4240>;
		phandle = <0xd6>;
	};

	tran_battery_aging: tran_battery_aging {
		compatible = "tran,chg_aging";
		battery_aging_module0 = <0x00>;
		battery_aging_module1 = <0x00>;
		battery_aging_module2 = <0x00>;
		battery_aging_module3 = <0x00>;
		phandle = <0xd7>;
	};

	mt_charger: mt_charger {
		compatible = "mediatek,mt-charger";
		phandle = <0xd8>;
	};

	lk_charger: lk_charger {
		compatible = "mediatek,lk_charger";
		enable_anime;
		enable_pe_plus;
		enable_pd20_reset;
		power_path_support;
		max_charger_voltage = <0x632ea0>;
		fast_charge_voltage = <0x2625a0>;
		usb_charger_current = <0x7a120>;
		ac_charger_current = <0x16e360>;
		ac_charger_input_current = <0x16e360>;
		non_std_ac_charger_current = <0x7a120>;
		charging_host_charger_current = <0x16e360>;
		ta_ac_charger_current = <0x2dc6c0>;
		pd_charger_current = <0x7a120>;
		cur_threshold = <0x7a120>;
		temp_t4_threshold = <0x32>;
		temp_t3_threshold = <0x2d>;
		temp_t2_threshold = <0x0f>;
		temp_t1_threshold = <0x00>;
		phandle = <0xd9>;
	};

	charger: charger {
		compatible = "mediatek,charger";
		algorithm_name = "DualSwitchCharging";
		enable_sw_jeita;
		enable_pe_plus;
		enable_pe_2;
		enable_hvdcp20;
		enable_tc30;
		enable_18w_flash;
		power_path_support;
		enable_ir_comp;
		r_bat_comp = <0x1e>;
		v_comp_max = <0x9c40>;
		disable_pd_dual;
		multi_battery_cv;
		battery_cv = <0x43e6d0 0x43e6d0 0x43e6d0 0x43e6d0>;
		max_charger_voltage = <0x632ea0>;
		min_charger_voltage = <0x432380>;
		min_charger_voltage_1 = <0x432380>;
		min_charger_voltage_2 = <0x401640>;
		max_dmivr_charger_current = <0x155cc0>;
		usb_charger_current_suspend = <0x00>;
		usb_charger_current_unconfigured = <0x11170>;
		usb_charger_current_configured = <0x7a120>;
		usb_charger_current = <0x7a120>;
		ac_charger_current = <0x2191c0>;
		ac_charger_input_current = <0x1e8480>;
		non_std_ac_charger_current = <0x124f80>;
		charging_host_charger_current = <0x16e360>;
		apple_1_0a_charger_current = <0x9eb10>;
		apple_2_1a_charger_current = "\0\f5";
		ta_ac_charger_current = <0x33e140>;
		jeita_temp_above_t4_cv = <0x3f52f0 0x3f52f0 0x3f52f0 0x3f52f0>;
		jeita_temp_t3_to_t4_cv = <0x3f52f0 0x3f52f0 0x3f52f0 0x3f52f0>;
		jeita_temp_t2_to_t3_cv = <0x43e6d0 0x43e6d0 0x43e6d0 0x43e6d0>;
		jeita_temp_t1_to_t2_cv = <0x43e6d0 0x43e6d0 0x43e6d0 0x43e6d0>;
		jeita_temp_t0_to_t1_cv = <0x43e6d0 0x43e6d0 0x43e6d0 0x43e6d0>;
		jeita_temp_below_t0_cv = <0x43e6d0 0x43e6d0 0x43e6d0 0x43e6d0>;
		temp_t4_thres = <0x37>;
		temp_t4_thres_minus_x_degree = <0x33>;
		temp_t3_thres = <0x2d>;
		temp_t3_thres_minus_x_degree = <0x2c>;
		temp_t2_thres = <0x0f>;
		temp_t2_thres_plus_x_degree = <0x10>;
		temp_t1_thres = <0x01>;
		temp_t1_thres_plus_x_degree = <0x01>;
		temp_t0_thres = <0x01>;
		temp_t0_thres_plus_x_degree = <0x01>;
		temp_neg_10_thres = <0x02>;
		enable_min_charge_temp;
		min_charge_temp = <0x00>;
		min_charge_temp_plus_x_degree = <0x01>;
		max_charge_temp = <0x35>;
		max_charge_temp_minus_x_degree = <0x34>;
		ta_9v_support;
		pe_ichg_level_threshold = <0xf4240>;
		ta_ac_12v_input_current = <0x30d400>;
		ta_ac_9v_input_current = <0x1e8480>;
		ta_ac_7v_input_current = <0x231860>;
		pe20_ichg_level_threshold = <0xf4240>;
		ta_start_battery_soc = <0x00>;
		ta_stop_battery_soc = <0x5a>;
		hvdcp20_ichg_level_threshold = <0xf4240>;
		high_temp_to_leave_pe40 = <0x2e>;
		high_temp_to_enter_pe40 = <0x27>;
		low_temp_to_leave_pe40 = <0x0a>;
		low_temp_to_enter_pe40 = <0x10>;
		pe40_single_charger_input_current = <0x2dc6c0>;
		pe40_single_charger_current = <0x2dc6c0>;
		pe40_dual_charger_input_current = <0x2dc6c0>;
		pe40_dual_charger_chg1_current = <0x1e8480>;
		pe40_dual_charger_chg2_current = <0x1e8480>;
		pe40_stop_battery_soc = <0x50>;
		pe40_r_cable_1a_lower = <0x206>;
		pe40_r_cable_2a_lower = <0x17f>;
		pe40_r_cable_3a_lower = <0xf5>;
		chg1_ta_ac_charger_current = <0x1ab3f0>;
		chg2_ta_ac_charger_current = <0x1ab3f0>;
		slave_mivr_diff = <0x186a0>;
		dual_polling_ieoc = <0x6ddd0>;
		cable_imp_threshold = <0x2bb>;
		vbat_cable_imp_threshold = <0x3b8260>;
		bif_threshold1 = <0x40d990>;
		bif_threshold2 = <0x419ce0>;
		bif_cv_under_threshold2 = <0x43e6d0>;
		pd_vbus_low_bound = <0x4c4b40>;
		pd_vbus_upper_bound = <0x4c4b40>;
		pd_ichg_level_threshold = <0xf4240>;
		pd_stop_battery_soc = <0x50>;
		ibus_err = <0x0e>;
		vsys_watt = <0x4c4b40>;
		max_charging_time = <0x14370>;
		phandle = <0xda>;
	};

	irtx_pwm: irtx_pwm {
		compatible = "mediatek,irtx-pwm";
		pwm_ch = <0x00>;
		pwm_data_invert = <0x00>;
		phandle = <0xdb>;
	};

	pmic_clock_buffer_ctrl: pmic_clock_buffer_ctrl {
		compatible = "mediatek,pmic_clock_buffer";
		mediatek,clkbuf-quantity = <0x07>;
		mediatek,clkbuf-config = <0x02 0x01 0x01 0x02 0x00 0x00 0x00>;
		mediatek,clkbuf-driving-current = <0x01 0x01 0x01 0x01 0x01 0x01 0x01>;
		phandle = <0xdc>;
	};

	touch: touch {
		compatible = "goodix,touch";
		phandle = <0xdd>;
	};

	nfc: nfc {
		compatible = "mediatek,nfc-gpio-v2";
		gpio-rst = <0x1e>;
		gpio-rst-std = <0x1e 0x1e 0x00>;
		gpio-irq = <0x1d>;
		gpio-irq-std = <0x1e 0x1d 0x00>;
		phandle = <0xde>;
	};

	irq_nfc: irq_nfc {
		compatible = "mediatek,irq_nfc-eint";
		phandle = <0xdf>;
		interrupt-parent = <&pio>;
		interrupts = <0x1d 0x04 0x1d 0x00>;
		status = "okay";
	};

	smart_pa: smart_pa {
		phandle = <0xe0>;
	};

	gpio_usage_mapping: gpio {
		compatible = "mediatek,gpio_usage_mapping";
		phandle = <0xe1>;
	};

	md1_sim1_hot_plug_eint: md1_sim1_hot_plug_eint {
		phandle = <0xe2>;
	};

	md1_sim2_hot_plug_eint: md1_sim2_hot_plug_eint {
		phandle = <0xe3>;
	};

	mt6370_pmu: mt6370_pmu_dts {
		interrupt-controller;
		#interrupt-cells = <0x01>;
		mt6370,intr_gpio_num = <0x03>;
		mt6370,intr_gpio = <0x1e 0x03 0x00>;
		phandle = <0xe4>;

		core {
			compatible = "mediatek,mt6370_pmu_core";
			interrupt-names = "otp\0vdda_ovp\0vdda_uv";
			i2cstmr_rst_tmr = <0x00>;
			mrstb_en;
			mrstb_tmr = <0x03>;
			int_wdt = <0x00>;
			int_deg = <0x00>;
		};

		charger {
			compatible = "mediatek,mt6370_pmu_charger";
			interrupt-names = "chg_mivr\0chg_aiclmeasi\0attachi\0ovpctrl_uvp_d_evt\0chg_wdtmri\0chg_vbusov\0chg_tmri\0chg_treg\0dcdti";
			charger_name = "primary_chg";
			load_switch_name = "primary_load_switch";
			ichg = <0x1e8480>;
			aicr = <0x7a120>;
			mivr = <0x432380>;
			cv = <0x426030>;
			ieoc = <0x249f0>;
			safety_timer = <0x0c>;
			dc_wdt = "\0=\t";
			ircmp_resistor = <0x61a8>;
			ircmp_vclamp = <0x7d00>;
			enable_te;
			enable_wdt;
			lbp_hys_sel = <0x01>;
			lbp_dt = <0x01>;
		};

		mt6370_pmu_fled1 {
			compatible = "mediatek,mt6370_pmu_fled1";
			interrupt-names = "fled_lvf\0fled2_short\0fled1_short";
			fled_enable = <0x01>;
			torch_cur = <0x493e0>;
			strobe_cur = <0x124f80>;
			strobe_timeout = <0x960>;
		};

		mt6370_pmu_fled2 {
			compatible = "mediatek,mt6370_pmu_fled2";
			fled_enable = <0x01>;
			torch_cur = <0x30d40>;
			strobe_cur = <0xf4240>;
			strobe_timeout = <0x4b0>;
		};

		ldo {
			compatible = "mediatek,mt6370_pmu_ldo";
			interrupt-names = "ldo_oc";
			ldo_oms = <0x01>;
			ldo_vrc_lt = <0x01>;

			mt6370_ldo {
				regulator-name = "irtx_ldo";
				regulator-min-microvolt = <0x186a00>;
				regulator-max-microvolt = "\0=\t";
			};
		};

		rgbled {
			compatible = "mediatek,mt6370_pmu_rgbled";
			interrupt-names = "isink4_short\0isink3_short\0isink2_short\0isink1_short\0isink4_open\0isink3_open\0isink2_open\0isink1_open";
			mt,led_name = "mt6370_pmu_led1\0mt6370_pmu_led2\0mt6370_pmu_led3\0mt6370_pmu_led4";
			mt,led_default_trigger = "cc_mode\0cc_mode\0cc_mode\0none";
		};

		bled {
			compatible = "mediatek,mt6370_pmu_bled";
			interrupt-names = "bled_ocp";
			mt,bled_name = "mt6370_pmu_bled";
			mt,chan_en = <0x0f>;
			mt,map_linear;
			mt,bl_ovp_level = <0x03>;
			mt,bl_ocp_level = <0x02>;
			mt,use_pwm;
			mt,pwm_fsample = <0x02>;
			mt,pwm_deglitch = <0x01>;
			mt,pwm_hys_en = <0x01>;
			mt,pwm_hys = <0x00>;
			mt,pwm_avg_cycle = <0x00>;
			mt,bled_ramptime = <0x03>;
			mt,bled_flash_ramp = <0x01>;
			mt,max_bled_brightness = <0x200>;
			mt,bled_curr_scale = <0x00>;
			mt,pwm_lpf_coef = <0x00>;
		};

		dsv {
			compatible = "mediatek,mt6370_pmu_dsv";
			interrupt-names = "dsv_vneg_ocp\0dsv_vpos_ocp\0dsv_bst_ocp\0dsv_vneg_scp\0dsv_vpos_scp";
			db_ext_en = <0x00>;
			db_periodic_fix = <0x00>;
			db_single_pin = <0x00>;
			db_freq_pm = <0x00>;
			db_periodic_mode = <0x00>;
			db_startup = <0x00>;
			db_vneg_20ms = <0x01>;
			db_vneg_disc = <0x00>;
			db_vpos_20ms = <0x01>;
			db_vpos_disc = <0x01>;
			db_delay = <0x03>;
			db_vbst = <0x1644>;
			db_vpos_slew = <0x01>;
			db_vneg_slew = <0x01>;

			mt6370_dsvp {
				regulator-name = "dsv_pos";
				regulator-min-microvolt = "\0=\t";
				regulator-max-microvolt = <0x5b8d80>;
			};

			mt6370_dsvn {
				regulator-name = "dsv_neg";
				regulator-min-microvolt = "\0=\t";
				regulator-max-microvolt = <0x5b8d80>;
			};
		};
	};

	mt6370_typec: type_c_port0 {
		tcpc-dual,supported_modes = <0x00>;
		mt-tcpc,name = "type_c_port0";
		mt-tcpc,role_def = <0x04>;
		mt-tcpc,rp_level = <0x01>;
		mt-tcpc,vconn_supply = <0x01>;
		mt-tcpc,notifier_supply_num = <0x03>;
		mt6370pd,intr_gpio = <0x1e 0x18 0x00>;
		mt6370pd,intr_gpio_num = <0x18>;
		phandle = <0xe5>;

		pd-data {
			pd,vid = <0x29cf>;
			pd,pid = <0x5081>;
			pd,source-cap-ext = <0x508129cf 0x00 0x00 0x00 0x00 0x7000000>;
			pd,mfrs = "RichtekTCPC";
			pd,charging_policy = <0x31>;
			pd,source-pdo-size = <0x01>;
			pd,source-pdo-data = <0x19096>;
			pd,sink-pdo-size = <0x01>;
			pd,sink-pdo-data = <0x190c8>;
			pd,id-vdo-size = <0x03>;
			pd,id-vdo-data = <0xd10029cf 0x00 0x50810000>;
			bat,nr = <0x01>;
			pd,country_nr = <0x00>;

			bat-info0 {
				bat,vid = <0x29cf>;
				bat,pid = <0x5081>;
				bat,mfrs = "bat1";
				bat,design_cap = <0xbb8>;
			};
		};

		dpm_caps {
			local_dr_power;
			local_dr_data;
			local_usb_comm;
			local_no_suspend;
			local_vconn_supply;
			attemp_enter_dp_mode;
			attemp_discover_cable;
			attemp_discover_id;
			pr_check = <0x00>;
			dr_check = <0x00>;
		};

		displayport {
			1st_connection = "dfp_d";
			2nd_connection = "dfp_d";
			signal,dp_v13;
			usbr20_not_used;
			typec,receptacle;

			ufp_d {
			};

			dfp_d {
				pin_assignment,mode_c;
				pin_assignment,mode_d;
				pin_assignment,mode_e;
				pin_assignment,mode_f;
			};
		};
	};

	trusty {
		compatible = "android,trusty-smc-v1";
		ranges;
		#address-cells = <0x02>;
		#size-cells = <0x02>;
		tee-id = <0x00>;
		tee-name = "trusty";

		mtee {
			compatible = "mediatek,trusty-mtee-v1";
		};

		gz-main {
			compatible = "mediatek,trusty-gz";
		};

		trusty-irq {
			compatible = "android,trusty-irq-v1";
			ppi-interrupt-parent = <0x11>;
		};

		trusty-virtio {
			compatible = "android,trusty-virtio-v1";
		};

		trusty-gz-log {
			compatible = "android,trusty-gz-log-v1";
		};
	};

	nebula {
		compatible = "android,nebula-smc-v1";
		ranges;
		#address-cells = <0x02>;
		#size-cells = <0x02>;
		tee-id = <0x01>;
		tee-name = "nebula";

		nebula-virtio {
			compatible = "android,nebula-virtio-v1";
		};

		nebula-irq {
			compatible = "android,nebula-irq-v1";
			ppi-interrupt-parent = <0x11>;
		};

		nebula-gz-log {
			compatible = "android,nebula-gz-log-v1";
		};
	};

};
