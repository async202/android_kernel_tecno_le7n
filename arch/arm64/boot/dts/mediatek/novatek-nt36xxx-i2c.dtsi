/*
 * Copyright (C) 2010 - 2017 Novatek, Inc.
 *
 * $Revision: 16858 $
 * $Date: 2017-09-26 15:01:39 +0800 (週二, 26 九月 2017) $
 *
 * This program is free software; you can redistribute it and/or modify
 * it under the terms of the GNU General Public License as published by
 * the Free Software Foundation; either version 2 of the License, or
 * (at your option) any later version.
 *
 * This program is distributed in the hope that it will be useful, but WITHOUT
 * ANY WARRANTY; without even the implied warranty of MERCHANTABILITY or
 * FITNESS FOR A PARTICULAR PURPOSE.  See the GNU General Public License for
 * more details.
 *
 */

&i2c0 {
	/* Novatek device tree node */
	cap_touch@62 {
		compatible = "mediatek,cap_touch";//Use MTK default touch
		reg = <0x62>;
		status = "ok";
	};
};
